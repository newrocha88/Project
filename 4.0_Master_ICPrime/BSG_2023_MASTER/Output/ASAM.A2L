ASAP2_VERSION 1 7
/begin PROJECT BSG_2023_MASTER "BSG_EVO_Master_MBDS_BSG_2023_MASTER"
/begin HEADER "D:\SDBox_MAN_Master_Expansion\Master_ICPrime\BSG_2023_MASTER" VERSION "8.27.01.01_1210" PROJECT_NO _245850671 /end HEADER
/begin MODULE BSG_2023_MASTER "D:\SDBox_MAN_Master_Expansion\Master_ICPrime\BSG_2023_MASTER"
/begin IF_DATA XCP
 /begin XCP_ON_CAN 0x0100 /*XCP on CAN version*/ CAN_ID_MASTER 0x18ef21f0 /* CMD/STIM */ CAN_ID_SLAVE 0x18eff021 /* RES/ERR/EV/SERV/DAQ */ BAUDRATE 250000 /* BAUDRATE */ SAMPLE_POINT 87 /* SAMPLE_POINT */ SAMPLE_RATE 1 /* SAMPLE_RATE */ BTL_CYCLES 160 /* BTL_CYCLES */ SJW 1 /* length synchr. segment */ CAN_ID_MASTER 0x18ef21f0 /* CMD/STIM */ CAN_ID_SLAVE 0x18eff021 /* RES/ERR/EV/SERV/DAQ */ BAUDRATE 250000 /* BAUDRATE */ SAMPLE_POINT 87 /* SAMPLE_POINT */ SAMPLE_RATE 1 /* SAMPLE_RATE */ BTL_CYCLES 160 /* BTL_CYCLES */ SJW 1 /* length synchr. segment */
  /begin PROTOCOL_LAYER 0x0100 0x07D0 0x2710 0 0 0 0 0 8 /* kXcpMaxCto */ 8 /* kXcpMaxDto */ BYTE_ORDER_MSB_LAST ADDRESS_GRANULARITY_BYTE OPTIONAL_CMD GET_COMM_MODE_INFO OPTIONAL_CMD GET_ID OPTIONAL_CMD SET_REQUEST OPTIONAL_CMD SET_MTA OPTIONAL_CMD UPLOAD OPTIONAL_CMD SHORT_UPLOAD OPTIONAL_CMD BUILD_CHECKSUM OPTIONAL_CMD DOWNLOAD OPTIONAL_CMD DOWNLOAD_NEXT OPTIONAL_CMD SET_CAL_PAGE OPTIONAL_CMD GET_CAL_PAGE OPTIONAL_CMD GET_PAG_PROCESSOR_INFO OPTIONAL_CMD GET_PAGE_INFO OPTIONAL_CMD SET_SEGMENT_MODE OPTIONAL_CMD GET_SEGMENT_MODE OPTIONAL_CMD COPY_CAL_PAGE OPTIONAL_CMD SET_DAQ_PTR OPTIONAL_CMD WRITE_DAQ OPTIONAL_CMD SET_DAQ_LIST_MODE OPTIONAL_CMD GET_DAQ_LIST_MODE OPTIONAL_CMD START_STOP_DAQ_LIST OPTIONAL_CMD START_STOP_SYNCH OPTIONAL_CMD GET_DAQ_PROCESSOR_INFO OPTIONAL_CMD GET_DAQ_RESOLUTION_INFO OPTIONAL_CMD GET_DAQ_EVENT_INFO OPTIONAL_CMD FREE_DAQ OPTIONAL_CMD ALLOC_DAQ OPTIONAL_CMD ALLOC_ODT OPTIONAL_CMD ALLOC_ODT_ENTRY COMMUNICATION_MODE_SUPPORTED BLOCK SLAVE MASTER 43 0 /end PROTOCOL_LAYER
  /begin PAG 1 /* MAX_SEGMENTS */ FREEZE_SUPPORTED /end PAG
  /begin DAQ DYNAMIC 0 /* MAX_DAQ */ 2 /* MAX_EVENT_CHANNEL */ 0 /* MIN_DAQ */ OPTIMISATION_TYPE_DEFAULT /* OPTIMISATION_TYPE */ ADDRESS_EXTENSION_FREE /* ADDRESS_EXTENSION */ IDENTIFICATION_FIELD_TYPE_ABSOLUTE /* IDENTIFICATION_FIELD */ GRANULARITY_ODT_ENTRY_SIZE_DAQ_BYTE /* GRANULARITY_ODT_ENTRY_SIZE_DAQ */ 7 /* MAX_ODT_ENTRY_SIZE_DAQ */ OVERLOAD_INDICATION_PID PRESCALER_SUPPORTED RESUME_SUPPORTED
   /begin STIM GRANULARITY_ODT_ENTRY_SIZE_STIM_BYTE 7 /* MAX_ODT_ENTRY_SIZE_STIM */ /end STIM
   /begin EVENT "OltRead" /* EVENT_CHANNEL_NAME */ "OltRead" /* EVENT_CHANNEL_SHORT_NAME */ 0 /* EVENT_CHANNEL_NUMBER */ DAQ 1 /* MAX_DAQ_LIST */ 100 /* TIME_CYCLE */ 6 /* TIME_UNIT */ 0 /* PRIORITY */ /end EVENT
   /begin EVENT "OltWrite" /* EVENT_CHANNEL_NAME */ "OltWrite" /* EVENT_CHANNEL_SHORT_NAME */ 1 /* EVENT_CHANNEL_NUMBER */ DAQ 1 /* MAX_DAQ_LIST */ 100 /* TIME_CYCLE */ 6 /* TIME_UNIT */ 0 /* PRIORITY */ /end EVENT
  /end DAQ
  /begin PAG 1 /* MAX_SEGMENTS */ FREEZE_SUPPORTED /end PAG
 /end XCP_ON_CAN
/end IF_DATA
/begin IF_DATA VISION DEVICE_SETTING "FlashScript=2" DEVICE_SETTING "UDS_TargetCanID=0x98DA27F9" DEVICE_SETTING "UDS_ToolCanID=0x98DAF927" /end IF_DATA
/begin IF_DATA GENERATOR INFO "Description=Release-AnyCPU, .NET Framework 4.5" INFO "IMSVersion=1.33: DIAG.SW.TOOL.A2LGenerator(BASE)_V03.00.22" INFO "APPVersion=3.0.22.29848" /end IF_DATA
/begin MOD_PAR ""
 /begin MEMORY_SEGMENT Parameter "Parameter_" DATA EEPROM INTERN 0x8DC8 0x0E -1 -1 -1 -1 -1 /end MEMORY_SEGMENT
 /begin MEMORY_SEGMENT MSW "MSW_" DATA ROM INTERN 0x1A20000 0x3B0000 -1 -1 -1 -1 -1 /end MEMORY_SEGMENT
 /begin MEMORY_SEGMENT MK_DDR_BDR_WDR "MK_DDR_BDR_WDR_" DATA ROM INTERN 0x19F0000 0x180 -1 -1 -1 -1 -1 /end MEMORY_SEGMENT
 /begin MEMORY_SEGMENT BM "BM_" DATA ROM INTERN 0x19F1F90 0x40 -1 -1 -1 -1 -1 /end MEMORY_SEGMENT
 /begin MEMORY_SEGMENT FLD "FLD_" DATA ROM INTERN 0x1A00010 0x40 -1 -1 -1 -1 -1 /end MEMORY_SEGMENT
 /begin MEMORY_SEGMENT CANConfigDataset "CANConfigDataset_" DATA ROM INTERN 0x1DE8000 0x18000 -1 -1 -1 -1 -1 /end MEMORY_SEGMENT
 SYSTEM_CONSTANT "BOOLEAN_TRUE" "1"
 SYSTEM_CONSTANT "BOOLEAN_FALSE" "0" VERSION "8.27.01.01_1210" ECU_CALIBRATION_OFFSET 0x00 /end MOD_PAR
/begin MOD_COMMON "" BYTE_ORDER MSB_LAST /end MOD_COMMON
/begin MEASUREMENT IN_DateandTime.LocalTime.Task5 "3.1.2.1.2 LocalTime" ULONG COMP_DEFAULT 0 0 0 255 ECU_ADDRESS 0x20401F0 READ_WRITE /end MEASUREMENT
/begin MEASUREMENT IN_DateandTime.SystemTime.Task5 "3.1.2.1.1 SystemTime" ULONG COMP_DEFAULT 0 0 0 255 ECU_ADDRESS 0x20401F4 READ_WRITE /end MEASUREMENT
/begin MEASUREMENT IN_DateandTime.TicksCount.Task5 "3.1.2.1.3 TicksCount" ULONG COMP_DEFAULT 0 0 0 255 ECU_ADDRESS 0x20401F8 READ_WRITE /end MEASUREMENT
/begin MEASUREMENT OUT_DateandTime.NewSystemTime.Task5 "3.1.2.2.1 NewSystemTime" ULONG COMP_DEFAULT 0 0 0 255 ECU_ADDRESS 0x204C000 READ_WRITE /end MEASUREMENT
/begin MEASUREMENT OUT_DateandTime.HourOffset.Task5 "3.1.2.2.2 HourOffset" SBYTE COMP_DEFAULT 0 0 -128 127 ECU_ADDRESS 0x204C004 READ_WRITE /end MEASUREMENT
/begin MEASUREMENT OUT_DateandTime.MinuteOffset.Task5 "3.1.2.2.3 MinuteOffset" SBYTE COMP_DEFAULT 0 0 -128 127 ECU_ADDRESS 0x204C005 READ_WRITE /end MEASUREMENT
/begin MEASUREMENT OUT_DateandTime.SetTime.Task5 "3.1.2.2.4 SetTime" UBYTE IS_BOOLEAN_TRUE 0 0 0 1 ECU_ADDRESS 0x204C006 READ_WRITE /end MEASUREMENT
/begin MEASUREMENT DIAG_DateandTime.LocalTime_DIAG.Task5 "Diagnosis Input" UWORD COMP_DEFAULT 0 0 0 65535 ECU_ADDRESS 0x204000C READ_WRITE /end MEASUREMENT
/begin MEASUREMENT DIAG_DateandTime.SetTime_DIAG.Task5 "Diagnosis Input" UWORD COMP_DEFAULT 0 0 0 65535 ECU_ADDRESS 0x204000E READ_WRITE /end MEASUREMENT
/begin MEASUREMENT DIAG_DateandTime.SystemTime_DIAG.Task5 "Diagnosis Input" UWORD COMP_DEFAULT 0 0 0 65535 ECU_ADDRESS 0x2040010 READ_WRITE /end MEASUREMENT
/begin MEASUREMENT OUT_MCANMaster.DeviceEnable.Task4 "" UBYTE IS_BOOLEAN_TRUE 0 0 0 1 ECU_ADDRESS 0x204B000 READ_WRITE /end MEASUREMENT
/begin MEASUREMENT OUT_ModelControl.ModelHold.Task1 "3.3.1.1.1 ModelHold" UBYTE IS_BOOLEAN_TRUE 0 0 0 1 ECU_ADDRESS 0x2048000 READ_WRITE /end MEASUREMENT
/begin MEASUREMENT IN_AnalogInputsPWR.IN_PWR.Task3 "U36Va" ULONG COMP_DEFAULT 0 0 0 4294967295 ECU_ADDRESS 0x2040240 READ_WRITE /end MEASUREMENT
/begin MEASUREMENT IN_AnalogInputsPWR.IN_PWR_G1.Task3 "U36Va" UWORD COMP_DEFAULT 0 0 0 65535 ECU_ADDRESS 0x2040244 READ_WRITE /end MEASUREMENT
/begin MEASUREMENT IN_AnalogInputsPWR.IN_PWR_G2.Task3 "U36Va" UWORD COMP_DEFAULT 0 0 0 65535 ECU_ADDRESS 0x2040246 READ_WRITE /end MEASUREMENT
/begin MEASUREMENT IN_AnalogInputsPWR.IN_PWR_G3.Task3 "U36Va" UWORD COMP_DEFAULT 0 0 0 65535 ECU_ADDRESS 0x2040248 READ_WRITE /end MEASUREMENT
/begin MEASUREMENT IN_AnalogInputsPWR.IN_PWR_G4.Task3 "U36Va" UWORD COMP_DEFAULT 0 0 0 65535 ECU_ADDRESS 0x204024A READ_WRITE /end MEASUREMENT
/begin MEASUREMENT IN_AnalogInputsPWR.IN_PWR_G5.Task3 "U36Va" UWORD COMP_DEFAULT 0 0 0 65535 ECU_ADDRESS 0x204024C READ_WRITE /end MEASUREMENT
/begin MEASUREMENT IN_AnalogInputsPWR.IN_PWR_G7.Task3 "U36Va" UWORD COMP_DEFAULT 0 0 0 65535 ECU_ADDRESS 0x204024E READ_WRITE /end MEASUREMENT
/begin MEASUREMENT IN_AnalogInputsPWR.IN_PWR.Task5 "U36Va" ULONG COMP_DEFAULT 0 0 0 4294967295 ECU_ADDRESS 0x20401FC READ_WRITE /end MEASUREMENT
/begin MEASUREMENT DIAG_AnalogInputsPWR.IN_PWR_DIAG.Task3 "Diagnosis Input" UWORD COMP_DEFAULT 0 0 0 65535 ECU_ADDRESS 0x2040028 READ_WRITE /end MEASUREMENT
/begin MEASUREMENT DIAG_AnalogInputsPWR.IN_PWR_G1_DIAG.Task3 "Diagnosis Input" UWORD COMP_DEFAULT 0 0 0 65535 ECU_ADDRESS 0x204002A READ_WRITE /end MEASUREMENT
/begin MEASUREMENT DIAG_AnalogInputsPWR.IN_PWR_G2_DIAG.Task3 "Diagnosis Input" UWORD COMP_DEFAULT 0 0 0 65535 ECU_ADDRESS 0x204002C READ_WRITE /end MEASUREMENT
/begin MEASUREMENT DIAG_AnalogInputsPWR.IN_PWR_G3_DIAG.Task3 "Diagnosis Input" UWORD COMP_DEFAULT 0 0 0 65535 ECU_ADDRESS 0x204002E READ_WRITE /end MEASUREMENT
/begin MEASUREMENT DIAG_AnalogInputsPWR.IN_PWR_G4_DIAG.Task3 "Diagnosis Input" UWORD COMP_DEFAULT 0 0 0 65535 ECU_ADDRESS 0x2040030 READ_WRITE /end MEASUREMENT
/begin MEASUREMENT DIAG_AnalogInputsPWR.IN_PWR_G5_DIAG.Task3 "Diagnosis Input" UWORD COMP_DEFAULT 0 0 0 65535 ECU_ADDRESS 0x2040032 READ_WRITE /end MEASUREMENT
/begin MEASUREMENT DIAG_AnalogInputsPWR.IN_PWR_G7_DIAG.Task3 "Diagnosis Input" UWORD COMP_DEFAULT 0 0 0 65535 ECU_ADDRESS 0x2040034 READ_WRITE /end MEASUREMENT
/begin MEASUREMENT IN_AnalogInputs.IN_ANA_01.Task3 "U5Va" ULONG COMP_DEFAULT 0 0 0 4294967295 ECU_ADDRESS 0x2040250 READ_WRITE /end MEASUREMENT
/begin MEASUREMENT IN_AnalogInputs.IN_ANA_02.Task3 "U5Va" ULONG COMP_DEFAULT 0 0 0 4294967295 ECU_ADDRESS 0x2040254 READ_WRITE /end MEASUREMENT
/begin MEASUREMENT IN_AnalogInputs.IN_ANA_03.Task3 "U32Vr" ULONG COMP_DEFAULT 0 0 0 4294967295 ECU_ADDRESS 0x2040258 READ_WRITE /end MEASUREMENT
/begin MEASUREMENT IN_AnalogInputs.IN_ANA_04.Task3 "U5Va" ULONG COMP_DEFAULT 0 0 0 4294967295 ECU_ADDRESS 0x204025C READ_WRITE /end MEASUREMENT
/begin MEASUREMENT IN_AnalogInputs.IN_ANA_05.Task3 "R500 (5V)" ULONG COMP_DEFAULT 0 0 0 4294967295 ECU_ADDRESS 0x2040260 READ_WRITE /end MEASUREMENT
/begin MEASUREMENT IN_AnalogInputs.IN_ANA_06.Task3 "R1000 (5V)" ULONG COMP_DEFAULT 0 0 0 4294967295 ECU_ADDRESS 0x2040264 READ_WRITE /end MEASUREMENT
/begin MEASUREMENT IN_AnalogInputs.IN_ANA_07.Task3 "RNTC" ULONG COMP_DEFAULT 0 0 0 4294967295 ECU_ADDRESS 0x2040268 READ_WRITE /end MEASUREMENT
/begin MEASUREMENT IN_AnalogInputs.IN_ANA_08_SEL1.Task3 "RNTC" ULONG COMP_DEFAULT 0 0 0 4294967295 ECU_ADDRESS 0x204026C READ_WRITE /end MEASUREMENT
/begin MEASUREMENT IN_AnalogInputs.IN_ANA_08_SEL2.Task3 "U32Vr-DA" ULONG COMP_DEFAULT 0 0 0 4294967295 ECU_ADDRESS 0x2040270 READ_WRITE /end MEASUREMENT
/begin MEASUREMENT IN_AnalogInputs.IN_ANA_09_SEL1.Task3 "RNTC" ULONG COMP_DEFAULT 0 0 0 4294967295 ECU_ADDRESS 0x2040274 READ_WRITE /end MEASUREMENT
/begin MEASUREMENT IN_AnalogInputs.IN_ANA_09_SEL2.Task3 "U32Vr-DA" ULONG COMP_DEFAULT 0 0 0 4294967295 ECU_ADDRESS 0x2040278 READ_WRITE /end MEASUREMENT
/begin MEASUREMENT IN_AnalogInputs.IN_ANA_10_SEL1.Task3 "RNTC" ULONG COMP_DEFAULT 0 0 0 4294967295 ECU_ADDRESS 0x204027C READ_WRITE /end MEASUREMENT
/begin MEASUREMENT IN_AnalogInputs.IN_ANA_10_SEL2.Task3 "U32Vr-DA" ULONG COMP_DEFAULT 0 0 0 4294967295 ECU_ADDRESS 0x2040280 READ_WRITE /end MEASUREMENT
/begin MEASUREMENT IN_AnalogInputs.IN_ANA_11_SEL1.Task3 "U36Vr - AC Compressor Input (Activated when > 50% VBatt)" ULONG COMP_DEFAULT 0 0 0 4294967295 ECU_ADDRESS 0x2040284 READ_WRITE /end MEASUREMENT
/begin MEASUREMENT IN_AnalogInputs.IN_ANA_11_SEL2.Task3 "U32Vr-DA" ULONG COMP_DEFAULT 0 0 0 4294967295 ECU_ADDRESS 0x2040288 READ_WRITE /end MEASUREMENT
/begin MEASUREMENT DIAG_AnalogInputs.IN_ANA_01_DIAG.Task3 "Diagnosis Input" UWORD COMP_DEFAULT 0 0 0 65535 ECU_ADDRESS 0x2040036 READ_WRITE /end MEASUREMENT
/begin MEASUREMENT DIAG_AnalogInputs.IN_ANA_02_DIAG.Task3 "Diagnosis Input" UWORD COMP_DEFAULT 0 0 0 65535 ECU_ADDRESS 0x2040038 READ_WRITE /end MEASUREMENT
/begin MEASUREMENT DIAG_AnalogInputs.IN_ANA_03_DIAG.Task3 "Diagnosis Input" UWORD COMP_DEFAULT 0 0 0 65535 ECU_ADDRESS 0x204003A READ_WRITE /end MEASUREMENT
/begin MEASUREMENT DIAG_AnalogInputs.IN_ANA_04_DIAG.Task3 "Diagnosis Input" UWORD COMP_DEFAULT 0 0 0 65535 ECU_ADDRESS 0x204003C READ_WRITE /end MEASUREMENT
/begin MEASUREMENT DIAG_AnalogInputs.IN_ANA_05_DIAG.Task3 "Diagnosis Input" UWORD COMP_DEFAULT 0 0 0 65535 ECU_ADDRESS 0x204003E READ_WRITE /end MEASUREMENT
/begin MEASUREMENT DIAG_AnalogInputs.IN_ANA_06_DIAG.Task3 "Diagnosis Input" UWORD COMP_DEFAULT 0 0 0 65535 ECU_ADDRESS 0x2040040 READ_WRITE /end MEASUREMENT
/begin MEASUREMENT DIAG_AnalogInputs.IN_ANA_07_DIAG.Task3 "Diagnosis Input" UWORD COMP_DEFAULT 0 0 0 65535 ECU_ADDRESS 0x2040042 READ_WRITE /end MEASUREMENT
/begin MEASUREMENT DIAG_AnalogInputs.IN_ANA_08_SEL1_DIAG.Task3 "Diagnosis Input" UWORD COMP_DEFAULT 0 0 0 65535 ECU_ADDRESS 0x2040044 READ_WRITE /end MEASUREMENT
/begin MEASUREMENT DIAG_AnalogInputs.IN_ANA_08_SEL2_DIAG.Task3 "Diagnosis Input" UWORD COMP_DEFAULT 0 0 0 65535 ECU_ADDRESS 0x2040046 READ_WRITE /end MEASUREMENT
/begin MEASUREMENT DIAG_AnalogInputs.IN_ANA_09_SEL1_DIAG.Task3 "Diagnosis Input" UWORD COMP_DEFAULT 0 0 0 65535 ECU_ADDRESS 0x2040048 READ_WRITE /end MEASUREMENT
/begin MEASUREMENT DIAG_AnalogInputs.IN_ANA_09_SEL2_DIAG.Task3 "Diagnosis Input" UWORD COMP_DEFAULT 0 0 0 65535 ECU_ADDRESS 0x204004A READ_WRITE /end MEASUREMENT
/begin MEASUREMENT DIAG_AnalogInputs.IN_ANA_10_SEL1_DIAG.Task3 "Diagnosis Input" UWORD COMP_DEFAULT 0 0 0 65535 ECU_ADDRESS 0x204004C READ_WRITE /end MEASUREMENT
/begin MEASUREMENT DIAG_AnalogInputs.IN_ANA_10_SEL2_DIAG.Task3 "Diagnosis Input" UWORD COMP_DEFAULT 0 0 0 65535 ECU_ADDRESS 0x204004E READ_WRITE /end MEASUREMENT
/begin MEASUREMENT DIAG_AnalogInputs.IN_ANA_11_SEL1_DIAG.Task3 "Diagnosis Input" UWORD COMP_DEFAULT 0 0 0 65535 ECU_ADDRESS 0x2040050 READ_WRITE /end MEASUREMENT
/begin MEASUREMENT DIAG_AnalogInputs.IN_ANA_11_SEL2_DIAG.Task3 "Diagnosis Input" UWORD COMP_DEFAULT 0 0 0 65535 ECU_ADDRESS 0x2040052 READ_WRITE /end MEASUREMENT
/begin MEASUREMENT IN_AnalogSupply.OUT_ANA_PWR_01.Task3 "PS 5V/50mA" UWORD COMP_DEFAULT 0 0 0 65535 ECU_ADDRESS 0x204028C READ_WRITE /end MEASUREMENT
/begin MEASUREMENT IN_AnalogSupply.OUT_ANA_PWR_02.Task3 "PS 5V/50mA" UWORD COMP_DEFAULT 0 0 0 65535 ECU_ADDRESS 0x204028E READ_WRITE /end MEASUREMENT
/begin MEASUREMENT IN_AnalogSupply.OUT_ANA_PWR_03.Task3 "PS 5V/50mA" UWORD COMP_DEFAULT 0 0 0 65535 ECU_ADDRESS 0x2040290 READ_WRITE /end MEASUREMENT
/begin MEASUREMENT DIAG_AnalogSupply.OUT_ANA_PWR_01_DIAG.Task3 "Diagnostic Input" UWORD COMP_DEFAULT 0 0 0 65535 ECU_ADDRESS 0x2040054 READ_WRITE /end MEASUREMENT
/begin MEASUREMENT DIAG_AnalogSupply.OUT_ANA_PWR_02_DIAG.Task3 "Diagnostic Input" UWORD COMP_DEFAULT 0 0 0 65535 ECU_ADDRESS 0x2040056 READ_WRITE /end MEASUREMENT
/begin MEASUREMENT DIAG_AnalogSupply.OUT_ANA_PWR_03_DIAG.Task3 "Diagnostic Input" UWORD COMP_DEFAULT 0 0 0 65535 ECU_ADDRESS 0x2040058 READ_WRITE /end MEASUREMENT
/begin MEASUREMENT IN_AnalogInputsCoolant.IN_ANA_12.Task3 "U32Va" ULONG COMP_DEFAULT 0 0 0 4294967295 ECU_ADDRESS 0x2040294 READ_WRITE /end MEASUREMENT
/begin MEASUREMENT IN_AnalogInputsCoolant.IN_ANA_13.Task3 "U32Va" ULONG COMP_DEFAULT 0 0 0 4294967295 ECU_ADDRESS 0x2040298 READ_WRITE /end MEASUREMENT
/begin MEASUREMENT DIAG_AnalogInputsCoolant.IN_ANA_12_DIAG.Task3 "Diagnosis Input" UWORD COMP_DEFAULT 0 0 0 65535 ECU_ADDRESS 0x204005A READ_WRITE /end MEASUREMENT
/begin MEASUREMENT DIAG_AnalogInputsCoolant.IN_ANA_13_DIAG.Task3 "Diagnosis Input" UWORD COMP_DEFAULT 0 0 0 65535 ECU_ADDRESS 0x204005C READ_WRITE /end MEASUREMENT
/begin MEASUREMENT IN_AnalogInputs.OUT_FREQ_feedback.IN_ANA_14.Task3 "U10Va / TSU B7 Signal Feedback" ULONG COMP_DEFAULT 0 0 0 4294967295 ECU_ADDRESS 0x204029C READ_WRITE /end MEASUREMENT
/begin MEASUREMENT IN_AnalogInputs.OUT_FREQ_feedback.IN_ANA_15.Task3 "U10Va / TSU B8 Signal Feedback" ULONG COMP_DEFAULT 0 0 0 4294967295 ECU_ADDRESS 0x20402A0 READ_WRITE /end MEASUREMENT
/begin MEASUREMENT DIAG_AnalogInputs.OUT_FREQ_feedback.IN_ANA_14_DIAG.Task3 "Diagnosis Input" UWORD COMP_DEFAULT 0 0 0 65535 ECU_ADDRESS 0x204005E READ_WRITE /end MEASUREMENT
/begin MEASUREMENT DIAG_AnalogInputs.OUT_FREQ_feedback.IN_ANA_15_DIAG.Task3 "Diagnosis Input" UWORD COMP_DEFAULT 0 0 0 65535 ECU_ADDRESS 0x2040060 READ_WRITE /end MEASUREMENT
/begin MEASUREMENT IN_DigitalInputs.IN_DIG_02.Task1 "" UBYTE IS_BOOLEAN_TRUE 0 0 0 1 ECU_ADDRESS 0x2040000 READ_WRITE /end MEASUREMENT
/begin MEASUREMENT IN_DigitalInputs.IN_DIG_10.Task1 "" UBYTE IS_BOOLEAN_TRUE 0 0 0 1 ECU_ADDRESS 0x2040001 READ_WRITE /end MEASUREMENT
/begin MEASUREMENT IN_DigitalInputs.IN_DIG_17.Task1 "" UBYTE IS_BOOLEAN_TRUE 0 0 0 1 ECU_ADDRESS 0x2040002 READ_WRITE /end MEASUREMENT
/begin MEASUREMENT IN_DigitalInputs.IN_DIG_26.Task1 "" UBYTE IS_BOOLEAN_TRUE 0 0 0 1 ECU_ADDRESS 0x2040003 READ_WRITE /end MEASUREMENT
/begin MEASUREMENT IN_DigitalInputs.IN_DIG_35.Task1 "" UBYTE IS_BOOLEAN_TRUE 0 0 0 1 ECU_ADDRESS 0x2040004 READ_WRITE /end MEASUREMENT
/begin MEASUREMENT IN_DigitalInputs.IN_DIG_36.Task1 "" UBYTE IS_BOOLEAN_TRUE 0 0 0 1 ECU_ADDRESS 0x2040005 READ_WRITE /end MEASUREMENT
/begin MEASUREMENT IN_DigitalInputs.IN_DIG_40.Task1 "" UBYTE IS_BOOLEAN_TRUE 0 0 0 1 ECU_ADDRESS 0x2040006 READ_WRITE /end MEASUREMENT
/begin MEASUREMENT IN_DigitalInputs.IN_DIG_36.Task2 "" UBYTE IS_BOOLEAN_TRUE 0 0 0 1 ECU_ADDRESS 0x2040018 READ_WRITE /end MEASUREMENT
/begin MEASUREMENT IN_DigitalInputs.IN_DIG_01.Task3 "" UBYTE IS_BOOLEAN_TRUE 0 0 0 1 ECU_ADDRESS 0x20402A4 READ_WRITE /end MEASUREMENT
/begin MEASUREMENT IN_DigitalInputs.IN_DIG_02.Task3 "" UBYTE IS_BOOLEAN_TRUE 0 0 0 1 ECU_ADDRESS 0x20402A5 READ_WRITE /end MEASUREMENT
/begin MEASUREMENT IN_DigitalInputs.IN_DIG_03.Task3 "" UBYTE IS_BOOLEAN_TRUE 0 0 0 1 ECU_ADDRESS 0x20402A6 READ_WRITE /end MEASUREMENT
/begin MEASUREMENT IN_DigitalInputs.IN_DIG_04.Task3 "" UBYTE IS_BOOLEAN_TRUE 0 0 0 1 ECU_ADDRESS 0x20402A7 READ_WRITE /end MEASUREMENT
/begin MEASUREMENT IN_DigitalInputs.IN_DIG_05.Task3 "" UBYTE IS_BOOLEAN_TRUE 0 0 0 1 ECU_ADDRESS 0x20402A8 READ_WRITE /end MEASUREMENT
/begin MEASUREMENT IN_DigitalInputs.IN_DIG_06.Task3 "" UBYTE IS_BOOLEAN_TRUE 0 0 0 1 ECU_ADDRESS 0x20402A9 READ_WRITE /end MEASUREMENT
/begin MEASUREMENT IN_DigitalInputs.IN_DIG_07.Task3 "" UBYTE IS_BOOLEAN_TRUE 0 0 0 1 ECU_ADDRESS 0x20402AA READ_WRITE /end MEASUREMENT
/begin MEASUREMENT IN_DigitalInputs.IN_DIG_08.Task3 "" UBYTE IS_BOOLEAN_TRUE 0 0 0 1 ECU_ADDRESS 0x20402AB READ_WRITE /end MEASUREMENT
/begin MEASUREMENT IN_DigitalInputs.IN_DIG_09.Task3 "" UBYTE IS_BOOLEAN_TRUE 0 0 0 1 ECU_ADDRESS 0x20402AC READ_WRITE /end MEASUREMENT
/begin MEASUREMENT IN_DigitalInputs.IN_DIG_10.Task3 "" UBYTE IS_BOOLEAN_TRUE 0 0 0 1 ECU_ADDRESS 0x20402AD READ_WRITE /end MEASUREMENT
/begin MEASUREMENT IN_DigitalInputs.IN_DIG_11.Task3 "" UBYTE IS_BOOLEAN_TRUE 0 0 0 1 ECU_ADDRESS 0x20402AE READ_WRITE /end MEASUREMENT
/begin MEASUREMENT IN_DigitalInputs.IN_DIG_12.Task3 "" UBYTE IS_BOOLEAN_TRUE 0 0 0 1 ECU_ADDRESS 0x20402AF READ_WRITE /end MEASUREMENT
/begin MEASUREMENT IN_DigitalInputs.IN_DIG_13.Task3 "" UBYTE IS_BOOLEAN_TRUE 0 0 0 1 ECU_ADDRESS 0x20402B0 READ_WRITE /end MEASUREMENT
/begin MEASUREMENT IN_DigitalInputs.IN_DIG_14.Task3 "" UBYTE IS_BOOLEAN_TRUE 0 0 0 1 ECU_ADDRESS 0x20402B1 READ_WRITE /end MEASUREMENT
/begin MEASUREMENT IN_DigitalInputs.IN_DIG_15.Task3 "" UBYTE IS_BOOLEAN_TRUE 0 0 0 1 ECU_ADDRESS 0x20402B2 READ_WRITE /end MEASUREMENT
/begin MEASUREMENT IN_DigitalInputs.IN_DIG_16.Task3 "" UBYTE IS_BOOLEAN_TRUE 0 0 0 1 ECU_ADDRESS 0x20402B3 READ_WRITE /end MEASUREMENT
/begin MEASUREMENT IN_DigitalInputs.IN_DIG_17.Task3 "" UBYTE IS_BOOLEAN_TRUE 0 0 0 1 ECU_ADDRESS 0x20402B4 READ_WRITE /end MEASUREMENT
/begin MEASUREMENT IN_DigitalInputs.IN_DIG_18.Task3 "" UBYTE IS_BOOLEAN_TRUE 0 0 0 1 ECU_ADDRESS 0x20402B5 READ_WRITE /end MEASUREMENT
/begin MEASUREMENT IN_DigitalInputs.IN_DIG_19.Task3 "" UBYTE IS_BOOLEAN_TRUE 0 0 0 1 ECU_ADDRESS 0x20402B6 READ_WRITE /end MEASUREMENT
/begin MEASUREMENT IN_DigitalInputs.IN_DIG_20.Task3 "" UBYTE IS_BOOLEAN_TRUE 0 0 0 1 ECU_ADDRESS 0x20402B7 READ_WRITE /end MEASUREMENT
/begin MEASUREMENT IN_DigitalInputs.IN_DIG_21.Task3 "" UBYTE IS_BOOLEAN_TRUE 0 0 0 1 ECU_ADDRESS 0x20402B8 READ_WRITE /end MEASUREMENT
/begin MEASUREMENT IN_DigitalInputs.IN_DIG_22.Task3 "" UBYTE IS_BOOLEAN_TRUE 0 0 0 1 ECU_ADDRESS 0x20402B9 READ_WRITE /end MEASUREMENT
/begin MEASUREMENT IN_DigitalInputs.IN_DIG_23.Task3 "" UBYTE IS_BOOLEAN_TRUE 0 0 0 1 ECU_ADDRESS 0x20402BA READ_WRITE /end MEASUREMENT
/begin MEASUREMENT IN_DigitalInputs.IN_DIG_24.Task3 "" UBYTE IS_BOOLEAN_TRUE 0 0 0 1 ECU_ADDRESS 0x20402BB READ_WRITE /end MEASUREMENT
/begin MEASUREMENT IN_DigitalInputs.IN_DIG_25.Task3 "" UBYTE IS_BOOLEAN_TRUE 0 0 0 1 ECU_ADDRESS 0x20402BC READ_WRITE /end MEASUREMENT
/begin MEASUREMENT IN_DigitalInputs.IN_DIG_26.Task3 "" UBYTE IS_BOOLEAN_TRUE 0 0 0 1 ECU_ADDRESS 0x20402BD READ_WRITE /end MEASUREMENT
/begin MEASUREMENT IN_DigitalInputs.IN_DIG_27.Task3 "" UBYTE IS_BOOLEAN_TRUE 0 0 0 1 ECU_ADDRESS 0x20402BE READ_WRITE /end MEASUREMENT
/begin MEASUREMENT IN_DigitalInputs.IN_DIG_28.Task3 "" UBYTE IS_BOOLEAN_TRUE 0 0 0 1 ECU_ADDRESS 0x20402BF READ_WRITE /end MEASUREMENT
/begin MEASUREMENT IN_DigitalInputs.IN_DIG_29.Task3 "" UBYTE IS_BOOLEAN_TRUE 0 0 0 1 ECU_ADDRESS 0x20402C0 READ_WRITE /end MEASUREMENT
/begin MEASUREMENT IN_DigitalInputs.IN_DIG_30.Task3 "" UBYTE IS_BOOLEAN_TRUE 0 0 0 1 ECU_ADDRESS 0x20402C1 READ_WRITE /end MEASUREMENT
/begin MEASUREMENT IN_DigitalInputs.IN_DIG_31.Task3 "" UBYTE IS_BOOLEAN_TRUE 0 0 0 1 ECU_ADDRESS 0x20402C2 READ_WRITE /end MEASUREMENT
/begin MEASUREMENT IN_DigitalInputs.IN_DIG_32.Task3 "" UBYTE IS_BOOLEAN_TRUE 0 0 0 1 ECU_ADDRESS 0x20402C3 READ_WRITE /end MEASUREMENT
/begin MEASUREMENT IN_DigitalInputs.IN_DIG_33.Task3 "" UBYTE IS_BOOLEAN_TRUE 0 0 0 1 ECU_ADDRESS 0x20402C4 READ_WRITE /end MEASUREMENT
/begin MEASUREMENT IN_DigitalInputs.IN_DIG_34.Task3 "" UBYTE IS_BOOLEAN_TRUE 0 0 0 1 ECU_ADDRESS 0x20402C5 READ_WRITE /end MEASUREMENT
/begin MEASUREMENT IN_DigitalInputs.IN_DIG_35.Task3 "" UBYTE IS_BOOLEAN_TRUE 0 0 0 1 ECU_ADDRESS 0x20402C6 READ_WRITE /end MEASUREMENT
/begin MEASUREMENT IN_DigitalInputs.IN_DIG_36.Task3 "" UBYTE IS_BOOLEAN_TRUE 0 0 0 1 ECU_ADDRESS 0x20402C7 READ_WRITE /end MEASUREMENT
/begin MEASUREMENT IN_DigitalInputs.IN_DIG_37.Task3 "" UBYTE IS_BOOLEAN_TRUE 0 0 0 1 ECU_ADDRESS 0x20402C8 READ_WRITE /end MEASUREMENT
/begin MEASUREMENT IN_DigitalInputs.IN_DIG_38.Task3 "" UBYTE IS_BOOLEAN_TRUE 0 0 0 1 ECU_ADDRESS 0x20402C9 READ_WRITE /end MEASUREMENT
/begin MEASUREMENT IN_DigitalInputs.IN_DIG_39.Task3 "" UBYTE IS_BOOLEAN_TRUE 0 0 0 1 ECU_ADDRESS 0x20402CA READ_WRITE /end MEASUREMENT
/begin MEASUREMENT IN_DigitalInputs.IN_DIG_40.Task3 "" UBYTE IS_BOOLEAN_TRUE 0 0 0 1 ECU_ADDRESS 0x20402CB READ_WRITE /end MEASUREMENT
/begin MEASUREMENT IN_DigitalInputs.IN_DIG_41.Task3 "" UBYTE IS_BOOLEAN_TRUE 0 0 0 1 ECU_ADDRESS 0x20402CC READ_WRITE /end MEASUREMENT
/begin MEASUREMENT IN_DigitalInputs.IN_DIG_42.Task3 "" UBYTE IS_BOOLEAN_TRUE 0 0 0 1 ECU_ADDRESS 0x20402CD READ_WRITE /end MEASUREMENT
/begin MEASUREMENT IN_DigitalInputs.IN_DIG_43.Task3 "" UBYTE IS_BOOLEAN_TRUE 0 0 0 1 ECU_ADDRESS 0x20402CE READ_WRITE /end MEASUREMENT
/begin MEASUREMENT IN_DigitalInputs.IN_DIG_44.Task3 "" UBYTE IS_BOOLEAN_TRUE 0 0 0 1 ECU_ADDRESS 0x20402CF READ_WRITE /end MEASUREMENT
/begin MEASUREMENT IN_DigitalInputs.IN_DIG_45.Task3 "" UBYTE IS_BOOLEAN_TRUE 0 0 0 1 ECU_ADDRESS 0x20402D0 READ_WRITE /end MEASUREMENT
/begin MEASUREMENT IN_DigitalInputs.IN_DIG_46.Task3 "" UBYTE IS_BOOLEAN_TRUE 0 0 0 1 ECU_ADDRESS 0x20402D1 READ_WRITE /end MEASUREMENT
/begin MEASUREMENT IN_DigitalInputs.IN_DIG_48.Task3 "" UBYTE IS_BOOLEAN_TRUE 0 0 0 1 ECU_ADDRESS 0x20402D2 READ_WRITE /end MEASUREMENT
/begin MEASUREMENT IN_DigitalInputs.IN_DIG_49.Task3 "" UBYTE IS_BOOLEAN_TRUE 0 0 0 1 ECU_ADDRESS 0x20402D3 READ_WRITE /end MEASUREMENT
/begin MEASUREMENT IN_DigitalInputs.IN_DIG_50.Task3 "" UBYTE IS_BOOLEAN_TRUE 0 0 0 1 ECU_ADDRESS 0x20402D4 READ_WRITE /end MEASUREMENT
/begin MEASUREMENT IN_DigitalInputs.IN_DIG_36.Task5 "" UBYTE IS_BOOLEAN_TRUE 0 0 0 1 ECU_ADDRESS 0x2040200 READ_WRITE /end MEASUREMENT
/begin MEASUREMENT DIAG_DigitalInputs.IN_DIG_01_DIAG.Task3 "Diagnosis Input" UWORD COMP_DEFAULT 0 0 0 65535 ECU_ADDRESS 0x2040062 READ_WRITE /end MEASUREMENT
/begin MEASUREMENT DIAG_DigitalInputs.IN_DIG_02_DIAG.Task3 "Diagnosis Input" UWORD COMP_DEFAULT 0 0 0 65535 ECU_ADDRESS 0x2040064 READ_WRITE /end MEASUREMENT
/begin MEASUREMENT DIAG_DigitalInputs.IN_DIG_03_DIAG.Task3 "Diagnosis Input" UWORD COMP_DEFAULT 0 0 0 65535 ECU_ADDRESS 0x2040066 READ_WRITE /end MEASUREMENT
/begin MEASUREMENT DIAG_DigitalInputs.IN_DIG_04_DIAG.Task3 "Diagnosis Input" UWORD COMP_DEFAULT 0 0 0 65535 ECU_ADDRESS 0x2040068 READ_WRITE /end MEASUREMENT
/begin MEASUREMENT DIAG_DigitalInputs.IN_DIG_05_DIAG.Task3 "Diagnosis Input" UWORD COMP_DEFAULT 0 0 0 65535 ECU_ADDRESS 0x204006A READ_WRITE /end MEASUREMENT
/begin MEASUREMENT DIAG_DigitalInputs.IN_DIG_06_DIAG.Task3 "Diagnosis Input" UWORD COMP_DEFAULT 0 0 0 65535 ECU_ADDRESS 0x204006C READ_WRITE /end MEASUREMENT
/begin MEASUREMENT DIAG_DigitalInputs.IN_DIG_07_DIAG.Task3 "Diagnostic Input" UWORD COMP_DEFAULT 0 0 0 65535 ECU_ADDRESS 0x204006E READ_WRITE /end MEASUREMENT
/begin MEASUREMENT DIAG_DigitalInputs.IN_DIG_08_DIAG.Task3 "Diagnostic Input" UWORD COMP_DEFAULT 0 0 0 65535 ECU_ADDRESS 0x2040070 READ_WRITE /end MEASUREMENT
/begin MEASUREMENT DIAG_DigitalInputs.IN_DIG_09_DIAG.Task3 "Diagnosis Input" UWORD COMP_DEFAULT 0 0 0 65535 ECU_ADDRESS 0x2040072 READ_WRITE /end MEASUREMENT
/begin MEASUREMENT DIAG_DigitalInputs.IN_DIG_10_DIAG.Task3 "Diagnosis Input" UWORD COMP_DEFAULT 0 0 0 65535 ECU_ADDRESS 0x2040074 READ_WRITE /end MEASUREMENT
/begin MEASUREMENT DIAG_DigitalInputs.IN_DIG_11_DIAG.Task3 "Diagnosis Input" UWORD COMP_DEFAULT 0 0 0 65535 ECU_ADDRESS 0x2040076 READ_WRITE /end MEASUREMENT
/begin MEASUREMENT DIAG_DigitalInputs.IN_DIG_12_DIAG.Task3 "Diagnosis Input" UWORD COMP_DEFAULT 0 0 0 65535 ECU_ADDRESS 0x2040078 READ_WRITE /end MEASUREMENT
/begin MEASUREMENT DIAG_DigitalInputs.IN_DIG_13_DIAG.Task3 "Diagnosis Input" UWORD COMP_DEFAULT 0 0 0 65535 ECU_ADDRESS 0x204007A READ_WRITE /end MEASUREMENT
/begin MEASUREMENT DIAG_DigitalInputs.IN_DIG_14_DIAG.Task3 "Diagnosis Input" UWORD COMP_DEFAULT 0 0 0 65535 ECU_ADDRESS 0x204007C READ_WRITE /end MEASUREMENT
/begin MEASUREMENT DIAG_DigitalInputs.IN_DIG_15_DIAG.Task3 "Diagnosis Input" UWORD COMP_DEFAULT 0 0 0 65535 ECU_ADDRESS 0x204007E READ_WRITE /end MEASUREMENT
/begin MEASUREMENT DIAG_DigitalInputs.IN_DIG_16_DIAG.Task3 "Diagnosis Input" UWORD COMP_DEFAULT 0 0 0 65535 ECU_ADDRESS 0x2040080 READ_WRITE /end MEASUREMENT
/begin MEASUREMENT DIAG_DigitalInputs.IN_DIG_17_DIAG.Task3 "Diagnosis Input" UWORD COMP_DEFAULT 0 0 0 65535 ECU_ADDRESS 0x2040082 READ_WRITE /end MEASUREMENT
/begin MEASUREMENT DIAG_DigitalInputs.IN_DIG_18_DIAG.Task3 "Diagnosis Input" UWORD COMP_DEFAULT 0 0 0 65535 ECU_ADDRESS 0x2040084 READ_WRITE /end MEASUREMENT
/begin MEASUREMENT DIAG_DigitalInputs.IN_DIG_19_DIAG.Task3 "Diagnosis Input" UWORD COMP_DEFAULT 0 0 0 65535 ECU_ADDRESS 0x2040086 READ_WRITE /end MEASUREMENT
/begin MEASUREMENT DIAG_DigitalInputs.IN_DIG_20_DIAG.Task3 "Diagnosis Input" UWORD COMP_DEFAULT 0 0 0 65535 ECU_ADDRESS 0x2040088 READ_WRITE /end MEASUREMENT
/begin MEASUREMENT DIAG_DigitalInputs.IN_DIG_21_DIAG.Task3 "Diagnosis Input" UWORD COMP_DEFAULT 0 0 0 65535 ECU_ADDRESS 0x204008A READ_WRITE /end MEASUREMENT
/begin MEASUREMENT DIAG_DigitalInputs.IN_DIG_22_DIAG.Task3 "Diagnosis Input" UWORD COMP_DEFAULT 0 0 0 65535 ECU_ADDRESS 0x204008C READ_WRITE /end MEASUREMENT
/begin MEASUREMENT DIAG_DigitalInputs.IN_DIG_23_DIAG.Task3 "Diagnosis Input" UWORD COMP_DEFAULT 0 0 0 65535 ECU_ADDRESS 0x204008E READ_WRITE /end MEASUREMENT
/begin MEASUREMENT DIAG_DigitalInputs.IN_DIG_24_DIAG.Task3 "Diagnosis Input" UWORD COMP_DEFAULT 0 0 0 65535 ECU_ADDRESS 0x2040090 READ_WRITE /end MEASUREMENT
/begin MEASUREMENT DIAG_DigitalInputs.IN_DIG_25_DIAG.Task3 "Diagnosis Input" UWORD COMP_DEFAULT 0 0 0 65535 ECU_ADDRESS 0x2040092 READ_WRITE /end MEASUREMENT
/begin MEASUREMENT DIAG_DigitalInputs.IN_DIG_26_DIAG.Task3 "Diagnosis Input" UWORD COMP_DEFAULT 0 0 0 65535 ECU_ADDRESS 0x2040094 READ_WRITE /end MEASUREMENT
/begin MEASUREMENT DIAG_DigitalInputs.IN_DIG_27_DIAG.Task3 "Diagnosis Input" UWORD COMP_DEFAULT 0 0 0 65535 ECU_ADDRESS 0x2040096 READ_WRITE /end MEASUREMENT
/begin MEASUREMENT DIAG_DigitalInputs.IN_DIG_28_DIAG.Task3 "Diagnosis Input" UWORD COMP_DEFAULT 0 0 0 65535 ECU_ADDRESS 0x2040098 READ_WRITE /end MEASUREMENT
/begin MEASUREMENT DIAG_DigitalInputs.IN_DIG_29_DIAG.Task3 "Diagnosis Input" UWORD COMP_DEFAULT 0 0 0 65535 ECU_ADDRESS 0x204009A READ_WRITE /end MEASUREMENT
/begin MEASUREMENT DIAG_DigitalInputs.IN_DIG_30_DIAG.Task3 "Diagnosis Input" UWORD COMP_DEFAULT 0 0 0 65535 ECU_ADDRESS 0x204009C READ_WRITE /end MEASUREMENT
/begin MEASUREMENT DIAG_DigitalInputs.IN_DIG_31_DIAG.Task3 "Diagnosis Input" UWORD COMP_DEFAULT 0 0 0 65535 ECU_ADDRESS 0x204009E READ_WRITE /end MEASUREMENT
/begin MEASUREMENT DIAG_DigitalInputs.IN_DIG_32_DIAG.Task3 "Diagnosis Input" UWORD COMP_DEFAULT 0 0 0 65535 ECU_ADDRESS 0x20400A0 READ_WRITE /end MEASUREMENT
/begin MEASUREMENT DIAG_DigitalInputs.IN_DIG_33_DIAG.Task3 "Diagnosis Input" UWORD COMP_DEFAULT 0 0 0 65535 ECU_ADDRESS 0x20400A2 READ_WRITE /end MEASUREMENT
/begin MEASUREMENT DIAG_DigitalInputs.IN_DIG_34_DIAG.Task3 "Diagnosis Input" UWORD COMP_DEFAULT 0 0 0 65535 ECU_ADDRESS 0x20400A4 READ_WRITE /end MEASUREMENT
/begin MEASUREMENT DIAG_DigitalInputs.IN_DIG_35_DIAG.Task3 "Diagnosis Input" UWORD COMP_DEFAULT 0 0 0 65535 ECU_ADDRESS 0x20400A6 READ_WRITE /end MEASUREMENT
/begin MEASUREMENT DIAG_DigitalInputs.IN_DIG_36_DIAG.Task3 "Diagnosis Input" UWORD COMP_DEFAULT 0 0 0 65535 ECU_ADDRESS 0x20400A8 READ_WRITE /end MEASUREMENT
/begin MEASUREMENT DIAG_DigitalInputs.IN_DIG_37_DIAG.Task3 "Diagnosis Input" UWORD COMP_DEFAULT 0 0 0 65535 ECU_ADDRESS 0x20400AA READ_WRITE /end MEASUREMENT
/begin MEASUREMENT DIAG_DigitalInputs.IN_DIG_38_DIAG.Task3 "Diagnosis Input" UWORD COMP_DEFAULT 0 0 0 65535 ECU_ADDRESS 0x20400AC READ_WRITE /end MEASUREMENT
/begin MEASUREMENT DIAG_DigitalInputs.IN_DIG_39_DIAG.Task3 "Diagnosis Input" UWORD COMP_DEFAULT 0 0 0 65535 ECU_ADDRESS 0x20400AE READ_WRITE /end MEASUREMENT
/begin MEASUREMENT DIAG_DigitalInputs.IN_DIG_40_DIAG.Task3 "Diagnosis Input" UWORD COMP_DEFAULT 0 0 0 65535 ECU_ADDRESS 0x20400B0 READ_WRITE /end MEASUREMENT
/begin MEASUREMENT DIAG_DigitalInputs.IN_DIG_41_DIAG.Task3 "Diagnosis Input" UWORD COMP_DEFAULT 0 0 0 65535 ECU_ADDRESS 0x20400B2 READ_WRITE /end MEASUREMENT
/begin MEASUREMENT DIAG_DigitalInputs.IN_DIG_42_DIAG.Task3 "Diagnosis Input" UWORD COMP_DEFAULT 0 0 0 65535 ECU_ADDRESS 0x20400B4 READ_WRITE /end MEASUREMENT
/begin MEASUREMENT DIAG_DigitalInputs.IN_DIG_43_DIAG.Task3 "Diagnosis Input" UWORD COMP_DEFAULT 0 0 0 65535 ECU_ADDRESS 0x20400B6 READ_WRITE /end MEASUREMENT
/begin MEASUREMENT DIAG_DigitalInputs.IN_DIG_44_DIAG.Task3 "Diagnosis Input" UWORD COMP_DEFAULT 0 0 0 65535 ECU_ADDRESS 0x20400B8 READ_WRITE /end MEASUREMENT
/begin MEASUREMENT DIAG_DigitalInputs.IN_DIG_45_DIAG.Task3 "Diagnosis Input" UWORD COMP_DEFAULT 0 0 0 65535 ECU_ADDRESS 0x20400BA READ_WRITE /end MEASUREMENT
/begin MEASUREMENT DIAG_DigitalInputs.IN_DIG_46_DIAG.Task3 "Diagnosis Input" UWORD COMP_DEFAULT 0 0 0 65535 ECU_ADDRESS 0x20400BC READ_WRITE /end MEASUREMENT
/begin MEASUREMENT DIAG_DigitalInputs.IN_DIG_48_DIAG.Task3 "Diagnosis Input" UWORD COMP_DEFAULT 0 0 0 65535 ECU_ADDRESS 0x20400BE READ_WRITE /end MEASUREMENT
/begin MEASUREMENT DIAG_DigitalInputs.IN_DIG_49_DIAG.Task3 "Diagnosis Input" UWORD COMP_DEFAULT 0 0 0 65535 ECU_ADDRESS 0x20400C0 READ_WRITE /end MEASUREMENT
/begin MEASUREMENT DIAG_DigitalInputs.IN_DIG_50_DIAG.Task3 "Diagnosis Input" UWORD COMP_DEFAULT 0 0 0 65535 ECU_ADDRESS 0x20400C2 READ_WRITE /end MEASUREMENT
/begin MEASUREMENT IN_DigitalOutputsSTATIC.OUT_01_SENSE.Task3 "" UWORD COMP_DEFAULT 0 0 0 65535 ECU_ADDRESS 0x20402D6 READ_WRITE /end MEASUREMENT
/begin MEASUREMENT IN_DigitalOutputsSTATIC.OUT_01_SENSE_PULSE.Task3 "" UWORD COMP_DEFAULT 0 0 0 65535 ECU_ADDRESS 0x20402D8 READ_WRITE /end MEASUREMENT
/begin MEASUREMENT IN_DigitalOutputsSTATIC.OUT_02_SENSE.Task3 "" UWORD COMP_DEFAULT 0 0 0 65535 ECU_ADDRESS 0x20402DA READ_WRITE /end MEASUREMENT
/begin MEASUREMENT IN_DigitalOutputsSTATIC.OUT_03_SENSE.Task3 "" UWORD COMP_DEFAULT 0 0 0 65535 ECU_ADDRESS 0x20402DC READ_WRITE /end MEASUREMENT
/begin MEASUREMENT IN_DigitalOutputsSTATIC.OUT_04_SENSE.Task3 "" UWORD COMP_DEFAULT 0 0 0 65535 ECU_ADDRESS 0x20402DE READ_WRITE /end MEASUREMENT
/begin MEASUREMENT IN_DigitalOutputsSTATIC.OUT_04_SENSE_PULSE.Task3 "" UWORD COMP_DEFAULT 0 0 0 65535 ECU_ADDRESS 0x20402E0 READ_WRITE /end MEASUREMENT
/begin MEASUREMENT IN_DigitalOutputsSTATIC.OUT_05_SENSE.Task3 "" UWORD COMP_DEFAULT 0 0 0 65535 ECU_ADDRESS 0x20402E2 READ_WRITE /end MEASUREMENT
/begin MEASUREMENT IN_DigitalOutputsSTATIC.OUT_06_SENSE.Task3 "" UWORD COMP_DEFAULT 0 0 0 65535 ECU_ADDRESS 0x20402E4 READ_WRITE /end MEASUREMENT
/begin MEASUREMENT IN_DigitalOutputsSTATIC.OUT_06_SENSE_PULSE.Task3 "" UWORD COMP_DEFAULT 0 0 0 65535 ECU_ADDRESS 0x20402E6 READ_WRITE /end MEASUREMENT
/begin MEASUREMENT IN_DigitalOutputsSTATIC.OUT_07_SENSE.Task3 "" UWORD COMP_DEFAULT 0 0 0 65535 ECU_ADDRESS 0x20402E8 READ_WRITE /end MEASUREMENT
/begin MEASUREMENT IN_DigitalOutputsSTATIC.OUT_07_SENSE_PULSE.Task3 "" UWORD COMP_DEFAULT 0 0 0 65535 ECU_ADDRESS 0x20402EA READ_WRITE /end MEASUREMENT
/begin MEASUREMENT IN_DigitalOutputsSTATIC.OUT_08_SENSE.Task3 "" UWORD COMP_DEFAULT 0 0 0 65535 ECU_ADDRESS 0x20402EC READ_WRITE /end MEASUREMENT
/begin MEASUREMENT IN_DigitalOutputsSTATIC.OUT_08_SENSE_PULSE.Task3 "" UWORD COMP_DEFAULT 0 0 0 65535 ECU_ADDRESS 0x20402EE READ_WRITE /end MEASUREMENT
/begin MEASUREMENT IN_DigitalOutputsSTATIC.OUT_09_SENSE.Task3 "" UWORD COMP_DEFAULT 0 0 0 65535 ECU_ADDRESS 0x20402F0 READ_WRITE /end MEASUREMENT
/begin MEASUREMENT IN_DigitalOutputsSTATIC.OUT_10_SENSE.Task3 "" UWORD COMP_DEFAULT 0 0 0 65535 ECU_ADDRESS 0x20402F2 READ_WRITE /end MEASUREMENT
/begin MEASUREMENT IN_DigitalOutputsSTATIC.OUT_11_SENSE.Task3 "" UWORD COMP_DEFAULT 0 0 0 65535 ECU_ADDRESS 0x20402F4 READ_WRITE /end MEASUREMENT
/begin MEASUREMENT IN_DigitalOutputsSTATIC.OUT_12_SENSE.Task3 "" UWORD COMP_DEFAULT 0 0 0 65535 ECU_ADDRESS 0x20402F6 READ_WRITE /end MEASUREMENT
/begin MEASUREMENT IN_DigitalOutputsSTATIC.OUT_12_SENSE_PULSE.Task3 "" UWORD COMP_DEFAULT 0 0 0 65535 ECU_ADDRESS 0x20402F8 READ_WRITE /end MEASUREMENT
/begin MEASUREMENT IN_DigitalOutputsSTATIC.OUT_13_SENSE.Task3 "" UWORD COMP_DEFAULT 0 0 0 65535 ECU_ADDRESS 0x20402FA READ_WRITE /end MEASUREMENT
/begin MEASUREMENT IN_DigitalOutputsSTATIC.OUT_13_SENSE_PULSE.Task3 "" UWORD COMP_DEFAULT 0 0 0 65535 ECU_ADDRESS 0x20402FC READ_WRITE /end MEASUREMENT
/begin MEASUREMENT IN_DigitalOutputsSTATIC.OUT_14_SENSE.Task3 "" UWORD COMP_DEFAULT 0 0 0 65535 ECU_ADDRESS 0x20402FE READ_WRITE /end MEASUREMENT
/begin MEASUREMENT IN_DigitalOutputsSTATIC.OUT_14_SENSE_PULSE.Task3 "" UWORD COMP_DEFAULT 0 0 0 65535 ECU_ADDRESS 0x2040300 READ_WRITE /end MEASUREMENT
/begin MEASUREMENT IN_DigitalOutputsSTATIC.OUT_15_SENSE.Task3 "" UWORD COMP_DEFAULT 0 0 0 65535 ECU_ADDRESS 0x2040302 READ_WRITE /end MEASUREMENT
/begin MEASUREMENT IN_DigitalOutputsSTATIC.OUT_15_SENSE_PULSE.Task3 "" UWORD COMP_DEFAULT 0 0 0 65535 ECU_ADDRESS 0x2040304 READ_WRITE /end MEASUREMENT
/begin MEASUREMENT IN_DigitalOutputsSTATIC.OUT_16_SENSE.Task3 "" UWORD COMP_DEFAULT 0 0 0 65535 ECU_ADDRESS 0x2040306 READ_WRITE /end MEASUREMENT
/begin MEASUREMENT IN_DigitalOutputsSTATIC.OUT_17_SENSE.Task3 "" UWORD COMP_DEFAULT 0 0 0 65535 ECU_ADDRESS 0x2040308 READ_WRITE /end MEASUREMENT
/begin MEASUREMENT IN_DigitalOutputsSTATIC.OUT_19_SENSE.Task3 "" UWORD COMP_DEFAULT 0 0 0 65535 ECU_ADDRESS 0x204030A READ_WRITE /end MEASUREMENT
/begin MEASUREMENT IN_DigitalOutputsSTATIC.OUT_01_TD.Task3 "PWR_HSS_SENSE_04, ISO, LM, TD" UBYTE IS_BOOLEAN_TRUE 0 0 0 1 ECU_ADDRESS 0x204030C READ_WRITE /end MEASUREMENT
/begin MEASUREMENT IN_DigitalOutputsSTATIC.OUT_04_TD.Task3 "PWR_HSS_SENSE_04, ISO, LM, TD" UBYTE IS_BOOLEAN_TRUE 0 0 0 1 ECU_ADDRESS 0x204030D READ_WRITE /end MEASUREMENT
/begin MEASUREMENT IN_DigitalOutputsSTATIC.OUT_06_TD.Task3 "PWR_HSS_SENSE_04, ISO, LM, TD" UBYTE IS_BOOLEAN_TRUE 0 0 0 1 ECU_ADDRESS 0x204030E READ_WRITE /end MEASUREMENT
/begin MEASUREMENT IN_DigitalOutputsSTATIC.OUT_07_TD.Task3 "PWR_HSS_SENSE_04, ISO, LM, TD" UBYTE IS_BOOLEAN_TRUE 0 0 0 1 ECU_ADDRESS 0x204030F READ_WRITE /end MEASUREMENT
/begin MEASUREMENT IN_DigitalOutputsSTATIC.OUT_08_TD.Task3 "PWR_HSS_SENSE_04, ISO, LM, TD" UBYTE IS_BOOLEAN_TRUE 0 0 0 1 ECU_ADDRESS 0x2040310 READ_WRITE /end MEASUREMENT
/begin MEASUREMENT IN_DigitalOutputsSTATIC.OUT_12_TD.Task3 "PWR_HSS_SENSE_04, ISO, LM, TD" UBYTE IS_BOOLEAN_TRUE 0 0 0 1 ECU_ADDRESS 0x2040311 READ_WRITE /end MEASUREMENT
/begin MEASUREMENT IN_DigitalOutputsSTATIC.OUT_13_TD.Task3 "PWR_HSS_SENSE_04, ISO, LM, TD" UBYTE IS_BOOLEAN_TRUE 0 0 0 1 ECU_ADDRESS 0x2040312 READ_WRITE /end MEASUREMENT
/begin MEASUREMENT IN_DigitalOutputsSTATIC.OUT_14_TD.Task3 "PWR_HSS_SENSE_04, ISO, LM, TD" UBYTE IS_BOOLEAN_TRUE 0 0 0 1 ECU_ADDRESS 0x2040313 READ_WRITE /end MEASUREMENT
/begin MEASUREMENT IN_DigitalOutputsSTATIC.OUT_15_TD.Task3 "PWR_HSS_SENSE_04, ISO, LM, TD" UBYTE IS_BOOLEAN_TRUE 0 0 0 1 ECU_ADDRESS 0x2040314 READ_WRITE /end MEASUREMENT
/begin MEASUREMENT OUT_DigitalOutputsSTATIC.IN_ANA_08_SWT1.Task3 "IN_ANA_08_SEL function selection switch" UBYTE IS_BOOLEAN_TRUE 0 0 0 1 ECU_ADDRESS 0x204A000 READ_WRITE /end MEASUREMENT
/begin MEASUREMENT OUT_DigitalOutputsSTATIC.IN_ANA_09_SWT1.Task3 "IN_ANA_08_SEL function selection switch" UBYTE IS_BOOLEAN_TRUE 0 0 0 1 ECU_ADDRESS 0x204A001 READ_WRITE /end MEASUREMENT
/begin MEASUREMENT OUT_DigitalOutputsSTATIC.IN_ANA_10_SWT1.Task3 "IN_ANA_08_SEL function selection switch" UBYTE IS_BOOLEAN_TRUE 0 0 0 1 ECU_ADDRESS 0x204A002 READ_WRITE /end MEASUREMENT
/begin MEASUREMENT OUT_DigitalOutputsSTATIC.IN_ANA_11_SWT1.Task3 "IN_ANA_08_SEL function selection switch" UBYTE IS_BOOLEAN_TRUE 0 0 0 1 ECU_ADDRESS 0x204A003 READ_WRITE /end MEASUREMENT
/begin MEASUREMENT OUT_DigitalOutputsSTATIC.OUT_01.Task3 "PWR_HSS_SENSE_04, ISO, TD" UBYTE IS_BOOLEAN_TRUE 0 0 0 1 ECU_ADDRESS 0x204A004 READ_WRITE /end MEASUREMENT
/begin MEASUREMENT OUT_DigitalOutputsSTATIC.OUT_01_TD_START.Task3 "TD" UBYTE IS_BOOLEAN_TRUE 0 0 0 1 ECU_ADDRESS 0x204A005 READ_WRITE /end MEASUREMENT
/begin MEASUREMENT OUT_DigitalOutputsSTATIC.OUT_02.Task3 "PWR_HSS_SENSE_04" UBYTE IS_BOOLEAN_TRUE 0 0 0 1 ECU_ADDRESS 0x204A006 READ_WRITE /end MEASUREMENT
/begin MEASUREMENT OUT_DigitalOutputsSTATIC.OUT_03.Task3 "PWR_HSS_SENSE_04" UBYTE IS_BOOLEAN_TRUE 0 0 0 1 ECU_ADDRESS 0x204A007 READ_WRITE /end MEASUREMENT
/begin MEASUREMENT OUT_DigitalOutputsSTATIC.OUT_04.Task3 "PWR_HSS_SENSE_04, ISO, TD" UBYTE IS_BOOLEAN_TRUE 0 0 0 1 ECU_ADDRESS 0x204A008 READ_WRITE /end MEASUREMENT
/begin MEASUREMENT OUT_DigitalOutputsSTATIC.OUT_04_TD_START.Task3 "TD" UBYTE IS_BOOLEAN_TRUE 0 0 0 1 ECU_ADDRESS 0x204A009 READ_WRITE /end MEASUREMENT
/begin MEASUREMENT OUT_DigitalOutputsSTATIC.OUT_05.Task3 "PWR_HSS_SENSE_04" UBYTE IS_BOOLEAN_TRUE 0 0 0 1 ECU_ADDRESS 0x204A00A READ_WRITE /end MEASUREMENT
/begin MEASUREMENT OUT_DigitalOutputsSTATIC.OUT_06.Task3 "PWR_HSS_SENSE_04, ISO, TD" UBYTE IS_BOOLEAN_TRUE 0 0 0 1 ECU_ADDRESS 0x204A00B READ_WRITE /end MEASUREMENT
/begin MEASUREMENT OUT_DigitalOutputsSTATIC.OUT_06_TD_START.Task3 "TD" UBYTE IS_BOOLEAN_TRUE 0 0 0 1 ECU_ADDRESS 0x204A00C READ_WRITE /end MEASUREMENT
/begin MEASUREMENT OUT_DigitalOutputsSTATIC.OUT_07.Task3 "PWR_HSS_SENSE_04, ISO, TD" UBYTE IS_BOOLEAN_TRUE 0 0 0 1 ECU_ADDRESS 0x204A00D READ_WRITE /end MEASUREMENT
/begin MEASUREMENT OUT_DigitalOutputsSTATIC.OUT_07_TD_START.Task3 "TD" UBYTE IS_BOOLEAN_TRUE 0 0 0 1 ECU_ADDRESS 0x204A00E READ_WRITE /end MEASUREMENT
/begin MEASUREMENT OUT_DigitalOutputsSTATIC.OUT_08.Task3 "PWR_HSS_SENSE_04, ISO, TD" UBYTE IS_BOOLEAN_TRUE 0 0 0 1 ECU_ADDRESS 0x204A00F READ_WRITE /end MEASUREMENT
/begin MEASUREMENT OUT_DigitalOutputsSTATIC.OUT_08_TD_START.Task3 "TD" UBYTE IS_BOOLEAN_TRUE 0 0 0 1 ECU_ADDRESS 0x204A010 READ_WRITE /end MEASUREMENT
/begin MEASUREMENT OUT_DigitalOutputsSTATIC.OUT_09.Task3 "PWR_HSS_SENSE_04" UBYTE IS_BOOLEAN_TRUE 0 0 0 1 ECU_ADDRESS 0x204A011 READ_WRITE /end MEASUREMENT
/begin MEASUREMENT OUT_DigitalOutputsSTATIC.OUT_10.Task3 "PWR_HSS_SENSE_04" UBYTE IS_BOOLEAN_TRUE 0 0 0 1 ECU_ADDRESS 0x204A012 READ_WRITE /end MEASUREMENT
/begin MEASUREMENT OUT_DigitalOutputsSTATIC.OUT_11.Task3 "PWR_HSS_SENSE_04" UBYTE IS_BOOLEAN_TRUE 0 0 0 1 ECU_ADDRESS 0x204A013 READ_WRITE /end MEASUREMENT
/begin MEASUREMENT OUT_DigitalOutputsSTATIC.OUT_12.Task3 "PWR_HSS_SENSE_04, ISO, TD" UBYTE IS_BOOLEAN_TRUE 0 0 0 1 ECU_ADDRESS 0x204A014 READ_WRITE /end MEASUREMENT
/begin MEASUREMENT OUT_DigitalOutputsSTATIC.OUT_12_TD_START.Task3 "TD" UBYTE IS_BOOLEAN_TRUE 0 0 0 1 ECU_ADDRESS 0x204A015 READ_WRITE /end MEASUREMENT
/begin MEASUREMENT OUT_DigitalOutputsSTATIC.OUT_13.Task3 "PWR_HSS_SENSE_04, ISO, TD" UBYTE IS_BOOLEAN_TRUE 0 0 0 1 ECU_ADDRESS 0x204A016 READ_WRITE /end MEASUREMENT
/begin MEASUREMENT OUT_DigitalOutputsSTATIC.OUT_13_TD_START.Task3 "TD" UBYTE IS_BOOLEAN_TRUE 0 0 0 1 ECU_ADDRESS 0x204A017 READ_WRITE /end MEASUREMENT
/begin MEASUREMENT OUT_DigitalOutputsSTATIC.OUT_14.Task3 "PWR_HSS_SENSE_04, ISO, TD" UBYTE IS_BOOLEAN_TRUE 0 0 0 1 ECU_ADDRESS 0x204A018 READ_WRITE /end MEASUREMENT
/begin MEASUREMENT OUT_DigitalOutputsSTATIC.OUT_14_TD_START.Task3 "TD" UBYTE IS_BOOLEAN_TRUE 0 0 0 1 ECU_ADDRESS 0x204A019 READ_WRITE /end MEASUREMENT
/begin MEASUREMENT OUT_DigitalOutputsSTATIC.OUT_15.Task3 "PWR_HSS_SENSE_04, ISO, TD" UBYTE IS_BOOLEAN_TRUE 0 0 0 1 ECU_ADDRESS 0x204A01A READ_WRITE /end MEASUREMENT
/begin MEASUREMENT OUT_DigitalOutputsSTATIC.OUT_15_TD_START.Task3 "TD" UBYTE IS_BOOLEAN_TRUE 0 0 0 1 ECU_ADDRESS 0x204A01B READ_WRITE /end MEASUREMENT
/begin MEASUREMENT OUT_DigitalOutputsSTATIC.OUT_16.Task3 "PWR_HSS_SENSE_04" UBYTE IS_BOOLEAN_TRUE 0 0 0 1 ECU_ADDRESS 0x204A01C READ_WRITE /end MEASUREMENT
/begin MEASUREMENT OUT_DigitalOutputsSTATIC.OUT_17.Task3 "PWR_HSS_SENSE_04" UBYTE IS_BOOLEAN_TRUE 0 0 0 1 ECU_ADDRESS 0x204A01D READ_WRITE /end MEASUREMENT
/begin MEASUREMENT OUT_DigitalOutputsSTATIC.OUT_19.Task3 "PWR_HSS_SENSE_04" UBYTE IS_BOOLEAN_TRUE 0 0 0 1 ECU_ADDRESS 0x204A01E READ_WRITE /end MEASUREMENT
/begin MEASUREMENT OUT_DigitalOutputsSTATIC.OUT_SUP_ANA_01.Task3 "" UBYTE IS_BOOLEAN_TRUE 0 0 0 1 ECU_ADDRESS 0x204A01F READ_WRITE /end MEASUREMENT
/begin MEASUREMENT OUT_DigitalOutputsSTATIC.OUT_SUP_ANA_02.Task3 "" UBYTE IS_BOOLEAN_TRUE 0 0 0 1 ECU_ADDRESS 0x204A020 READ_WRITE /end MEASUREMENT
/begin MEASUREMENT OUT_DigitalOutputsSTATIC.OUT_SUP_ANA_03.Task3 "" UBYTE IS_BOOLEAN_TRUE 0 0 0 1 ECU_ADDRESS 0x204A021 READ_WRITE /end MEASUREMENT
/begin MEASUREMENT DIAG_DigitalOutputsSTATIC.OUT_01_DIAG.Task3 "Diagnosis Input" UWORD COMP_DEFAULT 0 0 0 65535 ECU_ADDRESS 0x20400C4 READ_WRITE /end MEASUREMENT
/begin MEASUREMENT DIAG_DigitalOutputsSTATIC.OUT_01_SENSE_PULSE_DIAG.Task3 "Diagnostic Input" UWORD COMP_DEFAULT 0 0 0 65535 ECU_ADDRESS 0x20400C6 READ_WRITE /end MEASUREMENT
/begin MEASUREMENT DIAG_DigitalOutputsSTATIC.OUT_01_TD_DIAG.Task3 "Diagnostic Input" UWORD COMP_DEFAULT 0 0 0 65535 ECU_ADDRESS 0x20400C8 READ_WRITE /end MEASUREMENT
/begin MEASUREMENT DIAG_DigitalOutputsSTATIC.OUT_02_DIAG.Task3 "Diagnosis Input" UWORD COMP_DEFAULT 0 0 0 65535 ECU_ADDRESS 0x20400CA READ_WRITE /end MEASUREMENT
/begin MEASUREMENT DIAG_DigitalOutputsSTATIC.OUT_03_DIAG.Task3 "Diagnosis Input" UWORD COMP_DEFAULT 0 0 0 65535 ECU_ADDRESS 0x20400CC READ_WRITE /end MEASUREMENT
/begin MEASUREMENT DIAG_DigitalOutputsSTATIC.OUT_04_DIAG.Task3 "Diagnosis Input" UWORD COMP_DEFAULT 0 0 0 65535 ECU_ADDRESS 0x20400CE READ_WRITE /end MEASUREMENT
/begin MEASUREMENT DIAG_DigitalOutputsSTATIC.OUT_04_SENSE_PULSE_DIAG.Task3 "Diagnostic Input" UWORD COMP_DEFAULT 0 0 0 65535 ECU_ADDRESS 0x20400D0 READ_WRITE /end MEASUREMENT
/begin MEASUREMENT DIAG_DigitalOutputsSTATIC.OUT_04_TD_DIAG.Task3 "Diagnosis Input" UWORD COMP_DEFAULT 0 0 0 65535 ECU_ADDRESS 0x20400D2 READ_WRITE /end MEASUREMENT
/begin MEASUREMENT DIAG_DigitalOutputsSTATIC.OUT_05_DIAG.Task3 "Diagnosis Input" UWORD COMP_DEFAULT 0 0 0 65535 ECU_ADDRESS 0x20400D4 READ_WRITE /end MEASUREMENT
/begin MEASUREMENT DIAG_DigitalOutputsSTATIC.OUT_06_DIAG.Task3 "Diagnosis Input" UWORD COMP_DEFAULT 0 0 0 65535 ECU_ADDRESS 0x20400D6 READ_WRITE /end MEASUREMENT
/begin MEASUREMENT DIAG_DigitalOutputsSTATIC.OUT_06_SENSE_PULSE_DIAG.Task3 "Diagnostic Input" UWORD COMP_DEFAULT 0 0 0 65535 ECU_ADDRESS 0x20400D8 READ_WRITE /end MEASUREMENT
/begin MEASUREMENT DIAG_DigitalOutputsSTATIC.OUT_06_TD_DIAG.Task3 "Diagnosis Input" UWORD COMP_DEFAULT 0 0 0 65535 ECU_ADDRESS 0x20400DA READ_WRITE /end MEASUREMENT
/begin MEASUREMENT DIAG_DigitalOutputsSTATIC.OUT_07_DIAG.Task3 "Diagnosis Input" UWORD COMP_DEFAULT 0 0 0 65535 ECU_ADDRESS 0x20400DC READ_WRITE /end MEASUREMENT
/begin MEASUREMENT DIAG_DigitalOutputsSTATIC.OUT_07_SENSE_PULSE_DIAG.Task3 "Diagnostic Input" UWORD COMP_DEFAULT 0 0 0 65535 ECU_ADDRESS 0x20400DE READ_WRITE /end MEASUREMENT
/begin MEASUREMENT DIAG_DigitalOutputsSTATIC.OUT_07_TD_DIAG.Task3 "Diagnosis Input" UWORD COMP_DEFAULT 0 0 0 65535 ECU_ADDRESS 0x20400E0 READ_WRITE /end MEASUREMENT
/begin MEASUREMENT DIAG_DigitalOutputsSTATIC.OUT_08_DIAG.Task3 "Diagnosis Input" UWORD COMP_DEFAULT 0 0 0 65535 ECU_ADDRESS 0x20400E2 READ_WRITE /end MEASUREMENT
/begin MEASUREMENT DIAG_DigitalOutputsSTATIC.OUT_08_SENSE_PULSE_DIAG.Task3 "Diagnostic Input" UWORD COMP_DEFAULT 0 0 0 65535 ECU_ADDRESS 0x20400E4 READ_WRITE /end MEASUREMENT
/begin MEASUREMENT DIAG_DigitalOutputsSTATIC.OUT_08_TD_DIAG.Task3 "Diagnosis Input" UWORD COMP_DEFAULT 0 0 0 65535 ECU_ADDRESS 0x20400E6 READ_WRITE /end MEASUREMENT
/begin MEASUREMENT DIAG_DigitalOutputsSTATIC.OUT_09_DIAG.Task3 "Diagnostic Input" UWORD COMP_DEFAULT 0 0 0 65535 ECU_ADDRESS 0x20400E8 READ_WRITE /end MEASUREMENT
/begin MEASUREMENT DIAG_DigitalOutputsSTATIC.OUT_10_DIAG.Task3 "Diagnosis Input" UWORD COMP_DEFAULT 0 0 0 65535 ECU_ADDRESS 0x20400EA READ_WRITE /end MEASUREMENT
/begin MEASUREMENT DIAG_DigitalOutputsSTATIC.OUT_11_DIAG.Task3 "Diagnosis Input" UWORD COMP_DEFAULT 0 0 0 65535 ECU_ADDRESS 0x20400EC READ_WRITE /end MEASUREMENT
/begin MEASUREMENT DIAG_DigitalOutputsSTATIC.OUT_12_DIAG.Task3 "Diagnosis Input" UWORD COMP_DEFAULT 0 0 0 65535 ECU_ADDRESS 0x20400EE READ_WRITE /end MEASUREMENT
/begin MEASUREMENT DIAG_DigitalOutputsSTATIC.OUT_12_SENSE_PULSE_DIAG.Task3 "Diagnostic Input" UWORD COMP_DEFAULT 0 0 0 65535 ECU_ADDRESS 0x20400F0 READ_WRITE /end MEASUREMENT
/begin MEASUREMENT DIAG_DigitalOutputsSTATIC.OUT_12_TD_DIAG.Task3 "Diagnosis Input" UWORD COMP_DEFAULT 0 0 0 65535 ECU_ADDRESS 0x20400F2 READ_WRITE /end MEASUREMENT
/begin MEASUREMENT DIAG_DigitalOutputsSTATIC.OUT_13_DIAG.Task3 "Diagnosis Input" UWORD COMP_DEFAULT 0 0 0 65535 ECU_ADDRESS 0x20400F4 READ_WRITE /end MEASUREMENT
/begin MEASUREMENT DIAG_DigitalOutputsSTATIC.OUT_13_SENSE_PULSE_DIAG.Task3 "Diagnostic Input" UWORD COMP_DEFAULT 0 0 0 65535 ECU_ADDRESS 0x20400F6 READ_WRITE /end MEASUREMENT
/begin MEASUREMENT DIAG_DigitalOutputsSTATIC.OUT_13_TD_DIAG.Task3 "Diagnosis Input" UWORD COMP_DEFAULT 0 0 0 65535 ECU_ADDRESS 0x20400F8 READ_WRITE /end MEASUREMENT
/begin MEASUREMENT DIAG_DigitalOutputsSTATIC.OUT_14_DIAG.Task3 "Diagnosis Input" UWORD COMP_DEFAULT 0 0 0 65535 ECU_ADDRESS 0x20400FA READ_WRITE /end MEASUREMENT
/begin MEASUREMENT DIAG_DigitalOutputsSTATIC.OUT_14_SENSE_PULSE_DIAG.Task3 "Diagnostic Input" UWORD COMP_DEFAULT 0 0 0 65535 ECU_ADDRESS 0x20400FC READ_WRITE /end MEASUREMENT
/begin MEASUREMENT DIAG_DigitalOutputsSTATIC.OUT_14_TD_DIAG.Task3 "Diagnosis Input" UWORD COMP_DEFAULT 0 0 0 65535 ECU_ADDRESS 0x20400FE READ_WRITE /end MEASUREMENT
/begin MEASUREMENT DIAG_DigitalOutputsSTATIC.OUT_15_DIAG.Task3 "Diagnosis Input" UWORD COMP_DEFAULT 0 0 0 65535 ECU_ADDRESS 0x2040100 READ_WRITE /end MEASUREMENT
/begin MEASUREMENT DIAG_DigitalOutputsSTATIC.OUT_15_SENSE_PULSE_DIAG.Task3 "Diagnostic Input" UWORD COMP_DEFAULT 0 0 0 65535 ECU_ADDRESS 0x2040102 READ_WRITE /end MEASUREMENT
/begin MEASUREMENT DIAG_DigitalOutputsSTATIC.OUT_15_TD_DIAG.Task3 "Diagnosis Input" UWORD COMP_DEFAULT 0 0 0 65535 ECU_ADDRESS 0x2040104 READ_WRITE /end MEASUREMENT
/begin MEASUREMENT DIAG_DigitalOutputsSTATIC.OUT_16_DIAG.Task3 "Diagnosis Input" UWORD COMP_DEFAULT 0 0 0 65535 ECU_ADDRESS 0x2040106 READ_WRITE /end MEASUREMENT
/begin MEASUREMENT DIAG_DigitalOutputsSTATIC.OUT_17_DIAG.Task3 "Diagnosis Input" UWORD COMP_DEFAULT 0 0 0 65535 ECU_ADDRESS 0x2040108 READ_WRITE /end MEASUREMENT
/begin MEASUREMENT DIAG_DigitalOutputsSTATIC.OUT_19_DIAG.Task3 "Diagnosis Input" UWORD COMP_DEFAULT 0 0 0 65535 ECU_ADDRESS 0x204010A READ_WRITE /end MEASUREMENT
/begin MEASUREMENT IN_DigitalOutputPWM.OUT_18_SENSE.Task3 "" UWORD COMP_DEFAULT 0 0 0 65535 ECU_ADDRESS 0x2040316 READ_WRITE /end MEASUREMENT
/begin MEASUREMENT IN_DigitalOutputPWM.OUT_20_SENSE.Task3 "" UWORD COMP_DEFAULT 0 0 0 65535 ECU_ADDRESS 0x2040318 READ_WRITE /end MEASUREMENT
/begin MEASUREMENT IN_DigitalOutputPWM.OUT_20_SENSE_PULSE.Task3 "" UWORD COMP_DEFAULT 0 0 0 65535 ECU_ADDRESS 0x204031A READ_WRITE /end MEASUREMENT
/begin MEASUREMENT IN_DigitalOutputPWM.OUT_21_SENSE.Task3 "" UWORD COMP_DEFAULT 0 0 0 65535 ECU_ADDRESS 0x204031C READ_WRITE /end MEASUREMENT
/begin MEASUREMENT IN_DigitalOutputPWM.OUT_21_SENSE_PULSE.Task3 "" UWORD COMP_DEFAULT 0 0 0 65535 ECU_ADDRESS 0x204031E READ_WRITE /end MEASUREMENT
/begin MEASUREMENT IN_DigitalOutputPWM.OUT_22_SENSE.Task3 "" UWORD COMP_DEFAULT 0 0 0 65535 ECU_ADDRESS 0x2040320 READ_WRITE /end MEASUREMENT
/begin MEASUREMENT IN_DigitalOutputPWM.OUT_23_SENSE.Task3 "" UWORD COMP_DEFAULT 0 0 0 65535 ECU_ADDRESS 0x2040322 READ_WRITE /end MEASUREMENT
/begin MEASUREMENT IN_DigitalOutputPWM.OUT_24_SENSE.Task3 "" UWORD COMP_DEFAULT 0 0 0 65535 ECU_ADDRESS 0x2040324 READ_WRITE /end MEASUREMENT
/begin MEASUREMENT IN_DigitalOutputPWM.OUT_25_SENSE.Task3 "" UWORD COMP_DEFAULT 0 0 0 65535 ECU_ADDRESS 0x2040326 READ_WRITE /end MEASUREMENT
/begin MEASUREMENT IN_DigitalOutputPWM.OUT_26_SENSE.Task3 "" UWORD COMP_DEFAULT 0 0 0 65535 ECU_ADDRESS 0x2040328 READ_WRITE /end MEASUREMENT
/begin MEASUREMENT IN_DigitalOutputPWM.OUT_27_SENSE.Task3 "" UWORD COMP_DEFAULT 0 0 0 65535 ECU_ADDRESS 0x204032A READ_WRITE /end MEASUREMENT
/begin MEASUREMENT IN_DigitalOutputPWM.OUT_20_TD.Task3 "PWR_HSS_SENSE_04, ISO, LM, TD" UBYTE IS_BOOLEAN_TRUE 0 0 0 1 ECU_ADDRESS 0x204032C READ_WRITE /end MEASUREMENT
/begin MEASUREMENT IN_DigitalOutputPWM.OUT_21_TD.Task3 "PWR_HSS_SENSE_04, ISO, LM, TD" UBYTE IS_BOOLEAN_TRUE 0 0 0 1 ECU_ADDRESS 0x204032D READ_WRITE /end MEASUREMENT
/begin MEASUREMENT OUT_DigitalOutputPWM.OUT_18_PWM.Task3 "PWR_HSS_PWM_06" UBYTE COMP_DEFAULT 0 0 0 255 ECU_ADDRESS 0x204A022 READ_WRITE /end MEASUREMENT
/begin MEASUREMENT OUT_DigitalOutputPWM.OUT_20_PWM.Task3 "PWR_HSS_PWM_06" UBYTE COMP_DEFAULT 0 0 0 255 ECU_ADDRESS 0x204A023 READ_WRITE /end MEASUREMENT
/begin MEASUREMENT OUT_DigitalOutputPWM.OUT_20_TD_START.Task3 "TD" UBYTE IS_BOOLEAN_TRUE 0 0 0 1 ECU_ADDRESS 0x204A024 READ_WRITE /end MEASUREMENT
/begin MEASUREMENT OUT_DigitalOutputPWM.OUT_21_PWM.Task3 "PWR_HSS_PWM_06" UBYTE COMP_DEFAULT 0 0 0 255 ECU_ADDRESS 0x204A025 READ_WRITE /end MEASUREMENT
/begin MEASUREMENT OUT_DigitalOutputPWM.OUT_21_TD_START.Task3 "TD" UBYTE IS_BOOLEAN_TRUE 0 0 0 1 ECU_ADDRESS 0x204A026 READ_WRITE /end MEASUREMENT
/begin MEASUREMENT OUT_DigitalOutputPWM.OUT_22_PWM.Task3 "PWR_HSS_PWM_06" UBYTE COMP_DEFAULT 0 0 0 255 ECU_ADDRESS 0x204A027 READ_WRITE /end MEASUREMENT
/begin MEASUREMENT OUT_DigitalOutputPWM.OUT_23_PWM.Task3 "PWR_HSS_PWM_06" UBYTE COMP_DEFAULT 0 0 0 255 ECU_ADDRESS 0x204A028 READ_WRITE /end MEASUREMENT
/begin MEASUREMENT OUT_DigitalOutputPWM.OUT_24_PWM.Task3 "PWR_HSS_PWM_06" UBYTE COMP_DEFAULT 0 0 0 255 ECU_ADDRESS 0x204A029 READ_WRITE /end MEASUREMENT
/begin MEASUREMENT OUT_DigitalOutputPWM.OUT_25_PWM.Task3 "PWR_HSS_PWM_06" UBYTE COMP_DEFAULT 0 0 0 255 ECU_ADDRESS 0x204A02A READ_WRITE /end MEASUREMENT
/begin MEASUREMENT OUT_DigitalOutputPWM.OUT_26_PWM.Task3 "PWR_HSS_PWM_06" UBYTE COMP_DEFAULT 0 0 0 255 ECU_ADDRESS 0x204A02B READ_WRITE /end MEASUREMENT
/begin MEASUREMENT OUT_DigitalOutputPWM.OUT_27_PWM.Task3 "PWR_HSS_PWM_06" UBYTE COMP_DEFAULT 0 0 0 255 ECU_ADDRESS 0x204A02C READ_WRITE /end MEASUREMENT
/begin MEASUREMENT DIAG_DigitalOutputPWM.OUT_18_PWM_DIAG.Task3 "Diagnosis Input" UWORD COMP_DEFAULT 0 0 0 65535 ECU_ADDRESS 0x204010C READ_WRITE /end MEASUREMENT
/begin MEASUREMENT DIAG_DigitalOutputPWM.OUT_20_PWM_DIAG.Task3 "Diagnosis Input" UWORD COMP_DEFAULT 0 0 0 65535 ECU_ADDRESS 0x204010E READ_WRITE /end MEASUREMENT
/begin MEASUREMENT DIAG_DigitalOutputPWM.OUT_20_SENSE_PULSE_DIAG.Task3 "Diagnostic Input" UWORD COMP_DEFAULT 0 0 0 65535 ECU_ADDRESS 0x2040110 READ_WRITE /end MEASUREMENT
/begin MEASUREMENT DIAG_DigitalOutputPWM.OUT_20_TD_DIAG.Task3 "Diagnosis Input" UWORD COMP_DEFAULT 0 0 0 65535 ECU_ADDRESS 0x2040112 READ_WRITE /end MEASUREMENT
/begin MEASUREMENT DIAG_DigitalOutputPWM.OUT_21_PWM_DIAG.Task3 "Diagnosis Input" UWORD COMP_DEFAULT 0 0 0 65535 ECU_ADDRESS 0x2040114 READ_WRITE /end MEASUREMENT
/begin MEASUREMENT DIAG_DigitalOutputPWM.OUT_21_SENSE_PULSE_DIAG.Task3 "Diagnostic Input" UWORD COMP_DEFAULT 0 0 0 65535 ECU_ADDRESS 0x2040116 READ_WRITE /end MEASUREMENT
/begin MEASUREMENT DIAG_DigitalOutputPWM.OUT_21_TD_DIAG.Task3 "Diagnosis Input" UWORD COMP_DEFAULT 0 0 0 65535 ECU_ADDRESS 0x2040118 READ_WRITE /end MEASUREMENT
/begin MEASUREMENT DIAG_DigitalOutputPWM.OUT_22_PWM_DIAG.Task3 "Diagnosis Input" UWORD COMP_DEFAULT 0 0 0 65535 ECU_ADDRESS 0x204011A READ_WRITE /end MEASUREMENT
/begin MEASUREMENT DIAG_DigitalOutputPWM.OUT_23_PWM_DIAG.Task3 "Diagnosis Input" UWORD COMP_DEFAULT 0 0 0 65535 ECU_ADDRESS 0x204011C READ_WRITE /end MEASUREMENT
/begin MEASUREMENT DIAG_DigitalOutputPWM.OUT_24_PWM_DIAG.Task3 "Diagnosis Input" UWORD COMP_DEFAULT 0 0 0 65535 ECU_ADDRESS 0x204011E READ_WRITE /end MEASUREMENT
/begin MEASUREMENT DIAG_DigitalOutputPWM.OUT_25_PWM_DIAG.Task3 "Diagnosis Input" UWORD COMP_DEFAULT 0 0 0 65535 ECU_ADDRESS 0x2040120 READ_WRITE /end MEASUREMENT
/begin MEASUREMENT DIAG_DigitalOutputPWM.OUT_26_PWM_DIAG.Task3 "Diagnosis Input" UWORD COMP_DEFAULT 0 0 0 65535 ECU_ADDRESS 0x2040122 READ_WRITE /end MEASUREMENT
/begin MEASUREMENT DIAG_DigitalOutputPWM.OUT_27_PWM_DIAG.Task3 "Diagnosis Input" UWORD COMP_DEFAULT 0 0 0 65535 ECU_ADDRESS 0x2040124 READ_WRITE /end MEASUREMENT
/begin MEASUREMENT IN_NVM.Parameter.ModelHoldMinTimeAfterPOR.Task1 "" UWORD COMP_LINEAR.IN_NVM.Parameter.ModelHoldMinTimeAfterPOR 0 0 0 6553.5 ECU_ADDRESS 0x2040008 READ_WRITE /end MEASUREMENT
/begin MEASUREMENT IN_NVM.Parameter.BlinkSourcePeriod.Task3 "" UWORD COMP_LINEAR.IN_NVM.Parameter.BlinkSourcePeriod 0 0 0 2621.4 ECU_ADDRESS 0x204032E READ_WRITE /end MEASUREMENT
/begin MEASUREMENT IN_NVM.Parameter.TrailerDetectionTime.Task3 "" UBYTE COMP_LINEAR.IN_NVM.Parameter.TrailerDetectionTime 0 0 0 5.1 ECU_ADDRESS 0x2040330 READ_WRITE /end MEASUREMENT
/begin MEASUREMENT IN_NVM.Parameter.HBrakeTime.Task4 "" UWORD COMP_LINEAR.IN_NVM.Parameter.HBrakeTime 0 0 0 3276.75 ECU_ADDRESS 0x2040128 READ_WRITE /end MEASUREMENT
/begin MEASUREMENT IN_NVM.Parameter.HMaxActivationTimeTime.Task4 "" UWORD COMP_LINEAR.IN_NVM.Parameter.HMaxActivationTimeTime 0 0 0 3276.75 ECU_ADDRESS 0x204012A READ_WRITE /end MEASUREMENT
/begin MEASUREMENT IN_NVM.Parameter.HOpenLoadDetectTime.Task4 "" UWORD COMP_LINEAR.IN_NVM.Parameter.HOpenLoadDetectTime 0 0 0 3276.75 ECU_ADDRESS 0x204012C READ_WRITE /end MEASUREMENT
/begin MEASUREMENT IN_NVM.Parameter.HOpenLoadIntervalTime.Task4 "" UWORD COMP_LINEAR.IN_NVM.Parameter.HOpenLoadIntervalTime 0 0 0 3276.75 ECU_ADDRESS 0x204012E READ_WRITE /end MEASUREMENT
/begin MEASUREMENT INOUT_RAMDevice.boSystemWake.Task1 "" UBYTE IS_BOOLEAN_TRUE 0 0 0 1 ECU_ADDRESS 0x2048001 READ_WRITE /end MEASUREMENT
/begin MEASUREMENT INOUT_RAMDevice.boSystemWake.Task3 "" UBYTE IS_BOOLEAN_TRUE 0 0 0 1 ECU_ADDRESS 0x204A02D READ_WRITE /end MEASUREMENT
/begin MEASUREMENT INOUT_RAMDevice.boSystemWake.Task4 "" UBYTE IS_BOOLEAN_TRUE 0 0 0 1 ECU_ADDRESS 0x204B001 READ_WRITE /end MEASUREMENT
/begin MEASUREMENT INOUT_RAMDevice.boSystemWake.Task5 "" UBYTE IS_BOOLEAN_TRUE 0 0 0 1 ECU_ADDRESS 0x204C008 READ_WRITE /end MEASUREMENT
/begin MEASUREMENT IN_DEMDiagnosticEventManager.DeviceState.Task2 "3.1.3.1.1 DeviceState" UWORD COMP_DEFAULT 0 0 0 65535 ECU_ADDRESS 0x204001A READ_WRITE /end MEASUREMENT
/begin MEASUREMENT OUT_DEMDiagnosticEventManager.DateAndTime.Task2 "3.1.3.2.10 DateAndTime" ULONG COMP_DEFAULT 0 0 0 4294967295 ECU_ADDRESS 0x2049004 READ_WRITE /end MEASUREMENT
/begin MEASUREMENT OUT_DEMDiagnosticEventManager.Distance.Task2 "3.1.3.2.8 Distance" ULONG COMP_DEFAULT 0 0 0 4294967295 ECU_ADDRESS 0x2049008 READ_WRITE /end MEASUREMENT
/begin MEASUREMENT OUT_DEMDiagnosticEventManager.FreezeFrame1.Task2 "3.1.3.2.11 FreezeFrame " UWORD COMP_DEFAULT 0 0 0 65535 ECU_ADDRESS 0x204900C READ_WRITE /end MEASUREMENT
/begin MEASUREMENT OUT_DEMDiagnosticEventManager.FreezeFrame10.Task2 "3.1.3.2.11 FreezeFrame " UWORD COMP_DEFAULT 0 0 0 65535 ECU_ADDRESS 0x204900E READ_WRITE /end MEASUREMENT
/begin MEASUREMENT OUT_DEMDiagnosticEventManager.FreezeFrame2.Task2 "3.1.3.2.11 FreezeFrame " UWORD COMP_DEFAULT 0 0 0 65535 ECU_ADDRESS 0x2049010 READ_WRITE /end MEASUREMENT
/begin MEASUREMENT OUT_DEMDiagnosticEventManager.FreezeFrame3.Task2 "3.1.3.2.11 FreezeFrame " UWORD COMP_DEFAULT 0 0 0 65535 ECU_ADDRESS 0x2049012 READ_WRITE /end MEASUREMENT
/begin MEASUREMENT OUT_DEMDiagnosticEventManager.FreezeFrame4.Task2 "3.1.3.2.11 FreezeFrame " UWORD COMP_DEFAULT 0 0 0 65535 ECU_ADDRESS 0x2049014 READ_WRITE /end MEASUREMENT
/begin MEASUREMENT OUT_DEMDiagnosticEventManager.FreezeFrame5.Task2 "3.1.3.2.11 FreezeFrame " UWORD COMP_DEFAULT 0 0 0 65535 ECU_ADDRESS 0x2049016 READ_WRITE /end MEASUREMENT
/begin MEASUREMENT OUT_DEMDiagnosticEventManager.FreezeFrame6.Task2 "3.1.3.2.11 FreezeFrame " UWORD COMP_DEFAULT 0 0 0 65535 ECU_ADDRESS 0x2049018 READ_WRITE /end MEASUREMENT
/begin MEASUREMENT OUT_DEMDiagnosticEventManager.FreezeFrame7.Task2 "3.1.3.2.11 FreezeFrame " UWORD COMP_DEFAULT 0 0 0 65535 ECU_ADDRESS 0x204901A READ_WRITE /end MEASUREMENT
/begin MEASUREMENT OUT_DEMDiagnosticEventManager.FreezeFrame8.Task2 "3.1.3.2.11 FreezeFrame " UWORD COMP_DEFAULT 0 0 0 65535 ECU_ADDRESS 0x204901C READ_WRITE /end MEASUREMENT
/begin MEASUREMENT OUT_DEMDiagnosticEventManager.FreezeFrame9.Task2 "3.1.3.2.11 FreezeFrame " UWORD COMP_DEFAULT 0 0 0 65535 ECU_ADDRESS 0x204901E READ_WRITE /end MEASUREMENT
/begin MEASUREMENT OUT_DEMDiagnosticEventManager.EnableCondition00.Task2 "3.1.3.2.2 EnableCondition" UBYTE IS_BOOLEAN_TRUE 0 0 0 1 ECU_ADDRESS 0x2049020 READ_WRITE /end MEASUREMENT
/begin MEASUREMENT OUT_DEMDiagnosticEventManager.EnableCondition01.Task2 "3.1.3.2.2 EnableCondition" UBYTE IS_BOOLEAN_TRUE 0 0 0 1 ECU_ADDRESS 0x2049021 READ_WRITE /end MEASUREMENT
/begin MEASUREMENT OUT_DEMDiagnosticEventManager.EnableCondition02.Task2 "3.1.3.2.2 EnableCondition" UBYTE IS_BOOLEAN_TRUE 0 0 0 1 ECU_ADDRESS 0x2049022 READ_WRITE /end MEASUREMENT
/begin MEASUREMENT OUT_DEMDiagnosticEventManager.EnableCondition03.Task2 "3.1.3.2.2 EnableCondition" UBYTE IS_BOOLEAN_TRUE 0 0 0 1 ECU_ADDRESS 0x2049023 READ_WRITE /end MEASUREMENT
/begin MEASUREMENT OUT_DEMDiagnosticEventManager.EnableCondition04.Task2 "3.1.3.2.2 EnableCondition" UBYTE IS_BOOLEAN_TRUE 0 0 0 1 ECU_ADDRESS 0x2049024 READ_WRITE /end MEASUREMENT
/begin MEASUREMENT OUT_DEMDiagnosticEventManager.EnableCondition05.Task2 "3.1.3.2.2 EnableCondition" UBYTE IS_BOOLEAN_TRUE 0 0 0 1 ECU_ADDRESS 0x2049025 READ_WRITE /end MEASUREMENT
/begin MEASUREMENT OUT_DEMDiagnosticEventManager.EnableCondition06.Task2 "3.1.3.2.2 EnableCondition" UBYTE IS_BOOLEAN_TRUE 0 0 0 1 ECU_ADDRESS 0x2049026 READ_WRITE /end MEASUREMENT
/begin MEASUREMENT OUT_DEMDiagnosticEventManager.EnableCondition07.Task2 "3.1.3.2.2 EnableCondition" UBYTE IS_BOOLEAN_TRUE 0 0 0 1 ECU_ADDRESS 0x2049027 READ_WRITE /end MEASUREMENT
/begin MEASUREMENT OUT_DEMDiagnosticEventManager.EnableCondition08.Task2 "3.1.3.2.2 EnableCondition" UBYTE IS_BOOLEAN_TRUE 0 0 0 1 ECU_ADDRESS 0x2049028 READ_WRITE /end MEASUREMENT
/begin MEASUREMENT OUT_DEMDiagnosticEventManager.EnableCondition09.Task2 "3.1.3.2.2 EnableCondition" UBYTE IS_BOOLEAN_TRUE 0 0 0 1 ECU_ADDRESS 0x2049029 READ_WRITE /end MEASUREMENT
/begin MEASUREMENT OUT_DEMDiagnosticEventManager.OperationCycle.Task2 "3.1.3.2.1 OperationCycle" UBYTE IS_BOOLEAN_TRUE 0 0 0 1 ECU_ADDRESS 0x204902A READ_WRITE /end MEASUREMENT
/begin MEASUREMENT OUT_DEMDiagnosticEventManager.StorageCondition00.Task2 "3.1.3.2.3 StorageCondition" UBYTE IS_BOOLEAN_TRUE 0 0 0 1 ECU_ADDRESS 0x204902B READ_WRITE /end MEASUREMENT
/begin MEASUREMENT OUT_DEMDiagnosticEventManager.StorageCondition01.Task2 "3.1.3.2.3 StorageCondition" UBYTE IS_BOOLEAN_TRUE 0 0 0 1 ECU_ADDRESS 0x204902C READ_WRITE /end MEASUREMENT
/begin MEASUREMENT OUT_DEMDiagnosticEventManager.StorageCondition02.Task2 "3.1.3.2.3 StorageCondition" UBYTE IS_BOOLEAN_TRUE 0 0 0 1 ECU_ADDRESS 0x204902D READ_WRITE /end MEASUREMENT
/begin MEASUREMENT OUT_DEMDiagnosticEventManager.StorageCondition03.Task2 "3.1.3.2.3 StorageCondition" UBYTE IS_BOOLEAN_TRUE 0 0 0 1 ECU_ADDRESS 0x204902E READ_WRITE /end MEASUREMENT
/begin MEASUREMENT OUT_DEMDiagnosticEventManager.StorageCondition04.Task2 "3.1.3.2.3 StorageCondition" UBYTE IS_BOOLEAN_TRUE 0 0 0 1 ECU_ADDRESS 0x204902F READ_WRITE /end MEASUREMENT
/begin MEASUREMENT OUT_DEMDiagnosticEventManager.StorageCondition05.Task2 "3.1.3.2.3 StorageCondition" UBYTE IS_BOOLEAN_TRUE 0 0 0 1 ECU_ADDRESS 0x2049030 READ_WRITE /end MEASUREMENT
/begin MEASUREMENT OUT_DEMDiagnosticEventManager.StorageCondition06.Task2 "3.1.3.2.3 StorageCondition" UBYTE IS_BOOLEAN_TRUE 0 0 0 1 ECU_ADDRESS 0x2049031 READ_WRITE /end MEASUREMENT
/begin MEASUREMENT OUT_DEMDiagnosticEventManager.StorageCondition07.Task2 "3.1.3.2.3 StorageCondition" UBYTE IS_BOOLEAN_TRUE 0 0 0 1 ECU_ADDRESS 0x2049032 READ_WRITE /end MEASUREMENT
/begin MEASUREMENT OUT_DEMDiagnosticEventManager.StorageCondition08.Task2 "3.1.3.2.3 StorageCondition" UBYTE IS_BOOLEAN_TRUE 0 0 0 1 ECU_ADDRESS 0x2049033 READ_WRITE /end MEASUREMENT
/begin MEASUREMENT OUT_DEMDiagnosticEventManager.StorageCondition09.Task2 "3.1.3.2.3 StorageCondition" UBYTE IS_BOOLEAN_TRUE 0 0 0 1 ECU_ADDRESS 0x2049034 READ_WRITE /end MEASUREMENT
/begin MEASUREMENT OUT_DEMDiagnosticEventManager.DEMList.DTC_01.Task2 "" UBYTE COMP_DEFAULT 0 0 0 255 ECU_ADDRESS 0x2049000 READ_WRITE /end MEASUREMENT
/begin MEASUREMENT OUT_DCAN.MessageForwardingEnable.Task2 "" UBYTE IS_BOOLEAN_TRUE 0 0 0 1 ECU_ADDRESS 0x2049040 READ_WRITE /end MEASUREMENT
/begin MEASUREMENT OUT_DCAN.GW_00000501.MessageEnable.Task2 "3.1.2.2.1 MessageEnable" UBYTE IS_BOOLEAN_TRUE 0 0 0 1 ECU_ADDRESS 0x2049038 READ_WRITE /end MEASUREMENT
/begin MEASUREMENT OUT_DCAN.GW_00000502.MessageEnable.Task2 "3.1.2.2.1 MessageEnable" UBYTE IS_BOOLEAN_TRUE 0 0 0 1 ECU_ADDRESS 0x2049039 READ_WRITE /end MEASUREMENT
/begin MEASUREMENT OUT_DCAN.GW_00000503.MessageEnable.Task2 "3.1.2.2.1 MessageEnable" UBYTE IS_BOOLEAN_TRUE 0 0 0 1 ECU_ADDRESS 0x204903A READ_WRITE /end MEASUREMENT
/begin MEASUREMENT OUT_DCAN.GW_00000504.MessageEnable.Task2 "3.1.2.2.1 MessageEnable" UBYTE IS_BOOLEAN_TRUE 0 0 0 1 ECU_ADDRESS 0x204903B READ_WRITE /end MEASUREMENT
/begin MEASUREMENT OUT_DCAN.GW_00000FF1.MessageEnable.Task2 "3.1.2.2.1 MessageEnable" UBYTE IS_BOOLEAN_TRUE 0 0 0 1 ECU_ADDRESS 0x204903C READ_WRITE /end MEASUREMENT
/begin MEASUREMENT OUT_DCAN.GW_18DA17F0.MessageEnable.Task2 "3.1.2.2.1 MessageEnable" UBYTE IS_BOOLEAN_TRUE 0 0 0 1 ECU_ADDRESS 0x204903D READ_WRITE /end MEASUREMENT
/begin MEASUREMENT OUT_DCAN.GW_18DA17F1.MessageEnable.Task2 "3.1.2.2.1 MessageEnable" UBYTE IS_BOOLEAN_TRUE 0 0 0 1 ECU_ADDRESS 0x204903E READ_WRITE /end MEASUREMENT
/begin MEASUREMENT OUT_DCAN.GW_18DAE1F1.MessageEnable.Task2 "3.1.2.2.1 MessageEnable" UBYTE IS_BOOLEAN_TRUE 0 0 0 1 ECU_ADDRESS 0x204903F READ_WRITE /end MEASUREMENT
/begin MEASUREMENT OUT_ACAN.MessageForwardingEnable.Task2 "" UBYTE IS_BOOLEAN_TRUE 0 0 0 1 ECU_ADDRESS 0x2049042 READ_WRITE /end MEASUREMENT
/begin MEASUREMENT IN_ACAN.BSG_EXPA.IN_ANA_01.Task4 "RNTC" ULONG COMP_DEFAULT 0 0 0 4294967295 ECU_ADDRESS 0x2040130 READ_WRITE /end MEASUREMENT
/begin MEASUREMENT IN_ACAN.BSG_EXPA.IN_ANA_02.Task4 "RNTC" ULONG COMP_DEFAULT 0 0 0 4294967295 ECU_ADDRESS 0x2040134 READ_WRITE /end MEASUREMENT
/begin MEASUREMENT IN_ACAN.BSG_EXPA.IN_ANA_03.Task4 "5VA" ULONG COMP_DEFAULT 0 0 0 4294967295 ECU_ADDRESS 0x2040138 READ_WRITE /end MEASUREMENT
/begin MEASUREMENT IN_ACAN.BSG_EXPA.IN_ANA_04.Task4 "RNTC" ULONG COMP_DEFAULT 0 0 0 4294967295 ECU_ADDRESS 0x204013C READ_WRITE /end MEASUREMENT
/begin MEASUREMENT IN_ACAN.BSG_EXPA.IN_ANA_05.Task4 "5VREL" ULONG COMP_DEFAULT 0 0 0 4294967295 ECU_ADDRESS 0x2040140 READ_WRITE /end MEASUREMENT
/begin MEASUREMENT IN_ACAN.BSG_EXPA.IN_ANA_06.Task4 "5VREL" ULONG COMP_DEFAULT 0 0 0 4294967295 ECU_ADDRESS 0x2040144 READ_WRITE /end MEASUREMENT
/begin MEASUREMENT IN_ACAN.BSG_EXPA.IN_ANA_07.Task4 "5VREL" ULONG COMP_DEFAULT 0 0 0 4294967295 ECU_ADDRESS 0x2040148 READ_WRITE /end MEASUREMENT
/begin MEASUREMENT IN_ACAN.BSG_EXPA.IN_ANA_08.Task4 "5VREL" ULONG COMP_DEFAULT 0 0 0 4294967295 ECU_ADDRESS 0x204014C READ_WRITE /end MEASUREMENT
/begin MEASUREMENT IN_ACAN.BSG_EXPA.IN_ANA_09.Task4 "5VREL" ULONG COMP_DEFAULT 0 0 0 4294967295 ECU_ADDRESS 0x2040150 READ_WRITE /end MEASUREMENT
/begin MEASUREMENT IN_ACAN.BSG_EXPA.IN_PWR.Task4 "" ULONG COMP_DEFAULT 0 0 0 4294967295 ECU_ADDRESS 0x2040154 READ_WRITE /end MEASUREMENT
/begin MEASUREMENT IN_ACAN.BSG_EXPA.Frequency.Task4 "" UWORD COMP_DEFAULT 0 0 0 65535 ECU_ADDRESS 0x2040158 READ_WRITE /end MEASUREMENT
/begin MEASUREMENT IN_ACAN.BSG_EXPA.IN_ANA_11.Task4 "" UWORD COMP_DEFAULT 0 0 0 65535 ECU_ADDRESS 0x204015A READ_WRITE /end MEASUREMENT
/begin MEASUREMENT IN_ACAN.BSG_EXPA.IN_ANA_12.Task4 "" UWORD COMP_DEFAULT 0 0 0 65535 ECU_ADDRESS 0x204015C READ_WRITE /end MEASUREMENT
/begin MEASUREMENT IN_ACAN.BSG_EXPA.IN_PWR_G1.Task4 "" UWORD COMP_DEFAULT 0 0 0 65535 ECU_ADDRESS 0x204015E READ_WRITE /end MEASUREMENT
/begin MEASUREMENT IN_ACAN.BSG_EXPA.IN_PWR_G2.Task4 "" UWORD COMP_DEFAULT 0 0 0 65535 ECU_ADDRESS 0x2040160 READ_WRITE /end MEASUREMENT
/begin MEASUREMENT IN_ACAN.BSG_EXPA.IN_PWR_G3.Task4 "" UWORD COMP_DEFAULT 0 0 0 65535 ECU_ADDRESS 0x2040162 READ_WRITE /end MEASUREMENT
/begin MEASUREMENT IN_ACAN.BSG_EXPA.IN_PWR_G4.Task4 "" UWORD COMP_DEFAULT 0 0 0 65535 ECU_ADDRESS 0x2040164 READ_WRITE /end MEASUREMENT
/begin MEASUREMENT IN_ACAN.BSG_EXPA.IN_PWR_G5.Task4 "" UWORD COMP_DEFAULT 0 0 0 65535 ECU_ADDRESS 0x2040166 READ_WRITE /end MEASUREMENT
/begin MEASUREMENT IN_ACAN.BSG_EXPA.OUT_01_HB_SENSE.Task4 "" UWORD COMP_DEFAULT 0 0 0 65535 ECU_ADDRESS 0x2040168 READ_WRITE /end MEASUREMENT
/begin MEASUREMENT IN_ACAN.BSG_EXPA.OUT_02_HB_SENSE.Task4 "" UWORD COMP_DEFAULT 0 0 0 65535 ECU_ADDRESS 0x204016A READ_WRITE /end MEASUREMENT
/begin MEASUREMENT IN_ACAN.BSG_EXPA.OUT_03_SENSE.Task4 "" UWORD COMP_DEFAULT 0 0 0 65535 ECU_ADDRESS 0x204016C READ_WRITE /end MEASUREMENT
/begin MEASUREMENT IN_ACAN.BSG_EXPA.OUT_04_SENSE.Task4 "" UWORD COMP_DEFAULT 0 0 0 65535 ECU_ADDRESS 0x204016E READ_WRITE /end MEASUREMENT
/begin MEASUREMENT IN_ACAN.BSG_EXPA.OUT_05_HB_SENSE.Task4 "" UWORD COMP_DEFAULT 0 0 0 65535 ECU_ADDRESS 0x2040170 READ_WRITE /end MEASUREMENT
/begin MEASUREMENT IN_ACAN.BSG_EXPA.OUT_06_HB_SENSE.Task4 "" UWORD COMP_DEFAULT 0 0 0 65535 ECU_ADDRESS 0x2040172 READ_WRITE /end MEASUREMENT
/begin MEASUREMENT IN_ACAN.BSG_EXPA.OUT_07_HB_SENSE.Task4 "" UWORD COMP_DEFAULT 0 0 0 65535 ECU_ADDRESS 0x2040174 READ_WRITE /end MEASUREMENT
/begin MEASUREMENT IN_ACAN.BSG_EXPA.OUT_08_HB_SENSE.Task4 "" UWORD COMP_DEFAULT 0 0 0 65535 ECU_ADDRESS 0x2040176 READ_WRITE /end MEASUREMENT
/begin MEASUREMENT IN_ACAN.BSG_EXPA.OUT_09_HB_SENSE.Task4 "" UWORD COMP_DEFAULT 0 0 0 65535 ECU_ADDRESS 0x2040178 READ_WRITE /end MEASUREMENT
/begin MEASUREMENT IN_ACAN.BSG_EXPA.OUT_10_HB_SENSE.Task4 "" UWORD COMP_DEFAULT 0 0 0 65535 ECU_ADDRESS 0x204017A READ_WRITE /end MEASUREMENT
/begin MEASUREMENT IN_ACAN.BSG_EXPA.OUT_11_SENSE.Task4 "" UWORD COMP_DEFAULT 0 0 0 65535 ECU_ADDRESS 0x204017C READ_WRITE /end MEASUREMENT
/begin MEASUREMENT IN_ACAN.BSG_EXPA.OUT_12_SENSE.Task4 "" UWORD COMP_DEFAULT 0 0 0 65535 ECU_ADDRESS 0x204017E READ_WRITE /end MEASUREMENT
/begin MEASUREMENT IN_ACAN.BSG_EXPA.OUT_12_SENSE_PULSE.Task4 "" UWORD COMP_DEFAULT 0 0 0 65535 ECU_ADDRESS 0x2040180 READ_WRITE /end MEASUREMENT
/begin MEASUREMENT IN_ACAN.BSG_EXPA.OUT_13_SENSE.Task4 "" UWORD COMP_DEFAULT 0 0 0 65535 ECU_ADDRESS 0x2040182 READ_WRITE /end MEASUREMENT
/begin MEASUREMENT IN_ACAN.BSG_EXPA.OUT_14_SENSE.Task4 "" UWORD COMP_DEFAULT 0 0 0 65535 ECU_ADDRESS 0x2040184 READ_WRITE /end MEASUREMENT
/begin MEASUREMENT IN_ACAN.BSG_EXPA.OUT_15_SENSE.Task4 "" UWORD COMP_DEFAULT 0 0 0 65535 ECU_ADDRESS 0x2040186 READ_WRITE /end MEASUREMENT
/begin MEASUREMENT IN_ACAN.BSG_EXPA.OUT_16_SENSE.Task4 "" UWORD COMP_DEFAULT 0 0 0 65535 ECU_ADDRESS 0x2040188 READ_WRITE /end MEASUREMENT
/begin MEASUREMENT IN_ACAN.BSG_EXPA.OUT_17_SENSE.Task4 "" UWORD COMP_DEFAULT 0 0 0 65535 ECU_ADDRESS 0x204018A READ_WRITE /end MEASUREMENT
/begin MEASUREMENT IN_ACAN.BSG_EXPA.OUT_18_SENSE.Task4 "" UWORD COMP_DEFAULT 0 0 0 65535 ECU_ADDRESS 0x204018C READ_WRITE /end MEASUREMENT
/begin MEASUREMENT IN_ACAN.BSG_EXPA.OUT_19_SENSE.Task4 "" UWORD COMP_DEFAULT 0 0 0 65535 ECU_ADDRESS 0x204018E READ_WRITE /end MEASUREMENT
/begin MEASUREMENT IN_ACAN.BSG_EXPA.OUT_20_SENSE.Task4 "" UWORD COMP_DEFAULT 0 0 0 65535 ECU_ADDRESS 0x2040190 READ_WRITE /end MEASUREMENT
/begin MEASUREMENT IN_ACAN.BSG_EXPA.OUT_21_SENSE.Task4 "" UWORD COMP_DEFAULT 0 0 0 65535 ECU_ADDRESS 0x2040192 READ_WRITE /end MEASUREMENT
/begin MEASUREMENT IN_ACAN.BSG_EXPA.OUT_21_SENSE_PULSE.Task4 "ISO Pulse" UWORD COMP_DEFAULT 0 0 0 65535 ECU_ADDRESS 0x2040194 READ_WRITE /end MEASUREMENT
/begin MEASUREMENT IN_ACAN.BSG_EXPA.OUT_22_SENSE.Task4 "" UWORD COMP_DEFAULT 0 0 0 65535 ECU_ADDRESS 0x2040196 READ_WRITE /end MEASUREMENT
/begin MEASUREMENT IN_ACAN.BSG_EXPA.OUT_23_SENSE.Task4 "" UWORD COMP_DEFAULT 0 0 0 65535 ECU_ADDRESS 0x2040198 READ_WRITE /end MEASUREMENT
/begin MEASUREMENT IN_ACAN.BSG_EXPA.OUT_24_SENSE.Task4 "" UWORD COMP_DEFAULT 0 0 0 65535 ECU_ADDRESS 0x204019A READ_WRITE /end MEASUREMENT
/begin MEASUREMENT IN_ACAN.BSG_EXPA.OUT_25_SENSE.Task4 "" UWORD COMP_DEFAULT 0 0 0 65535 ECU_ADDRESS 0x204019C READ_WRITE /end MEASUREMENT
/begin MEASUREMENT IN_ACAN.BSG_EXPA.OUT_26_SENSE.Task4 "" UWORD COMP_DEFAULT 0 0 0 65535 ECU_ADDRESS 0x204019E READ_WRITE /end MEASUREMENT
/begin MEASUREMENT IN_ACAN.BSG_EXPA.OUT_27_SENSE.Task4 "" UWORD COMP_DEFAULT 0 0 0 65535 ECU_ADDRESS 0x20401A0 READ_WRITE /end MEASUREMENT
/begin MEASUREMENT IN_ACAN.BSG_EXPA.OUT_28_SENSE.Task4 "" UWORD COMP_DEFAULT 0 0 0 65535 ECU_ADDRESS 0x20401A2 READ_WRITE /end MEASUREMENT
/begin MEASUREMENT IN_ACAN.BSG_EXPA.OUT_ANA_PWR_01.Task4 "" UWORD COMP_DEFAULT 0 0 0 65535 ECU_ADDRESS 0x20401A4 READ_WRITE /end MEASUREMENT
/begin MEASUREMENT IN_ACAN.BSG_EXPA.IN_DIG_01.Task4 "" UBYTE IS_BOOLEAN_TRUE 0 0 0 1 ECU_ADDRESS 0x20401A6 READ_WRITE /end MEASUREMENT
/begin MEASUREMENT IN_ACAN.BSG_EXPA.IN_DIG_02.Task4 "" UBYTE IS_BOOLEAN_TRUE 0 0 0 1 ECU_ADDRESS 0x20401A7 READ_WRITE /end MEASUREMENT
/begin MEASUREMENT IN_ACAN.BSG_EXPA.IN_DIG_03.Task4 "" UBYTE IS_BOOLEAN_TRUE 0 0 0 1 ECU_ADDRESS 0x20401A8 READ_WRITE /end MEASUREMENT
/begin MEASUREMENT IN_ACAN.BSG_EXPA.IN_DIG_04.Task4 "" UBYTE IS_BOOLEAN_TRUE 0 0 0 1 ECU_ADDRESS 0x20401A9 READ_WRITE /end MEASUREMENT
/begin MEASUREMENT IN_ACAN.BSG_EXPA.IN_DIG_05.Task4 "" UBYTE IS_BOOLEAN_TRUE 0 0 0 1 ECU_ADDRESS 0x20401AA READ_WRITE /end MEASUREMENT
/begin MEASUREMENT IN_ACAN.BSG_EXPA.IN_DIG_06.Task4 "" UBYTE IS_BOOLEAN_TRUE 0 0 0 1 ECU_ADDRESS 0x20401AB READ_WRITE /end MEASUREMENT
/begin MEASUREMENT IN_ACAN.BSG_EXPA.IN_DIG_07.Task4 "" UBYTE IS_BOOLEAN_TRUE 0 0 0 1 ECU_ADDRESS 0x20401AC READ_WRITE /end MEASUREMENT
/begin MEASUREMENT IN_ACAN.BSG_EXPA.IN_DIG_08.Task4 "" UBYTE IS_BOOLEAN_TRUE 0 0 0 1 ECU_ADDRESS 0x20401AD READ_WRITE /end MEASUREMENT
/begin MEASUREMENT IN_ACAN.BSG_EXPA.IN_DIG_09.Task4 "" UBYTE IS_BOOLEAN_TRUE 0 0 0 1 ECU_ADDRESS 0x20401AE READ_WRITE /end MEASUREMENT
/begin MEASUREMENT IN_ACAN.BSG_EXPA.IN_DIG_10.Task4 "" UBYTE IS_BOOLEAN_TRUE 0 0 0 1 ECU_ADDRESS 0x20401AF READ_WRITE /end MEASUREMENT
/begin MEASUREMENT IN_ACAN.BSG_EXPA.IN_DIG_11.Task4 "" UBYTE IS_BOOLEAN_TRUE 0 0 0 1 ECU_ADDRESS 0x20401B0 READ_WRITE /end MEASUREMENT
/begin MEASUREMENT IN_ACAN.BSG_EXPA.IN_DIG_12.Task4 "" UBYTE IS_BOOLEAN_TRUE 0 0 0 1 ECU_ADDRESS 0x20401B1 READ_WRITE /end MEASUREMENT
/begin MEASUREMENT IN_ACAN.BSG_EXPA.IN_DIG_13.Task4 "" UBYTE IS_BOOLEAN_TRUE 0 0 0 1 ECU_ADDRESS 0x20401B2 READ_WRITE /end MEASUREMENT
/begin MEASUREMENT IN_ACAN.BSG_EXPA.IN_DIG_14.Task4 "" UBYTE IS_BOOLEAN_TRUE 0 0 0 1 ECU_ADDRESS 0x20401B3 READ_WRITE /end MEASUREMENT
/begin MEASUREMENT IN_ACAN.BSG_EXPA.IN_DIG_15.Task4 "" UBYTE IS_BOOLEAN_TRUE 0 0 0 1 ECU_ADDRESS 0x20401B4 READ_WRITE /end MEASUREMENT
/begin MEASUREMENT IN_ACAN.BSG_EXPA.IN_DIG_16.Task4 "" UBYTE IS_BOOLEAN_TRUE 0 0 0 1 ECU_ADDRESS 0x20401B5 READ_WRITE /end MEASUREMENT
/begin MEASUREMENT IN_ACAN.BSG_EXPA.IN_DIG_17.Task4 "" UBYTE IS_BOOLEAN_TRUE 0 0 0 1 ECU_ADDRESS 0x20401B6 READ_WRITE /end MEASUREMENT
/begin MEASUREMENT IN_ACAN.BSG_EXPA.IN_DIG_18.Task4 "" UBYTE IS_BOOLEAN_TRUE 0 0 0 1 ECU_ADDRESS 0x20401B7 READ_WRITE /end MEASUREMENT
/begin MEASUREMENT IN_ACAN.BSG_EXPA.IN_DIG_19.Task4 "" UBYTE IS_BOOLEAN_TRUE 0 0 0 1 ECU_ADDRESS 0x20401B8 READ_WRITE /end MEASUREMENT
/begin MEASUREMENT IN_ACAN.BSG_EXPA.IN_DIG_20.Task4 "" UBYTE IS_BOOLEAN_TRUE 0 0 0 1 ECU_ADDRESS 0x20401B9 READ_WRITE /end MEASUREMENT
/begin MEASUREMENT IN_ACAN.BSG_EXPA.IN_DIG_21.Task4 "" UBYTE IS_BOOLEAN_TRUE 0 0 0 1 ECU_ADDRESS 0x20401BA READ_WRITE /end MEASUREMENT
/begin MEASUREMENT IN_ACAN.BSG_EXPA.IN_DIG_22.Task4 "" UBYTE IS_BOOLEAN_TRUE 0 0 0 1 ECU_ADDRESS 0x20401BB READ_WRITE /end MEASUREMENT
/begin MEASUREMENT IN_ACAN.BSG_EXPA.OUT_12_TD.Task4 "" UBYTE IS_BOOLEAN_TRUE 0 0 0 1 ECU_ADDRESS 0x20401BC READ_WRITE /end MEASUREMENT
/begin MEASUREMENT IN_ACAN.BSG_EXPA.OUT_21_TD.Task4 "" UBYTE IS_BOOLEAN_TRUE 0 0 0 1 ECU_ADDRESS 0x20401BD READ_WRITE /end MEASUREMENT
/begin MEASUREMENT OUT_ACAN.BSG_EXPA.OUT_01_HB.Task4 "PWR_BRIDGE_01" SBYTE COMP_DEFAULT 0 0 -128 127 ECU_ADDRESS 0x204B002 READ_WRITE /end MEASUREMENT
/begin MEASUREMENT OUT_ACAN.BSG_EXPA.OUT_02_HB.Task4 "PWR_BRIDGE_01" SBYTE COMP_DEFAULT 0 0 -128 127 ECU_ADDRESS 0x204B003 READ_WRITE /end MEASUREMENT
/begin MEASUREMENT OUT_ACAN.BSG_EXPA.OUT_03.Task4 "PWR_HSS_SENSE_04" UBYTE IS_BOOLEAN_TRUE 0 0 0 1 ECU_ADDRESS 0x204B004 READ_WRITE /end MEASUREMENT
/begin MEASUREMENT OUT_ACAN.BSG_EXPA.OUT_04.Task4 "PWR_HSS_SENSE_04" UBYTE IS_BOOLEAN_TRUE 0 0 0 1 ECU_ADDRESS 0x204B005 READ_WRITE /end MEASUREMENT
/begin MEASUREMENT OUT_ACAN.BSG_EXPA.OUT_05_HB.Task4 "PWR_BRIDGE_01" SBYTE COMP_DEFAULT 0 0 -128 127 ECU_ADDRESS 0x204B006 READ_WRITE /end MEASUREMENT
/begin MEASUREMENT OUT_ACAN.BSG_EXPA.OUT_06_HB.Task4 "PWR_BRIDGE_01" SBYTE COMP_DEFAULT 0 0 -128 127 ECU_ADDRESS 0x204B007 READ_WRITE /end MEASUREMENT
/begin MEASUREMENT OUT_ACAN.BSG_EXPA.OUT_07_HB.Task4 "PWR_BRIDGE_01" SBYTE COMP_DEFAULT 0 0 -128 127 ECU_ADDRESS 0x204B008 READ_WRITE /end MEASUREMENT
/begin MEASUREMENT OUT_ACAN.BSG_EXPA.OUT_08_HB.Task4 "PWR_BRIDGE_01" SBYTE COMP_DEFAULT 0 0 -128 127 ECU_ADDRESS 0x204B009 READ_WRITE /end MEASUREMENT
/begin MEASUREMENT OUT_ACAN.BSG_EXPA.OUT_09_HB.Task4 "PWR_BRIDGE_01" SBYTE COMP_DEFAULT 0 0 -128 127 ECU_ADDRESS 0x204B00A READ_WRITE /end MEASUREMENT
/begin MEASUREMENT OUT_ACAN.BSG_EXPA.OUT_10_HB.Task4 "PWR_BRIDGE_01" SBYTE COMP_DEFAULT 0 0 -128 127 ECU_ADDRESS 0x204B00B READ_WRITE /end MEASUREMENT
/begin MEASUREMENT OUT_ACAN.BSG_EXPA.OUT_11.Task4 "PWR_HSS_SENSE_04" UBYTE IS_BOOLEAN_TRUE 0 0 0 1 ECU_ADDRESS 0x204B00C READ_WRITE /end MEASUREMENT
/begin MEASUREMENT OUT_ACAN.BSG_EXPA.OUT_12.Task4 "PWR_HSS_SENSE_04" UBYTE IS_BOOLEAN_TRUE 0 0 0 1 ECU_ADDRESS 0x204B00D READ_WRITE /end MEASUREMENT
/begin MEASUREMENT OUT_ACAN.BSG_EXPA.OUT_12_TD_START.Task4 "Trailer detection" UBYTE IS_BOOLEAN_TRUE 0 0 0 1 ECU_ADDRESS 0x204B00E READ_WRITE /end MEASUREMENT
/begin MEASUREMENT OUT_ACAN.BSG_EXPA.OUT_13.Task4 "PWR_HSS_SENSE_04" UBYTE IS_BOOLEAN_TRUE 0 0 0 1 ECU_ADDRESS 0x204B00F READ_WRITE /end MEASUREMENT
/begin MEASUREMENT OUT_ACAN.BSG_EXPA.OUT_14.Task4 "PWR_HSS_SENSE_04" UBYTE IS_BOOLEAN_TRUE 0 0 0 1 ECU_ADDRESS 0x204B010 READ_WRITE /end MEASUREMENT
/begin MEASUREMENT OUT_ACAN.BSG_EXPA.OUT_15.Task4 "PWR_HSS_SENSE_04" UBYTE IS_BOOLEAN_TRUE 0 0 0 1 ECU_ADDRESS 0x204B011 READ_WRITE /end MEASUREMENT
/begin MEASUREMENT OUT_ACAN.BSG_EXPA.OUT_16.Task4 "PWR_HSS_SENSE_04" UBYTE IS_BOOLEAN_TRUE 0 0 0 1 ECU_ADDRESS 0x204B012 READ_WRITE /end MEASUREMENT
/begin MEASUREMENT OUT_ACAN.BSG_EXPA.OUT_17.Task4 "PWR_HSS_SENSE_04" UBYTE IS_BOOLEAN_TRUE 0 0 0 1 ECU_ADDRESS 0x204B013 READ_WRITE /end MEASUREMENT
/begin MEASUREMENT OUT_ACAN.BSG_EXPA.OUT_18.Task4 "PWR_HSS_SENSE_04" UBYTE IS_BOOLEAN_TRUE 0 0 0 1 ECU_ADDRESS 0x204B014 READ_WRITE /end MEASUREMENT
/begin MEASUREMENT OUT_ACAN.BSG_EXPA.OUT_19.Task4 "PWR_HSS_SENSE_04" UBYTE IS_BOOLEAN_TRUE 0 0 0 1 ECU_ADDRESS 0x204B015 READ_WRITE /end MEASUREMENT
/begin MEASUREMENT OUT_ACAN.BSG_EXPA.OUT_20.Task4 "PWR_HSS_SENSE_04" UBYTE IS_BOOLEAN_TRUE 0 0 0 1 ECU_ADDRESS 0x204B016 READ_WRITE /end MEASUREMENT
/begin MEASUREMENT OUT_ACAN.BSG_EXPA.OUT_21.Task4 "PWR_HSS_SENSE_04, ISO, LM, TD" UBYTE IS_BOOLEAN_TRUE 0 0 0 1 ECU_ADDRESS 0x204B017 READ_WRITE /end MEASUREMENT
/begin MEASUREMENT OUT_ACAN.BSG_EXPA.OUT_21_TD_START.Task4 "Trailer detection" UBYTE IS_BOOLEAN_TRUE 0 0 0 1 ECU_ADDRESS 0x204B018 READ_WRITE /end MEASUREMENT
/begin MEASUREMENT OUT_ACAN.BSG_EXPA.OUT_22.Task4 "PWR_HSS_SENSE_04" UBYTE IS_BOOLEAN_TRUE 0 0 0 1 ECU_ADDRESS 0x204B019 READ_WRITE /end MEASUREMENT
/begin MEASUREMENT OUT_ACAN.BSG_EXPA.OUT_23.Task4 "PWR_HSS_SENSE_04" UBYTE IS_BOOLEAN_TRUE 0 0 0 1 ECU_ADDRESS 0x204B01A READ_WRITE /end MEASUREMENT
/begin MEASUREMENT OUT_ACAN.BSG_EXPA.OUT_24.Task4 "PWR_HSS_SENSE_04" UBYTE IS_BOOLEAN_TRUE 0 0 0 1 ECU_ADDRESS 0x204B01B READ_WRITE /end MEASUREMENT
/begin MEASUREMENT OUT_ACAN.BSG_EXPA.OUT_25.Task4 "PWR_HSS_SENSE_04" UBYTE IS_BOOLEAN_TRUE 0 0 0 1 ECU_ADDRESS 0x204B01C READ_WRITE /end MEASUREMENT
/begin MEASUREMENT OUT_ACAN.BSG_EXPA.OUT_26.Task4 "PWR_HSS_SENSE_04" UBYTE IS_BOOLEAN_TRUE 0 0 0 1 ECU_ADDRESS 0x204B01D READ_WRITE /end MEASUREMENT
/begin MEASUREMENT OUT_ACAN.BSG_EXPA.OUT_27.Task4 "PWR_HSS_SENSE_04" UBYTE IS_BOOLEAN_TRUE 0 0 0 1 ECU_ADDRESS 0x204B01E READ_WRITE /end MEASUREMENT
/begin MEASUREMENT OUT_ACAN.BSG_EXPA.OUT_28.Task4 "PWR_HSS_SENSE_04" UBYTE IS_BOOLEAN_TRUE 0 0 0 1 ECU_ADDRESS 0x204B01F READ_WRITE /end MEASUREMENT
/begin MEASUREMENT OUT_ACAN.BSG_EXPA.OUT_29_HB.Task4 "SPI Mirror Driver - OL diag only" SBYTE COMP_DEFAULT 0 0 -128 127 ECU_ADDRESS 0x204B020 READ_WRITE /end MEASUREMENT
/begin MEASUREMENT OUT_ACAN.BSG_EXPA.OUT_30_HB.Task4 "SPI Mirror Driver - OL diag only" SBYTE COMP_DEFAULT 0 0 -128 127 ECU_ADDRESS 0x204B021 READ_WRITE /end MEASUREMENT
/begin MEASUREMENT OUT_ACAN.BSG_EXPA.OUT_31_HB.Task4 "SPI Mirror Driver - OL diag only" SBYTE COMP_DEFAULT 0 0 -128 127 ECU_ADDRESS 0x204B022 READ_WRITE /end MEASUREMENT
/begin MEASUREMENT OUT_ACAN.BSG_EXPA.OUT_32_HB.Task4 "SPI Mirror Driver - OL diag only" SBYTE COMP_DEFAULT 0 0 -128 127 ECU_ADDRESS 0x204B023 READ_WRITE /end MEASUREMENT
/begin MEASUREMENT OUT_ACAN.BSG_EXPA.OUT_33_HB.Task4 "SPI Mirror Driver - OL diag only" SBYTE COMP_DEFAULT 0 0 -128 127 ECU_ADDRESS 0x204B024 READ_WRITE /end MEASUREMENT
/begin MEASUREMENT OUT_ACAN.BSG_EXPA.OUT_34_HB.Task4 "SPI Mirror Driver - OL diag only" SBYTE COMP_DEFAULT 0 0 -128 127 ECU_ADDRESS 0x204B025 READ_WRITE /end MEASUREMENT
/begin MEASUREMENT OUT_ACAN.BSG_EXPA.OUT_OLD_01.Task4 "PWR_HSS_SENSE04, TD" UBYTE IS_BOOLEAN_TRUE 0 0 0 1 ECU_ADDRESS 0x204B026 READ_WRITE /end MEASUREMENT
/begin MEASUREMENT OUT_ACAN.BSG_EXPA.OUT_OLD_02.Task4 "PWR_HSS_SENSE04, TD" UBYTE IS_BOOLEAN_TRUE 0 0 0 1 ECU_ADDRESS 0x204B027 READ_WRITE /end MEASUREMENT
/begin MEASUREMENT OUT_ACAN.BSG_EXPA.OUT_OLD_03.Task4 "PWR_HSS_SENSE04, TD" UBYTE IS_BOOLEAN_TRUE 0 0 0 1 ECU_ADDRESS 0x204B028 READ_WRITE /end MEASUREMENT
/begin MEASUREMENT OUT_ACAN.BSG_EXPA.OUT_OLD_04.Task4 "PWR_HSS_SENSE04, TD" UBYTE IS_BOOLEAN_TRUE 0 0 0 1 ECU_ADDRESS 0x204B029 READ_WRITE /end MEASUREMENT
/begin MEASUREMENT OUT_ACAN.BSG_EXPA.OUT_SUP_ANA_01.Task4 "Voltage-Tracker" UBYTE IS_BOOLEAN_TRUE 0 0 0 1 ECU_ADDRESS 0x204B02A READ_WRITE /end MEASUREMENT
/begin MEASUREMENT DIAG_ACAN.BSG_EXPA.IN_ANA_01_DIAG.Task4 "Diagnosis Input" UWORD COMP_DEFAULT 0 0 0 65535 ECU_ADDRESS 0x204035C READ_WRITE /end MEASUREMENT
/begin MEASUREMENT DIAG_ACAN.BSG_EXPA.IN_ANA_02_DIAG.Task4 "Diagnosis Input" UWORD COMP_DEFAULT 0 0 0 65535 ECU_ADDRESS 0x204035E READ_WRITE /end MEASUREMENT
/begin MEASUREMENT DIAG_ACAN.BSG_EXPA.IN_ANA_03_DIAG.Task4 "Diagnosis Input" UWORD COMP_DEFAULT 0 0 0 65535 ECU_ADDRESS 0x2040360 READ_WRITE /end MEASUREMENT
/begin MEASUREMENT DIAG_ACAN.BSG_EXPA.IN_ANA_04_DIAG.Task4 "Diagnosis Input" UWORD COMP_DEFAULT 0 0 0 65535 ECU_ADDRESS 0x2040362 READ_WRITE /end MEASUREMENT
/begin MEASUREMENT DIAG_ACAN.BSG_EXPA.IN_ANA_05_DIAG.Task4 "Diagnosis Input" UWORD COMP_DEFAULT 0 0 0 65535 ECU_ADDRESS 0x2040364 READ_WRITE /end MEASUREMENT
/begin MEASUREMENT DIAG_ACAN.BSG_EXPA.IN_ANA_06_DIAG.Task4 "Diagnosis Input" UWORD COMP_DEFAULT 0 0 0 65535 ECU_ADDRESS 0x2040366 READ_WRITE /end MEASUREMENT
/begin MEASUREMENT DIAG_ACAN.BSG_EXPA.IN_ANA_07_DIAG.Task4 "Diagnosis Input" UWORD COMP_DEFAULT 0 0 0 65535 ECU_ADDRESS 0x2040368 READ_WRITE /end MEASUREMENT
/begin MEASUREMENT DIAG_ACAN.BSG_EXPA.IN_ANA_08_DIAG.Task4 "Diagnosis Input" UWORD COMP_DEFAULT 0 0 0 65535 ECU_ADDRESS 0x204036A READ_WRITE /end MEASUREMENT
/begin MEASUREMENT DIAG_ACAN.BSG_EXPA.IN_ANA_09_DIAG.Task4 "Diagnosis Input" UWORD COMP_DEFAULT 0 0 0 65535 ECU_ADDRESS 0x204036C READ_WRITE /end MEASUREMENT
/begin MEASUREMENT DIAG_ACAN.BSG_EXPA.IN_ANA_11_DIAG.Task4 "Diagnosis Input" UWORD COMP_DEFAULT 0 0 0 65535 ECU_ADDRESS 0x204036E READ_WRITE /end MEASUREMENT
/begin MEASUREMENT DIAG_ACAN.BSG_EXPA.IN_ANA_12_DIAG.Task4 "Diagnosis Input" UWORD COMP_DEFAULT 0 0 0 65535 ECU_ADDRESS 0x2040370 READ_WRITE /end MEASUREMENT
/begin MEASUREMENT DIAG_ACAN.BSG_EXPA.IN_DIG_01_DIAG.Task4 "Diagnosis Input" UWORD COMP_DEFAULT 0 0 0 65535 ECU_ADDRESS 0x2040372 READ_WRITE /end MEASUREMENT
/begin MEASUREMENT DIAG_ACAN.BSG_EXPA.IN_DIG_02_DIAG.Task4 "Diagnosis Input" UWORD COMP_DEFAULT 0 0 0 65535 ECU_ADDRESS 0x2040374 READ_WRITE /end MEASUREMENT
/begin MEASUREMENT DIAG_ACAN.BSG_EXPA.IN_DIG_03_DIAG.Task4 "Diagnosis Input" UWORD COMP_DEFAULT 0 0 0 65535 ECU_ADDRESS 0x2040376 READ_WRITE /end MEASUREMENT
/begin MEASUREMENT DIAG_ACAN.BSG_EXPA.IN_DIG_04_DIAG.Task4 "Diagnosis Input" UWORD COMP_DEFAULT 0 0 0 65535 ECU_ADDRESS 0x2040378 READ_WRITE /end MEASUREMENT
/begin MEASUREMENT DIAG_ACAN.BSG_EXPA.IN_DIG_05_DIAG.Task4 "Diagnosis Input" UWORD COMP_DEFAULT 0 0 0 65535 ECU_ADDRESS 0x204037A READ_WRITE /end MEASUREMENT
/begin MEASUREMENT DIAG_ACAN.BSG_EXPA.IN_DIG_06_DIAG.Task4 "Diagnosis Input" UWORD COMP_DEFAULT 0 0 0 65535 ECU_ADDRESS 0x204037C READ_WRITE /end MEASUREMENT
/begin MEASUREMENT DIAG_ACAN.BSG_EXPA.IN_DIG_07_DIAG.Task4 "Diagnosis Input" UWORD COMP_DEFAULT 0 0 0 65535 ECU_ADDRESS 0x204037E READ_WRITE /end MEASUREMENT
/begin MEASUREMENT DIAG_ACAN.BSG_EXPA.IN_DIG_08_DIAG.Task4 "Diagnosis Input" UWORD COMP_DEFAULT 0 0 0 65535 ECU_ADDRESS 0x2040380 READ_WRITE /end MEASUREMENT
/begin MEASUREMENT DIAG_ACAN.BSG_EXPA.IN_DIG_09_DIAG.Task4 "Diagnosis Input" UWORD COMP_DEFAULT 0 0 0 65535 ECU_ADDRESS 0x2040382 READ_WRITE /end MEASUREMENT
/begin MEASUREMENT DIAG_ACAN.BSG_EXPA.IN_DIG_10_DIAG.Task4 "Diagnosis Input" UWORD COMP_DEFAULT 0 0 0 65535 ECU_ADDRESS 0x2040384 READ_WRITE /end MEASUREMENT
/begin MEASUREMENT DIAG_ACAN.BSG_EXPA.IN_DIG_11_DIAG.Task4 "Diagnosis Input" UWORD COMP_DEFAULT 0 0 0 65535 ECU_ADDRESS 0x2040386 READ_WRITE /end MEASUREMENT
/begin MEASUREMENT DIAG_ACAN.BSG_EXPA.IN_DIG_12_DIAG.Task4 "Diagnosis Input" UWORD COMP_DEFAULT 0 0 0 65535 ECU_ADDRESS 0x2040388 READ_WRITE /end MEASUREMENT
/begin MEASUREMENT DIAG_ACAN.BSG_EXPA.IN_DIG_13_DIAG.Task4 "Diagnosis Input" UWORD COMP_DEFAULT 0 0 0 65535 ECU_ADDRESS 0x204038A READ_WRITE /end MEASUREMENT
/begin MEASUREMENT DIAG_ACAN.BSG_EXPA.IN_DIG_14_DIAG.Task4 "Diagnosis Input" UWORD COMP_DEFAULT 0 0 0 65535 ECU_ADDRESS 0x204038C READ_WRITE /end MEASUREMENT
/begin MEASUREMENT DIAG_ACAN.BSG_EXPA.IN_DIG_15_DIAG.Task4 "Diagnosis Input" UWORD COMP_DEFAULT 0 0 0 65535 ECU_ADDRESS 0x204038E READ_WRITE /end MEASUREMENT
/begin MEASUREMENT DIAG_ACAN.BSG_EXPA.IN_DIG_16_DIAG.Task4 "Diagnosis Input" UWORD COMP_DEFAULT 0 0 0 65535 ECU_ADDRESS 0x2040390 READ_WRITE /end MEASUREMENT
/begin MEASUREMENT DIAG_ACAN.BSG_EXPA.IN_DIG_17_DIAG.Task4 "Diagnosis Input" UWORD COMP_DEFAULT 0 0 0 65535 ECU_ADDRESS 0x2040392 READ_WRITE /end MEASUREMENT
/begin MEASUREMENT DIAG_ACAN.BSG_EXPA.IN_DIG_18_DIAG.Task4 "Diagnosis Input" UWORD COMP_DEFAULT 0 0 0 65535 ECU_ADDRESS 0x2040394 READ_WRITE /end MEASUREMENT
/begin MEASUREMENT DIAG_ACAN.BSG_EXPA.IN_DIG_19_DIAG.Task4 "Diagnosis Input" UWORD COMP_DEFAULT 0 0 0 65535 ECU_ADDRESS 0x2040396 READ_WRITE /end MEASUREMENT
/begin MEASUREMENT DIAG_ACAN.BSG_EXPA.IN_DIG_20_DIAG.Task4 "Diagnosis Input" UWORD COMP_DEFAULT 0 0 0 65535 ECU_ADDRESS 0x2040398 READ_WRITE /end MEASUREMENT
/begin MEASUREMENT DIAG_ACAN.BSG_EXPA.IN_DIG_21_DIAG.Task4 "Diagnosis Input" UWORD COMP_DEFAULT 0 0 0 65535 ECU_ADDRESS 0x204039A READ_WRITE /end MEASUREMENT
/begin MEASUREMENT DIAG_ACAN.BSG_EXPA.IN_DIG_22_DIAG.Task4 "Diagnosis Input" UWORD COMP_DEFAULT 0 0 0 65535 ECU_ADDRESS 0x204039C READ_WRITE /end MEASUREMENT
/begin MEASUREMENT DIAG_ACAN.BSG_EXPA.IN_PWR_DIAG.Task4 "Diagnosis Input" UWORD COMP_DEFAULT 0 0 0 65535 ECU_ADDRESS 0x204039E READ_WRITE /end MEASUREMENT
/begin MEASUREMENT DIAG_ACAN.BSG_EXPA.IN_PWR_G1_DIAG.Task4 "Diagnosis Input" UWORD COMP_DEFAULT 0 0 0 65535 ECU_ADDRESS 0x20403A0 READ_WRITE /end MEASUREMENT
/begin MEASUREMENT DIAG_ACAN.BSG_EXPA.IN_PWR_G2_DIAG.Task4 "Diagnosis Input" UWORD COMP_DEFAULT 0 0 0 65535 ECU_ADDRESS 0x20403A2 READ_WRITE /end MEASUREMENT
/begin MEASUREMENT DIAG_ACAN.BSG_EXPA.IN_PWR_G3_DIAG.Task4 "Diagnosis Input" UWORD COMP_DEFAULT 0 0 0 65535 ECU_ADDRESS 0x20403A4 READ_WRITE /end MEASUREMENT
/begin MEASUREMENT DIAG_ACAN.BSG_EXPA.IN_PWR_G4_DIAG.Task4 "Diagnosis Input" UWORD COMP_DEFAULT 0 0 0 65535 ECU_ADDRESS 0x20403A6 READ_WRITE /end MEASUREMENT
/begin MEASUREMENT DIAG_ACAN.BSG_EXPA.IN_PWR_G5_DIAG.Task4 "Diagnosis Input" UWORD COMP_DEFAULT 0 0 0 65535 ECU_ADDRESS 0x20403A8 READ_WRITE /end MEASUREMENT
/begin MEASUREMENT DIAG_ACAN.BSG_EXPA.OUT_01_HB_DIAG.Task4 "Diagnosis Input" UWORD COMP_DEFAULT 0 0 0 65535 ECU_ADDRESS 0x20403AA READ_WRITE /end MEASUREMENT
/begin MEASUREMENT DIAG_ACAN.BSG_EXPA.OUT_02_HB_DIAG.Task4 "Diagnosis Input" UWORD COMP_DEFAULT 0 0 0 65535 ECU_ADDRESS 0x20403AC READ_WRITE /end MEASUREMENT
/begin MEASUREMENT DIAG_ACAN.BSG_EXPA.OUT_03_DIAG.Task4 "Diagnosis Input" UWORD COMP_DEFAULT 0 0 0 65535 ECU_ADDRESS 0x20403AE READ_WRITE /end MEASUREMENT
/begin MEASUREMENT DIAG_ACAN.BSG_EXPA.OUT_04_DIAG.Task4 "Diagnosis Input" UWORD COMP_DEFAULT 0 0 0 65535 ECU_ADDRESS 0x20403B0 READ_WRITE /end MEASUREMENT
/begin MEASUREMENT DIAG_ACAN.BSG_EXPA.OUT_05_HB_DIAG.Task4 "Diagnosis Input" UWORD COMP_DEFAULT 0 0 0 65535 ECU_ADDRESS 0x20403B2 READ_WRITE /end MEASUREMENT
/begin MEASUREMENT DIAG_ACAN.BSG_EXPA.OUT_06_HB_DIAG.Task4 "Diagnosis Input" UWORD COMP_DEFAULT 0 0 0 65535 ECU_ADDRESS 0x20403B4 READ_WRITE /end MEASUREMENT
/begin MEASUREMENT DIAG_ACAN.BSG_EXPA.OUT_07_HB_DIAG.Task4 "Diagnosis Input" UWORD COMP_DEFAULT 0 0 0 65535 ECU_ADDRESS 0x20403B6 READ_WRITE /end MEASUREMENT
/begin MEASUREMENT DIAG_ACAN.BSG_EXPA.OUT_08_HB_DIAG.Task4 "Diagnosis Input" UWORD COMP_DEFAULT 0 0 0 65535 ECU_ADDRESS 0x20403B8 READ_WRITE /end MEASUREMENT
/begin MEASUREMENT DIAG_ACAN.BSG_EXPA.OUT_09_HB_DIAG.Task4 "Diagnosis Input" UWORD COMP_DEFAULT 0 0 0 65535 ECU_ADDRESS 0x20403BA READ_WRITE /end MEASUREMENT
/begin MEASUREMENT DIAG_ACAN.BSG_EXPA.OUT_10_HB_DIAG.Task4 "Diagnosis Input" UWORD COMP_DEFAULT 0 0 0 65535 ECU_ADDRESS 0x20403BC READ_WRITE /end MEASUREMENT
/begin MEASUREMENT DIAG_ACAN.BSG_EXPA.OUT_11_DIAG.Task4 "Diagnosis Input" UWORD COMP_DEFAULT 0 0 0 65535 ECU_ADDRESS 0x20403BE READ_WRITE /end MEASUREMENT
/begin MEASUREMENT DIAG_ACAN.BSG_EXPA.OUT_12_DIAG.Task4 "Diagnosis Input" UWORD COMP_DEFAULT 0 0 0 65535 ECU_ADDRESS 0x20403C0 READ_WRITE /end MEASUREMENT
/begin MEASUREMENT DIAG_ACAN.BSG_EXPA.OUT_12_SENSE_PULSE_DIAG.Task4 "Diagnostic Input" UWORD COMP_DEFAULT 0 0 0 65535 ECU_ADDRESS 0x20403C2 READ_WRITE /end MEASUREMENT
/begin MEASUREMENT DIAG_ACAN.BSG_EXPA.OUT_12_TD_DIAG.Task4 "Diagnosis Input" UWORD COMP_DEFAULT 0 0 0 65535 ECU_ADDRESS 0x20403C4 READ_WRITE /end MEASUREMENT
/begin MEASUREMENT DIAG_ACAN.BSG_EXPA.OUT_13_DIAG.Task4 "Diagnosis Input" UWORD COMP_DEFAULT 0 0 0 65535 ECU_ADDRESS 0x20403C6 READ_WRITE /end MEASUREMENT
/begin MEASUREMENT DIAG_ACAN.BSG_EXPA.OUT_14_DIAG.Task4 "Diagnosis Input" UWORD COMP_DEFAULT 0 0 0 65535 ECU_ADDRESS 0x20403C8 READ_WRITE /end MEASUREMENT
/begin MEASUREMENT DIAG_ACAN.BSG_EXPA.OUT_15_DIAG.Task4 "Diagnosis Input" UWORD COMP_DEFAULT 0 0 0 65535 ECU_ADDRESS 0x20403CA READ_WRITE /end MEASUREMENT
/begin MEASUREMENT DIAG_ACAN.BSG_EXPA.OUT_16_DIAG.Task4 "Diagnosis Input" UWORD COMP_DEFAULT 0 0 0 65535 ECU_ADDRESS 0x20403CC READ_WRITE /end MEASUREMENT
/begin MEASUREMENT DIAG_ACAN.BSG_EXPA.OUT_17_DIAG.Task4 "Diagnosis Input" UWORD COMP_DEFAULT 0 0 0 65535 ECU_ADDRESS 0x20403CE READ_WRITE /end MEASUREMENT
/begin MEASUREMENT DIAG_ACAN.BSG_EXPA.OUT_18_DIAG.Task4 "Diagnosis Input" UWORD COMP_DEFAULT 0 0 0 65535 ECU_ADDRESS 0x20403D0 READ_WRITE /end MEASUREMENT
/begin MEASUREMENT DIAG_ACAN.BSG_EXPA.OUT_19_DIAG.Task4 "Diagnosis Input" UWORD COMP_DEFAULT 0 0 0 65535 ECU_ADDRESS 0x20403D2 READ_WRITE /end MEASUREMENT
/begin MEASUREMENT DIAG_ACAN.BSG_EXPA.OUT_20_DIAG.Task4 "Diagnosis Input" UWORD COMP_DEFAULT 0 0 0 65535 ECU_ADDRESS 0x20403D4 READ_WRITE /end MEASUREMENT
/begin MEASUREMENT DIAG_ACAN.BSG_EXPA.OUT_21_DIAG.Task4 "Diagnosis Input" UWORD COMP_DEFAULT 0 0 0 65535 ECU_ADDRESS 0x20403D6 READ_WRITE /end MEASUREMENT
/begin MEASUREMENT DIAG_ACAN.BSG_EXPA.OUT_21_SENSE_PULSE_DIAG.Task4 "Diagnostic Input" UWORD COMP_DEFAULT 0 0 0 65535 ECU_ADDRESS 0x20403D8 READ_WRITE /end MEASUREMENT
/begin MEASUREMENT DIAG_ACAN.BSG_EXPA.OUT_21_TD_DIAG.Task4 "Diagnosis Input" UWORD COMP_DEFAULT 0 0 0 65535 ECU_ADDRESS 0x20403DA READ_WRITE /end MEASUREMENT
/begin MEASUREMENT DIAG_ACAN.BSG_EXPA.OUT_22_DIAG.Task4 "Diagnosis Input" UWORD COMP_DEFAULT 0 0 0 65535 ECU_ADDRESS 0x20403DC READ_WRITE /end MEASUREMENT
/begin MEASUREMENT DIAG_ACAN.BSG_EXPA.OUT_23_DIAG.Task4 "Diagnosis Input" UWORD COMP_DEFAULT 0 0 0 65535 ECU_ADDRESS 0x20403DE READ_WRITE /end MEASUREMENT
/begin MEASUREMENT DIAG_ACAN.BSG_EXPA.OUT_24_DIAG.Task4 "Diagnosis Input" UWORD COMP_DEFAULT 0 0 0 65535 ECU_ADDRESS 0x20403E0 READ_WRITE /end MEASUREMENT
/begin MEASUREMENT DIAG_ACAN.BSG_EXPA.OUT_25_DIAG.Task4 "Diagnosis Input" UWORD COMP_DEFAULT 0 0 0 65535 ECU_ADDRESS 0x20403E2 READ_WRITE /end MEASUREMENT
/begin MEASUREMENT DIAG_ACAN.BSG_EXPA.OUT_26_DIAG.Task4 "Diagnosis Input" UWORD COMP_DEFAULT 0 0 0 65535 ECU_ADDRESS 0x20403E4 READ_WRITE /end MEASUREMENT
/begin MEASUREMENT DIAG_ACAN.BSG_EXPA.OUT_27_DIAG.Task4 "Diagnosis Input" UWORD COMP_DEFAULT 0 0 0 65535 ECU_ADDRESS 0x20403E6 READ_WRITE /end MEASUREMENT
/begin MEASUREMENT DIAG_ACAN.BSG_EXPA.OUT_28_DIAG.Task4 "Diagnosis Input" UWORD COMP_DEFAULT 0 0 0 65535 ECU_ADDRESS 0x20403E8 READ_WRITE /end MEASUREMENT
/begin MEASUREMENT DIAG_ACAN.BSG_EXPA.OUT_29_HB_DIAG.Task4 "Diagnosis Input" UWORD COMP_DEFAULT 0 0 0 65535 ECU_ADDRESS 0x20403EA READ_WRITE /end MEASUREMENT
/begin MEASUREMENT DIAG_ACAN.BSG_EXPA.OUT_30_HB_DIAG.Task4 "Diagnostic Input" UWORD COMP_DEFAULT 0 0 0 65535 ECU_ADDRESS 0x20403EC READ_WRITE /end MEASUREMENT
/begin MEASUREMENT DIAG_ACAN.BSG_EXPA.OUT_31_HB_DIAG.Task4 "Diagnosis Input" UWORD COMP_DEFAULT 0 0 0 65535 ECU_ADDRESS 0x20403EE READ_WRITE /end MEASUREMENT
/begin MEASUREMENT DIAG_ACAN.BSG_EXPA.OUT_32_HB_DIAG.Task4 "Diagnosis Input" UWORD COMP_DEFAULT 0 0 0 65535 ECU_ADDRESS 0x20403F0 READ_WRITE /end MEASUREMENT
/begin MEASUREMENT DIAG_ACAN.BSG_EXPA.OUT_33_HB_DIAG.Task4 "Diagnostic Input" UWORD COMP_DEFAULT 0 0 0 65535 ECU_ADDRESS 0x20403F2 READ_WRITE /end MEASUREMENT
/begin MEASUREMENT DIAG_ACAN.BSG_EXPA.OUT_34_HB_DIAG.Task4 "Diagnosis Input" UWORD COMP_DEFAULT 0 0 0 65535 ECU_ADDRESS 0x20403F4 READ_WRITE /end MEASUREMENT
/begin MEASUREMENT DIAG_ACAN.BSG_EXPA.OUT_ANA_PWR_01_DIAG.Task4 "Diagnosis Input" UWORD COMP_DEFAULT 0 0 0 65535 ECU_ADDRESS 0x20403F6 READ_WRITE /end MEASUREMENT
/begin MEASUREMENT OUT_ACAN.GW_18DAF1E1.MessageEnable.Task2 "3.1.2.2.1 MessageEnable" UBYTE IS_BOOLEAN_TRUE 0 0 0 1 ECU_ADDRESS 0x2049041 READ_WRITE /end MEASUREMENT
/begin MEASUREMENT IN_PCAN.Rx_Ctrl.Out_PWM_Ctrl.MessageState.Task3 "3.2.2.1.1 MessageState" UWORD COMP_DEFAULT 0 0 0 65535 ECU_ADDRESS 0x2040338 READ_WRITE /end MEASUREMENT
/begin MEASUREMENT IN_PCAN.Rx_Ctrl.Out_PWM_Ctrl.Out_20_PWM_Ctrl.Task3 "" UBYTE COMP_DEFAULT 0 0 0 255 ECU_ADDRESS 0x204033A READ_WRITE /end MEASUREMENT
/begin MEASUREMENT IN_PCAN.Rx_Ctrl.Out_PWM_Ctrl.Out_21_PWM_Ctrl.Task3 "" UBYTE COMP_DEFAULT 0 0 0 255 ECU_ADDRESS 0x204033B READ_WRITE /end MEASUREMENT
/begin MEASUREMENT IN_PCAN.Rx_Ctrl.Out_PWM_Ctrl.Out_22_PWM_Ctrl.Task3 "" UBYTE COMP_DEFAULT 0 0 0 255 ECU_ADDRESS 0x204033C READ_WRITE /end MEASUREMENT
/begin MEASUREMENT IN_PCAN.Rx_Ctrl.Out_PWM_Ctrl.Out_23_PWM_Ctrl.Task3 "" UBYTE COMP_DEFAULT 0 0 0 255 ECU_ADDRESS 0x204033D READ_WRITE /end MEASUREMENT
/begin MEASUREMENT IN_PCAN.Rx_Ctrl.Out_PWM_Ctrl.Out_24_PWM_Ctrl.Task3 "" UBYTE COMP_DEFAULT 0 0 0 255 ECU_ADDRESS 0x204033E READ_WRITE /end MEASUREMENT
/begin MEASUREMENT IN_PCAN.Rx_Ctrl.Out_PWM_Ctrl.Out_25_PWM_Ctrl.Task3 "" UBYTE COMP_DEFAULT 0 0 0 255 ECU_ADDRESS 0x204033F READ_WRITE /end MEASUREMENT
/begin MEASUREMENT IN_PCAN.Rx_Ctrl.Out_PWM_Ctrl.Out_26_PWM_Ctrl.Task3 "" UBYTE COMP_DEFAULT 0 0 0 255 ECU_ADDRESS 0x2040340 READ_WRITE /end MEASUREMENT
/begin MEASUREMENT IN_PCAN.Rx_Ctrl.Out_PWM_Ctrl.Out_27_PWM_Ctrl.Task3 "" UBYTE COMP_DEFAULT 0 0 0 255 ECU_ADDRESS 0x2040341 READ_WRITE /end MEASUREMENT
/begin MEASUREMENT OUT_PCAN.Rx_Ctrl.Out_PWM_Ctrl.MessageEnable.Task3 "3.2.2.2.1 MessageEnable" UBYTE IS_BOOLEAN_TRUE 0 0 0 1 ECU_ADDRESS 0x204A031 READ_WRITE /end MEASUREMENT
/begin MEASUREMENT IN_PCAN.Rx_Ctrl.Out_Ctrl.MessageState.Task3 "3.2.2.1.1 MessageState" UWORD COMP_DEFAULT 0 0 0 65535 ECU_ADDRESS 0x2040342 READ_WRITE /end MEASUREMENT
/begin MEASUREMENT IN_PCAN.Rx_Ctrl.Out_Ctrl.Out_01_Ctrl.Task3 "" UBYTE IS_BOOLEAN_TRUE 0 0 0 1 ECU_ADDRESS 0x2040344 READ_WRITE /end MEASUREMENT
/begin MEASUREMENT IN_PCAN.Rx_Ctrl.Out_Ctrl.Out_02_Ctrl.Task3 "" UBYTE IS_BOOLEAN_TRUE 0 0 0 1 ECU_ADDRESS 0x2040345 READ_WRITE /end MEASUREMENT
/begin MEASUREMENT IN_PCAN.Rx_Ctrl.Out_Ctrl.Out_03_Ctrl.Task3 "" UBYTE IS_BOOLEAN_TRUE 0 0 0 1 ECU_ADDRESS 0x2040346 READ_WRITE /end MEASUREMENT
/begin MEASUREMENT IN_PCAN.Rx_Ctrl.Out_Ctrl.Out_04_Ctrl.Task3 "" UBYTE IS_BOOLEAN_TRUE 0 0 0 1 ECU_ADDRESS 0x2040347 READ_WRITE /end MEASUREMENT
/begin MEASUREMENT IN_PCAN.Rx_Ctrl.Out_Ctrl.Out_05_Ctrl.Task3 "" UBYTE IS_BOOLEAN_TRUE 0 0 0 1 ECU_ADDRESS 0x2040348 READ_WRITE /end MEASUREMENT
/begin MEASUREMENT IN_PCAN.Rx_Ctrl.Out_Ctrl.Out_06_Ctrl.Task3 "" UBYTE IS_BOOLEAN_TRUE 0 0 0 1 ECU_ADDRESS 0x2040349 READ_WRITE /end MEASUREMENT
/begin MEASUREMENT IN_PCAN.Rx_Ctrl.Out_Ctrl.Out_07_Ctrl.Task3 "" UBYTE IS_BOOLEAN_TRUE 0 0 0 1 ECU_ADDRESS 0x204034A READ_WRITE /end MEASUREMENT
/begin MEASUREMENT IN_PCAN.Rx_Ctrl.Out_Ctrl.Out_08_Ctrl.Task3 "" UBYTE IS_BOOLEAN_TRUE 0 0 0 1 ECU_ADDRESS 0x204034B READ_WRITE /end MEASUREMENT
/begin MEASUREMENT IN_PCAN.Rx_Ctrl.Out_Ctrl.Out_09_Ctrl.Task3 "" UBYTE IS_BOOLEAN_TRUE 0 0 0 1 ECU_ADDRESS 0x204034C READ_WRITE /end MEASUREMENT
/begin MEASUREMENT IN_PCAN.Rx_Ctrl.Out_Ctrl.Out_10_Ctrl.Task3 "" UBYTE IS_BOOLEAN_TRUE 0 0 0 1 ECU_ADDRESS 0x204034D READ_WRITE /end MEASUREMENT
/begin MEASUREMENT IN_PCAN.Rx_Ctrl.Out_Ctrl.Out_11_Ctrl.Task3 "" UBYTE IS_BOOLEAN_TRUE 0 0 0 1 ECU_ADDRESS 0x204034E READ_WRITE /end MEASUREMENT
/begin MEASUREMENT IN_PCAN.Rx_Ctrl.Out_Ctrl.Out_12_Ctrl.Task3 "" UBYTE IS_BOOLEAN_TRUE 0 0 0 1 ECU_ADDRESS 0x204034F READ_WRITE /end MEASUREMENT
/begin MEASUREMENT IN_PCAN.Rx_Ctrl.Out_Ctrl.Out_13_Ctrl.Task3 "" UBYTE IS_BOOLEAN_TRUE 0 0 0 1 ECU_ADDRESS 0x2040350 READ_WRITE /end MEASUREMENT
/begin MEASUREMENT IN_PCAN.Rx_Ctrl.Out_Ctrl.Out_14_Ctrl.Task3 "" UBYTE IS_BOOLEAN_TRUE 0 0 0 1 ECU_ADDRESS 0x2040351 READ_WRITE /end MEASUREMENT
/begin MEASUREMENT IN_PCAN.Rx_Ctrl.Out_Ctrl.Out_15_Ctrl.Task3 "" UBYTE IS_BOOLEAN_TRUE 0 0 0 1 ECU_ADDRESS 0x2040352 READ_WRITE /end MEASUREMENT
/begin MEASUREMENT IN_PCAN.Rx_Ctrl.Out_Ctrl.Out_16_Ctrl.Task3 "" UBYTE IS_BOOLEAN_TRUE 0 0 0 1 ECU_ADDRESS 0x2040353 READ_WRITE /end MEASUREMENT
/begin MEASUREMENT IN_PCAN.Rx_Ctrl.Out_Ctrl.Out_17_Ctrl.Task3 "" UBYTE IS_BOOLEAN_TRUE 0 0 0 1 ECU_ADDRESS 0x2040354 READ_WRITE /end MEASUREMENT
/begin MEASUREMENT IN_PCAN.Rx_Ctrl.Out_Ctrl.Out_18_PWM_Ctrl.Task3 "" UBYTE COMP_DEFAULT 0 0 0 255 ECU_ADDRESS 0x2040355 READ_WRITE /end MEASUREMENT
/begin MEASUREMENT IN_PCAN.Rx_Ctrl.Out_Ctrl.Out_19_Ctrl.Task3 "" UBYTE IS_BOOLEAN_TRUE 0 0 0 1 ECU_ADDRESS 0x2040356 READ_WRITE /end MEASUREMENT
/begin MEASUREMENT IN_PCAN.Rx_Ctrl.Out_Ctrl.Out_Supply_ANA_01_Ctrl.Task3 "" UBYTE IS_BOOLEAN_TRUE 0 0 0 1 ECU_ADDRESS 0x2040357 READ_WRITE /end MEASUREMENT
/begin MEASUREMENT IN_PCAN.Rx_Ctrl.Out_Ctrl.Out_Supply_ANA_02_Ctrl.Task3 "" UBYTE IS_BOOLEAN_TRUE 0 0 0 1 ECU_ADDRESS 0x2040358 READ_WRITE /end MEASUREMENT
/begin MEASUREMENT IN_PCAN.Rx_Ctrl.Out_Ctrl.Out_Supply_ANA_03_Ctrl.Task3 "" UBYTE IS_BOOLEAN_TRUE 0 0 0 1 ECU_ADDRESS 0x2040359 READ_WRITE /end MEASUREMENT
/begin MEASUREMENT IN_PCAN.Rx_Ctrl.Out_Ctrl.WorkingMode.Task3 "" UBYTE IS_BOOLEAN_TRUE 0 0 0 1 ECU_ADDRESS 0x204035A READ_WRITE /end MEASUREMENT
/begin MEASUREMENT OUT_PCAN.Rx_Ctrl.Out_Ctrl.MessageEnable.Task3 "3.2.2.2.1 MessageEnable" UBYTE IS_BOOLEAN_TRUE 0 0 0 1 ECU_ADDRESS 0x204A032 READ_WRITE /end MEASUREMENT
/begin MEASUREMENT IN_PCAN.Rx_Ctrl.DateTime_SetTime_Ctrl.DateTime_NewSystemTime.Task5 "" ULONG COMP_DEFAULT 0 0 0 4294967295 ECU_ADDRESS 0x2040204 READ_WRITE /end MEASUREMENT
/begin MEASUREMENT IN_PCAN.Rx_Ctrl.DateTime_SetTime_Ctrl.MessageState.Task5 "3.2.2.1.1 MessageState" UWORD COMP_DEFAULT 0 0 0 65535 ECU_ADDRESS 0x2040208 READ_WRITE /end MEASUREMENT
/begin MEASUREMENT IN_PCAN.Rx_Ctrl.DateTime_SetTime_Ctrl.DateTime_HourOffset.Task5 "" UBYTE COMP_DEFAULT 0 0 0 255 ECU_ADDRESS 0x204020A READ_WRITE /end MEASUREMENT
/begin MEASUREMENT IN_PCAN.Rx_Ctrl.DateTime_SetTime_Ctrl.DateTime_MinuteOffset.Task5 "" UBYTE COMP_DEFAULT 0 0 0 255 ECU_ADDRESS 0x204020B READ_WRITE /end MEASUREMENT
/begin MEASUREMENT IN_PCAN.Rx_Ctrl.DateTime_SetTime_Ctrl.DateTime_SetTime.Task5 "" UBYTE IS_BOOLEAN_TRUE 0 0 0 1 ECU_ADDRESS 0x204020C READ_WRITE /end MEASUREMENT
/begin MEASUREMENT OUT_PCAN.Rx_Ctrl.DateTime_SetTime_Ctrl.MessageEnable.Task5 "3.2.2.2.1 MessageEnable" UBYTE IS_BOOLEAN_TRUE 0 0 0 1 ECU_ADDRESS 0x204C00C READ_WRITE /end MEASUREMENT
/begin MEASUREMENT IN_PCAN.Rx_Ctrl.In_Ana_Ctrl.MessageState.Task3 "3.2.2.1.1 MessageState" UWORD COMP_DEFAULT 0 0 0 65535 ECU_ADDRESS 0x2040332 READ_WRITE /end MEASUREMENT
/begin MEASUREMENT IN_PCAN.Rx_Ctrl.In_Ana_Ctrl.IN_ANA_08_SWT1.Task3 "" UBYTE IS_BOOLEAN_TRUE 0 0 0 0 ECU_ADDRESS 0x2040334 READ_WRITE /end MEASUREMENT
/begin MEASUREMENT IN_PCAN.Rx_Ctrl.In_Ana_Ctrl.IN_ANA_09_SWT1.Task3 "" UBYTE IS_BOOLEAN_TRUE 0 0 0 0 ECU_ADDRESS 0x2040335 READ_WRITE /end MEASUREMENT
/begin MEASUREMENT IN_PCAN.Rx_Ctrl.In_Ana_Ctrl.IN_ANA_10_SWT1.Task3 "" UBYTE IS_BOOLEAN_TRUE 0 0 0 0 ECU_ADDRESS 0x2040336 READ_WRITE /end MEASUREMENT
/begin MEASUREMENT IN_PCAN.Rx_Ctrl.In_Ana_Ctrl.IN_ANA_11_SWT1.Task3 "" UBYTE IS_BOOLEAN_TRUE 0 0 0 0 ECU_ADDRESS 0x2040337 READ_WRITE /end MEASUREMENT
/begin MEASUREMENT OUT_PCAN.Rx_Ctrl.In_Ana_Ctrl.MessageEnable.Task3 "3.2.2.2.1 MessageEnable" UBYTE IS_BOOLEAN_TRUE 0 0 0 1 ECU_ADDRESS 0x204A030 READ_WRITE /end MEASUREMENT
/begin MEASUREMENT OUT_PCAN.Tx_Out.Out_20_TD_Sts.Out_SENSE_PULSE.Task3 "" UWORD COMP_DEFAULT 0 0 0 0 ECU_ADDRESS 0x204A03A READ_WRITE /end MEASUREMENT
/begin MEASUREMENT OUT_PCAN.Tx_Out.Out_20_TD_Sts.Out_SENSE_PULSE_DIAG.Task3 "" UWORD COMP_DEFAULT 0 0 0 0 ECU_ADDRESS 0x204A03C READ_WRITE /end MEASUREMENT
/begin MEASUREMENT OUT_PCAN.Tx_Out.Out_20_TD_Sts.MessageEnable.Task3 "3.3.2.2.1 MessageEnable" UBYTE IS_BOOLEAN_TRUE 0 0 0 1 ECU_ADDRESS 0x204A03E READ_WRITE /end MEASUREMENT
/begin MEASUREMENT OUT_PCAN.Tx_Out.Out_15_TD_Sts.Out_SENSE_PULSE.Task3 "" UWORD COMP_DEFAULT 0 0 0 0 ECU_ADDRESS 0x204A040 READ_WRITE /end MEASUREMENT
/begin MEASUREMENT OUT_PCAN.Tx_Out.Out_15_TD_Sts.Out_SENSE_PULSE_DIAG.Task3 "" UWORD COMP_DEFAULT 0 0 0 0 ECU_ADDRESS 0x204A042 READ_WRITE /end MEASUREMENT
/begin MEASUREMENT OUT_PCAN.Tx_Out.Out_15_TD_Sts.MessageEnable.Task3 "3.3.2.2.1 MessageEnable" UBYTE IS_BOOLEAN_TRUE 0 0 0 1 ECU_ADDRESS 0x204A044 READ_WRITE /end MEASUREMENT
/begin MEASUREMENT OUT_PCAN.Tx_Out.Out_14_TD_Sts.Out_SENSE_PULSE.Task3 "" UWORD COMP_DEFAULT 0 0 0 0 ECU_ADDRESS 0x204A046 READ_WRITE /end MEASUREMENT
/begin MEASUREMENT OUT_PCAN.Tx_Out.Out_14_TD_Sts.Out_SENSE_PULSE_DIAG.Task3 "" UWORD COMP_DEFAULT 0 0 0 0 ECU_ADDRESS 0x204A048 READ_WRITE /end MEASUREMENT
/begin MEASUREMENT OUT_PCAN.Tx_Out.Out_14_TD_Sts.MessageEnable.Task3 "3.3.2.2.1 MessageEnable" UBYTE IS_BOOLEAN_TRUE 0 0 0 1 ECU_ADDRESS 0x204A04A READ_WRITE /end MEASUREMENT
/begin MEASUREMENT OUT_PCAN.Tx_Out.Out_13_TD_Sts.Out_SENSE_PULSE.Task3 "" UWORD COMP_DEFAULT 0 0 0 0 ECU_ADDRESS 0x204A04C READ_WRITE /end MEASUREMENT
/begin MEASUREMENT OUT_PCAN.Tx_Out.Out_13_TD_Sts.Out_SENSE_PULSE_DIAG.Task3 "" UWORD COMP_DEFAULT 0 0 0 0 ECU_ADDRESS 0x204A04E READ_WRITE /end MEASUREMENT
/begin MEASUREMENT OUT_PCAN.Tx_Out.Out_13_TD_Sts.MessageEnable.Task3 "3.3.2.2.1 MessageEnable" UBYTE IS_BOOLEAN_TRUE 0 0 0 1 ECU_ADDRESS 0x204A050 READ_WRITE /end MEASUREMENT
/begin MEASUREMENT OUT_PCAN.Tx_Out.Out_12_TD_Sts.Out_SENSE_PULSE.Task3 "" UWORD COMP_DEFAULT 0 0 0 0 ECU_ADDRESS 0x204A052 READ_WRITE /end MEASUREMENT
/begin MEASUREMENT OUT_PCAN.Tx_Out.Out_12_TD_Sts.Out_SENSE_PULSE_DIAG.Task3 "" UWORD COMP_DEFAULT 0 0 0 0 ECU_ADDRESS 0x204A054 READ_WRITE /end MEASUREMENT
/begin MEASUREMENT OUT_PCAN.Tx_Out.Out_12_TD_Sts.MessageEnable.Task3 "3.3.2.2.1 MessageEnable" UBYTE IS_BOOLEAN_TRUE 0 0 0 1 ECU_ADDRESS 0x204A056 READ_WRITE /end MEASUREMENT
/begin MEASUREMENT OUT_PCAN.Tx_Out.Out_08_TD_Sts.Out_SENSE_PULSE.Task3 "" UWORD COMP_DEFAULT 0 0 0 0 ECU_ADDRESS 0x204A058 READ_WRITE /end MEASUREMENT
/begin MEASUREMENT OUT_PCAN.Tx_Out.Out_08_TD_Sts.Out_SENSE_PULSE_DIAG.Task3 "" UWORD COMP_DEFAULT 0 0 0 0 ECU_ADDRESS 0x204A05A READ_WRITE /end MEASUREMENT
/begin MEASUREMENT OUT_PCAN.Tx_Out.Out_08_TD_Sts.MessageEnable.Task3 "3.3.2.2.1 MessageEnable" UBYTE IS_BOOLEAN_TRUE 0 0 0 1 ECU_ADDRESS 0x204A05C READ_WRITE /end MEASUREMENT
/begin MEASUREMENT OUT_PCAN.Tx_Out.Out_07_TD_Sts.Out_SENSE_PULSE.Task3 "" UWORD COMP_DEFAULT 0 0 0 0 ECU_ADDRESS 0x204A05E READ_WRITE /end MEASUREMENT
/begin MEASUREMENT OUT_PCAN.Tx_Out.Out_07_TD_Sts.Out_SENSE_PULSE_DIAG.Task3 "" UWORD COMP_DEFAULT 0 0 0 0 ECU_ADDRESS 0x204A060 READ_WRITE /end MEASUREMENT
/begin MEASUREMENT OUT_PCAN.Tx_Out.Out_07_TD_Sts.MessageEnable.Task3 "3.3.2.2.1 MessageEnable" UBYTE IS_BOOLEAN_TRUE 0 0 0 1 ECU_ADDRESS 0x204A062 READ_WRITE /end MEASUREMENT
/begin GROUP SYSTEM.Date_and_Time "Date and Time"
 /begin ANNOTATION ANNOTATION_LABEL "Instance" ANNOTATION_ORIGIN "Group" /begin ANNOTATION_TEXT "0" /end ANNOTATION_TEXT /end ANNOTATION
 /begin ANNOTATION ANNOTATION_LABEL "TaskCycleTime" ANNOTATION_ORIGIN "Group" /begin ANNOTATION_TEXT "0" /end ANNOTATION_TEXT /end ANNOTATION
 /begin ANNOTATION ANNOTATION_LABEL "TimeResolution" ANNOTATION_ORIGIN "Group" /begin ANNOTATION_TEXT "0" /end ANNOTATION_TEXT /end ANNOTATION
 /begin REF_MEASUREMENT IN_DateandTime.LocalTime.Task5 IN_DateandTime.SystemTime.Task5 IN_DateandTime.TicksCount.Task5 OUT_DateandTime.NewSystemTime.Task5 OUT_DateandTime.HourOffset.Task5 OUT_DateandTime.MinuteOffset.Task5 OUT_DateandTime.SetTime.Task5 DIAG_DateandTime.LocalTime_DIAG.Task5 DIAG_DateandTime.SetTime_DIAG.Task5 DIAG_DateandTime.SystemTime_DIAG.Task5 /end REF_MEASUREMENT
/end GROUP
/begin GROUP SYSTEM.MCAN_Master "MCAN Master"
 /begin ANNOTATION ANNOTATION_LABEL "Instance" ANNOTATION_ORIGIN "Group" /begin ANNOTATION_TEXT "0" /end ANNOTATION_TEXT /end ANNOTATION
 /begin ANNOTATION ANNOTATION_LABEL "TaskCycleTime" ANNOTATION_ORIGIN "Group" /begin ANNOTATION_TEXT "0" /end ANNOTATION_TEXT /end ANNOTATION
 /begin ANNOTATION ANNOTATION_LABEL "TimeResolution" ANNOTATION_ORIGIN "Group" /begin ANNOTATION_TEXT "0" /end ANNOTATION_TEXT /end ANNOTATION
 /begin REF_MEASUREMENT OUT_MCANMaster.DeviceEnable.Task4 /end REF_MEASUREMENT
/end GROUP
/begin GROUP SYSTEM.Model_Control "Model Control"
 /begin ANNOTATION ANNOTATION_LABEL "Instance" ANNOTATION_ORIGIN "Group" /begin ANNOTATION_TEXT "0" /end ANNOTATION_TEXT /end ANNOTATION
 /begin ANNOTATION ANNOTATION_LABEL "TaskCycleTime" ANNOTATION_ORIGIN "Group" /begin ANNOTATION_TEXT "0" /end ANNOTATION_TEXT /end ANNOTATION
 /begin ANNOTATION ANNOTATION_LABEL "TimeResolution" ANNOTATION_ORIGIN "Group" /begin ANNOTATION_TEXT "0" /end ANNOTATION_TEXT /end ANNOTATION
 /begin REF_MEASUREMENT OUT_ModelControl.ModelHold.Task1 /end REF_MEASUREMENT
/end GROUP
/begin GROUP SYSTEM.Analog_Inputs__PWR_ "Analog Inputs (PWR)"
 /begin ANNOTATION ANNOTATION_LABEL "Instance" ANNOTATION_ORIGIN "Group" /begin ANNOTATION_TEXT "0" /end ANNOTATION_TEXT /end ANNOTATION
 /begin ANNOTATION ANNOTATION_LABEL "TaskCycleTime" ANNOTATION_ORIGIN "Group" /begin ANNOTATION_TEXT "0" /end ANNOTATION_TEXT /end ANNOTATION
 /begin ANNOTATION ANNOTATION_LABEL "TimeResolution" ANNOTATION_ORIGIN "Group" /begin ANNOTATION_TEXT "0" /end ANNOTATION_TEXT /end ANNOTATION
 /begin REF_MEASUREMENT IN_AnalogInputsPWR.IN_PWR.Task3 IN_AnalogInputsPWR.IN_PWR_G1.Task3 IN_AnalogInputsPWR.IN_PWR_G2.Task3 IN_AnalogInputsPWR.IN_PWR_G3.Task3 IN_AnalogInputsPWR.IN_PWR_G4.Task3 IN_AnalogInputsPWR.IN_PWR_G5.Task3 IN_AnalogInputsPWR.IN_PWR_G7.Task3 IN_AnalogInputsPWR.IN_PWR.Task5 DIAG_AnalogInputsPWR.IN_PWR_DIAG.Task3 DIAG_AnalogInputsPWR.IN_PWR_G1_DIAG.Task3 DIAG_AnalogInputsPWR.IN_PWR_G2_DIAG.Task3 DIAG_AnalogInputsPWR.IN_PWR_G3_DIAG.Task3 DIAG_AnalogInputsPWR.IN_PWR_G4_DIAG.Task3 DIAG_AnalogInputsPWR.IN_PWR_G5_DIAG.Task3 DIAG_AnalogInputsPWR.IN_PWR_G7_DIAG.Task3 /end REF_MEASUREMENT
/end GROUP
/begin GROUP SYSTEM.Analog_Inputs "Analog Inputs"
 /begin ANNOTATION ANNOTATION_LABEL "Instance" ANNOTATION_ORIGIN "Group" /begin ANNOTATION_TEXT "0" /end ANNOTATION_TEXT /end ANNOTATION
 /begin ANNOTATION ANNOTATION_LABEL "TaskCycleTime" ANNOTATION_ORIGIN "Group" /begin ANNOTATION_TEXT "0" /end ANNOTATION_TEXT /end ANNOTATION
 /begin ANNOTATION ANNOTATION_LABEL "TimeResolution" ANNOTATION_ORIGIN "Group" /begin ANNOTATION_TEXT "0" /end ANNOTATION_TEXT /end ANNOTATION
 /begin REF_MEASUREMENT IN_AnalogInputs.IN_ANA_01.Task3 IN_AnalogInputs.IN_ANA_02.Task3 IN_AnalogInputs.IN_ANA_03.Task3 IN_AnalogInputs.IN_ANA_04.Task3 IN_AnalogInputs.IN_ANA_05.Task3 IN_AnalogInputs.IN_ANA_06.Task3 IN_AnalogInputs.IN_ANA_07.Task3 IN_AnalogInputs.IN_ANA_08_SEL1.Task3 IN_AnalogInputs.IN_ANA_08_SEL2.Task3 IN_AnalogInputs.IN_ANA_09_SEL1.Task3 IN_AnalogInputs.IN_ANA_09_SEL2.Task3 IN_AnalogInputs.IN_ANA_10_SEL1.Task3 IN_AnalogInputs.IN_ANA_10_SEL2.Task3 IN_AnalogInputs.IN_ANA_11_SEL1.Task3 IN_AnalogInputs.IN_ANA_11_SEL2.Task3 DIAG_AnalogInputs.IN_ANA_01_DIAG.Task3 DIAG_AnalogInputs.IN_ANA_02_DIAG.Task3 DIAG_AnalogInputs.IN_ANA_03_DIAG.Task3 DIAG_AnalogInputs.IN_ANA_04_DIAG.Task3 DIAG_AnalogInputs.IN_ANA_05_DIAG.Task3 DIAG_AnalogInputs.IN_ANA_06_DIAG.Task3 DIAG_AnalogInputs.IN_ANA_07_DIAG.Task3 DIAG_AnalogInputs.IN_ANA_08_SEL1_DIAG.Task3 DIAG_AnalogInputs.IN_ANA_08_SEL2_DIAG.Task3 DIAG_AnalogInputs.IN_ANA_09_SEL1_DIAG.Task3 DIAG_AnalogInputs.IN_ANA_09_SEL2_DIAG.Task3 DIAG_AnalogInputs.IN_ANA_10_SEL1_DIAG.Task3 DIAG_AnalogInputs.IN_ANA_10_SEL2_DIAG.Task3 DIAG_AnalogInputs.IN_ANA_11_SEL1_DIAG.Task3 DIAG_AnalogInputs.IN_ANA_11_SEL2_DIAG.Task3 /end REF_MEASUREMENT
/end GROUP
/begin GROUP SYSTEM.Analog_Supply "Analog Supply"
 /begin ANNOTATION ANNOTATION_LABEL "Instance" ANNOTATION_ORIGIN "Group" /begin ANNOTATION_TEXT "0" /end ANNOTATION_TEXT /end ANNOTATION
 /begin ANNOTATION ANNOTATION_LABEL "TaskCycleTime" ANNOTATION_ORIGIN "Group" /begin ANNOTATION_TEXT "0" /end ANNOTATION_TEXT /end ANNOTATION
 /begin ANNOTATION ANNOTATION_LABEL "TimeResolution" ANNOTATION_ORIGIN "Group" /begin ANNOTATION_TEXT "0" /end ANNOTATION_TEXT /end ANNOTATION
 /begin REF_MEASUREMENT IN_AnalogSupply.OUT_ANA_PWR_01.Task3 IN_AnalogSupply.OUT_ANA_PWR_02.Task3 IN_AnalogSupply.OUT_ANA_PWR_03.Task3 DIAG_AnalogSupply.OUT_ANA_PWR_01_DIAG.Task3 DIAG_AnalogSupply.OUT_ANA_PWR_02_DIAG.Task3 DIAG_AnalogSupply.OUT_ANA_PWR_03_DIAG.Task3 /end REF_MEASUREMENT
/end GROUP
/begin GROUP SYSTEM.Analog_Inputs__Coolant_ "Analog Inputs (Coolant)"
 /begin ANNOTATION ANNOTATION_LABEL "Instance" ANNOTATION_ORIGIN "Group" /begin ANNOTATION_TEXT "0" /end ANNOTATION_TEXT /end ANNOTATION
 /begin ANNOTATION ANNOTATION_LABEL "TaskCycleTime" ANNOTATION_ORIGIN "Group" /begin ANNOTATION_TEXT "0" /end ANNOTATION_TEXT /end ANNOTATION
 /begin ANNOTATION ANNOTATION_LABEL "TimeResolution" ANNOTATION_ORIGIN "Group" /begin ANNOTATION_TEXT "0" /end ANNOTATION_TEXT /end ANNOTATION
 /begin REF_MEASUREMENT IN_AnalogInputsCoolant.IN_ANA_12.Task3 IN_AnalogInputsCoolant.IN_ANA_13.Task3 DIAG_AnalogInputsCoolant.IN_ANA_12_DIAG.Task3 DIAG_AnalogInputsCoolant.IN_ANA_13_DIAG.Task3 /end REF_MEASUREMENT
/end GROUP
/begin GROUP SYSTEM.Analog_Inputs__OUT_FREQ_feedback_ "Analog Inputs (OUT_FREQ_feedback)"
 /begin ANNOTATION ANNOTATION_LABEL "Instance" ANNOTATION_ORIGIN "Group" /begin ANNOTATION_TEXT "0" /end ANNOTATION_TEXT /end ANNOTATION
 /begin ANNOTATION ANNOTATION_LABEL "TaskCycleTime" ANNOTATION_ORIGIN "Group" /begin ANNOTATION_TEXT "0" /end ANNOTATION_TEXT /end ANNOTATION
 /begin ANNOTATION ANNOTATION_LABEL "TimeResolution" ANNOTATION_ORIGIN "Group" /begin ANNOTATION_TEXT "0" /end ANNOTATION_TEXT /end ANNOTATION
 /begin REF_MEASUREMENT IN_AnalogInputs.OUT_FREQ_feedback.IN_ANA_14.Task3 IN_AnalogInputs.OUT_FREQ_feedback.IN_ANA_15.Task3 DIAG_AnalogInputs.OUT_FREQ_feedback.IN_ANA_14_DIAG.Task3 DIAG_AnalogInputs.OUT_FREQ_feedback.IN_ANA_15_DIAG.Task3 /end REF_MEASUREMENT
/end GROUP
/begin GROUP SYSTEM.Digital_Inputs "Digital Inputs"
 /begin ANNOTATION ANNOTATION_LABEL "Instance" ANNOTATION_ORIGIN "Group" /begin ANNOTATION_TEXT "0" /end ANNOTATION_TEXT /end ANNOTATION
 /begin ANNOTATION ANNOTATION_LABEL "TaskCycleTime" ANNOTATION_ORIGIN "Group" /begin ANNOTATION_TEXT "0" /end ANNOTATION_TEXT /end ANNOTATION
 /begin ANNOTATION ANNOTATION_LABEL "TimeResolution" ANNOTATION_ORIGIN "Group" /begin ANNOTATION_TEXT "0" /end ANNOTATION_TEXT /end ANNOTATION
 /begin REF_MEASUREMENT IN_DigitalInputs.IN_DIG_02.Task1 IN_DigitalInputs.IN_DIG_10.Task1 IN_DigitalInputs.IN_DIG_17.Task1 IN_DigitalInputs.IN_DIG_26.Task1 IN_DigitalInputs.IN_DIG_35.Task1 IN_DigitalInputs.IN_DIG_36.Task1 IN_DigitalInputs.IN_DIG_40.Task1 IN_DigitalInputs.IN_DIG_36.Task2 IN_DigitalInputs.IN_DIG_01.Task3 IN_DigitalInputs.IN_DIG_02.Task3 IN_DigitalInputs.IN_DIG_03.Task3 IN_DigitalInputs.IN_DIG_04.Task3 IN_DigitalInputs.IN_DIG_05.Task3 IN_DigitalInputs.IN_DIG_06.Task3 IN_DigitalInputs.IN_DIG_07.Task3 IN_DigitalInputs.IN_DIG_08.Task3 IN_DigitalInputs.IN_DIG_09.Task3 IN_DigitalInputs.IN_DIG_10.Task3 IN_DigitalInputs.IN_DIG_11.Task3 IN_DigitalInputs.IN_DIG_12.Task3 IN_DigitalInputs.IN_DIG_13.Task3 IN_DigitalInputs.IN_DIG_14.Task3 IN_DigitalInputs.IN_DIG_15.Task3 IN_DigitalInputs.IN_DIG_16.Task3 IN_DigitalInputs.IN_DIG_17.Task3 IN_DigitalInputs.IN_DIG_18.Task3 IN_DigitalInputs.IN_DIG_19.Task3 IN_DigitalInputs.IN_DIG_20.Task3 IN_DigitalInputs.IN_DIG_21.Task3 IN_DigitalInputs.IN_DIG_22.Task3 IN_DigitalInputs.IN_DIG_23.Task3 IN_DigitalInputs.IN_DIG_24.Task3 IN_DigitalInputs.IN_DIG_25.Task3 IN_DigitalInputs.IN_DIG_26.Task3 IN_DigitalInputs.IN_DIG_27.Task3 IN_DigitalInputs.IN_DIG_28.Task3 IN_DigitalInputs.IN_DIG_29.Task3 IN_DigitalInputs.IN_DIG_30.Task3 IN_DigitalInputs.IN_DIG_31.Task3 IN_DigitalInputs.IN_DIG_32.Task3 IN_DigitalInputs.IN_DIG_33.Task3 IN_DigitalInputs.IN_DIG_34.Task3 IN_DigitalInputs.IN_DIG_35.Task3 IN_DigitalInputs.IN_DIG_36.Task3 IN_DigitalInputs.IN_DIG_37.Task3 IN_DigitalInputs.IN_DIG_38.Task3 IN_DigitalInputs.IN_DIG_39.Task3 IN_DigitalInputs.IN_DIG_40.Task3 IN_DigitalInputs.IN_DIG_41.Task3 IN_DigitalInputs.IN_DIG_42.Task3 IN_DigitalInputs.IN_DIG_43.Task3 IN_DigitalInputs.IN_DIG_44.Task3 IN_DigitalInputs.IN_DIG_45.Task3 IN_DigitalInputs.IN_DIG_46.Task3 IN_DigitalInputs.IN_DIG_48.Task3 IN_DigitalInputs.IN_DIG_49.Task3 IN_DigitalInputs.IN_DIG_50.Task3 IN_DigitalInputs.IN_DIG_36.Task5 DIAG_DigitalInputs.IN_DIG_01_DIAG.Task3 DIAG_DigitalInputs.IN_DIG_02_DIAG.Task3 DIAG_DigitalInputs.IN_DIG_03_DIAG.Task3 DIAG_DigitalInputs.IN_DIG_04_DIAG.Task3 DIAG_DigitalInputs.IN_DIG_05_DIAG.Task3 DIAG_DigitalInputs.IN_DIG_06_DIAG.Task3 DIAG_DigitalInputs.IN_DIG_07_DIAG.Task3 DIAG_DigitalInputs.IN_DIG_08_DIAG.Task3 DIAG_DigitalInputs.IN_DIG_09_DIAG.Task3 DIAG_DigitalInputs.IN_DIG_10_DIAG.Task3 DIAG_DigitalInputs.IN_DIG_11_DIAG.Task3 DIAG_DigitalInputs.IN_DIG_12_DIAG.Task3 DIAG_DigitalInputs.IN_DIG_13_DIAG.Task3 DIAG_DigitalInputs.IN_DIG_14_DIAG.Task3 DIAG_DigitalInputs.IN_DIG_15_DIAG.Task3 DIAG_DigitalInputs.IN_DIG_16_DIAG.Task3 DIAG_DigitalInputs.IN_DIG_17_DIAG.Task3 DIAG_DigitalInputs.IN_DIG_18_DIAG.Task3 DIAG_DigitalInputs.IN_DIG_19_DIAG.Task3 DIAG_DigitalInputs.IN_DIG_20_DIAG.Task3 DIAG_DigitalInputs.IN_DIG_21_DIAG.Task3 DIAG_DigitalInputs.IN_DIG_22_DIAG.Task3 DIAG_DigitalInputs.IN_DIG_23_DIAG.Task3 DIAG_DigitalInputs.IN_DIG_24_DIAG.Task3 DIAG_DigitalInputs.IN_DIG_25_DIAG.Task3 DIAG_DigitalInputs.IN_DIG_26_DIAG.Task3 DIAG_DigitalInputs.IN_DIG_27_DIAG.Task3 DIAG_DigitalInputs.IN_DIG_28_DIAG.Task3 DIAG_DigitalInputs.IN_DIG_29_DIAG.Task3 DIAG_DigitalInputs.IN_DIG_30_DIAG.Task3 DIAG_DigitalInputs.IN_DIG_31_DIAG.Task3 DIAG_DigitalInputs.IN_DIG_32_DIAG.Task3 DIAG_DigitalInputs.IN_DIG_33_DIAG.Task3 DIAG_DigitalInputs.IN_DIG_34_DIAG.Task3 DIAG_DigitalInputs.IN_DIG_35_DIAG.Task3 DIAG_DigitalInputs.IN_DIG_36_DIAG.Task3 DIAG_DigitalInputs.IN_DIG_37_DIAG.Task3 DIAG_DigitalInputs.IN_DIG_38_DIAG.Task3 DIAG_DigitalInputs.IN_DIG_39_DIAG.Task3 DIAG_DigitalInputs.IN_DIG_40_DIAG.Task3 DIAG_DigitalInputs.IN_DIG_41_DIAG.Task3 DIAG_DigitalInputs.IN_DIG_42_DIAG.Task3 DIAG_DigitalInputs.IN_DIG_43_DIAG.Task3 DIAG_DigitalInputs.IN_DIG_44_DIAG.Task3 DIAG_DigitalInputs.IN_DIG_45_DIAG.Task3 DIAG_DigitalInputs.IN_DIG_46_DIAG.Task3 DIAG_DigitalInputs.IN_DIG_48_DIAG.Task3 DIAG_DigitalInputs.IN_DIG_49_DIAG.Task3 DIAG_DigitalInputs.IN_DIG_50_DIAG.Task3 /end REF_MEASUREMENT
/end GROUP
/begin GROUP SYSTEM.Digital_Outputs__STATIC_ "Digital Outputs (STATIC)"
 /begin ANNOTATION ANNOTATION_LABEL "Instance" ANNOTATION_ORIGIN "Group" /begin ANNOTATION_TEXT "0" /end ANNOTATION_TEXT /end ANNOTATION
 /begin ANNOTATION ANNOTATION_LABEL "TaskCycleTime" ANNOTATION_ORIGIN "Group" /begin ANNOTATION_TEXT "0" /end ANNOTATION_TEXT /end ANNOTATION
 /begin ANNOTATION ANNOTATION_LABEL "TimeResolution" ANNOTATION_ORIGIN "Group" /begin ANNOTATION_TEXT "0" /end ANNOTATION_TEXT /end ANNOTATION
 /begin REF_MEASUREMENT IN_DigitalOutputsSTATIC.OUT_01_SENSE.Task3 IN_DigitalOutputsSTATIC.OUT_01_SENSE_PULSE.Task3 IN_DigitalOutputsSTATIC.OUT_02_SENSE.Task3 IN_DigitalOutputsSTATIC.OUT_03_SENSE.Task3 IN_DigitalOutputsSTATIC.OUT_04_SENSE.Task3 IN_DigitalOutputsSTATIC.OUT_04_SENSE_PULSE.Task3 IN_DigitalOutputsSTATIC.OUT_05_SENSE.Task3 IN_DigitalOutputsSTATIC.OUT_06_SENSE.Task3 IN_DigitalOutputsSTATIC.OUT_06_SENSE_PULSE.Task3 IN_DigitalOutputsSTATIC.OUT_07_SENSE.Task3 IN_DigitalOutputsSTATIC.OUT_07_SENSE_PULSE.Task3 IN_DigitalOutputsSTATIC.OUT_08_SENSE.Task3 IN_DigitalOutputsSTATIC.OUT_08_SENSE_PULSE.Task3 IN_DigitalOutputsSTATIC.OUT_09_SENSE.Task3 IN_DigitalOutputsSTATIC.OUT_10_SENSE.Task3 IN_DigitalOutputsSTATIC.OUT_11_SENSE.Task3 IN_DigitalOutputsSTATIC.OUT_12_SENSE.Task3 IN_DigitalOutputsSTATIC.OUT_12_SENSE_PULSE.Task3 IN_DigitalOutputsSTATIC.OUT_13_SENSE.Task3 IN_DigitalOutputsSTATIC.OUT_13_SENSE_PULSE.Task3 IN_DigitalOutputsSTATIC.OUT_14_SENSE.Task3 IN_DigitalOutputsSTATIC.OUT_14_SENSE_PULSE.Task3 IN_DigitalOutputsSTATIC.OUT_15_SENSE.Task3 IN_DigitalOutputsSTATIC.OUT_15_SENSE_PULSE.Task3 IN_DigitalOutputsSTATIC.OUT_16_SENSE.Task3 IN_DigitalOutputsSTATIC.OUT_17_SENSE.Task3 IN_DigitalOutputsSTATIC.OUT_19_SENSE.Task3 IN_DigitalOutputsSTATIC.OUT_01_TD.Task3 IN_DigitalOutputsSTATIC.OUT_04_TD.Task3 IN_DigitalOutputsSTATIC.OUT_06_TD.Task3 IN_DigitalOutputsSTATIC.OUT_07_TD.Task3 IN_DigitalOutputsSTATIC.OUT_08_TD.Task3 IN_DigitalOutputsSTATIC.OUT_12_TD.Task3 IN_DigitalOutputsSTATIC.OUT_13_TD.Task3 IN_DigitalOutputsSTATIC.OUT_14_TD.Task3 IN_DigitalOutputsSTATIC.OUT_15_TD.Task3 OUT_DigitalOutputsSTATIC.IN_ANA_08_SWT1.Task3 OUT_DigitalOutputsSTATIC.IN_ANA_09_SWT1.Task3 OUT_DigitalOutputsSTATIC.IN_ANA_10_SWT1.Task3 OUT_DigitalOutputsSTATIC.IN_ANA_11_SWT1.Task3 OUT_DigitalOutputsSTATIC.OUT_01.Task3 OUT_DigitalOutputsSTATIC.OUT_01_TD_START.Task3 OUT_DigitalOutputsSTATIC.OUT_02.Task3 OUT_DigitalOutputsSTATIC.OUT_03.Task3 OUT_DigitalOutputsSTATIC.OUT_04.Task3 OUT_DigitalOutputsSTATIC.OUT_04_TD_START.Task3 OUT_DigitalOutputsSTATIC.OUT_05.Task3 OUT_DigitalOutputsSTATIC.OUT_06.Task3 OUT_DigitalOutputsSTATIC.OUT_06_TD_START.Task3 OUT_DigitalOutputsSTATIC.OUT_07.Task3 OUT_DigitalOutputsSTATIC.OUT_07_TD_START.Task3 OUT_DigitalOutputsSTATIC.OUT_08.Task3 OUT_DigitalOutputsSTATIC.OUT_08_TD_START.Task3 OUT_DigitalOutputsSTATIC.OUT_09.Task3 OUT_DigitalOutputsSTATIC.OUT_10.Task3 OUT_DigitalOutputsSTATIC.OUT_11.Task3 OUT_DigitalOutputsSTATIC.OUT_12.Task3 OUT_DigitalOutputsSTATIC.OUT_12_TD_START.Task3 OUT_DigitalOutputsSTATIC.OUT_13.Task3 OUT_DigitalOutputsSTATIC.OUT_13_TD_START.Task3 OUT_DigitalOutputsSTATIC.OUT_14.Task3 OUT_DigitalOutputsSTATIC.OUT_14_TD_START.Task3 OUT_DigitalOutputsSTATIC.OUT_15.Task3 OUT_DigitalOutputsSTATIC.OUT_15_TD_START.Task3 OUT_DigitalOutputsSTATIC.OUT_16.Task3 OUT_DigitalOutputsSTATIC.OUT_17.Task3 OUT_DigitalOutputsSTATIC.OUT_19.Task3 OUT_DigitalOutputsSTATIC.OUT_SUP_ANA_01.Task3 OUT_DigitalOutputsSTATIC.OUT_SUP_ANA_02.Task3 OUT_DigitalOutputsSTATIC.OUT_SUP_ANA_03.Task3 DIAG_DigitalOutputsSTATIC.OUT_01_DIAG.Task3 DIAG_DigitalOutputsSTATIC.OUT_01_SENSE_PULSE_DIAG.Task3 DIAG_DigitalOutputsSTATIC.OUT_01_TD_DIAG.Task3 DIAG_DigitalOutputsSTATIC.OUT_02_DIAG.Task3 DIAG_DigitalOutputsSTATIC.OUT_03_DIAG.Task3 DIAG_DigitalOutputsSTATIC.OUT_04_DIAG.Task3 DIAG_DigitalOutputsSTATIC.OUT_04_SENSE_PULSE_DIAG.Task3 DIAG_DigitalOutputsSTATIC.OUT_04_TD_DIAG.Task3 DIAG_DigitalOutputsSTATIC.OUT_05_DIAG.Task3 DIAG_DigitalOutputsSTATIC.OUT_06_DIAG.Task3 DIAG_DigitalOutputsSTATIC.OUT_06_SENSE_PULSE_DIAG.Task3 DIAG_DigitalOutputsSTATIC.OUT_06_TD_DIAG.Task3 DIAG_DigitalOutputsSTATIC.OUT_07_DIAG.Task3 DIAG_DigitalOutputsSTATIC.OUT_07_SENSE_PULSE_DIAG.Task3 DIAG_DigitalOutputsSTATIC.OUT_07_TD_DIAG.Task3 DIAG_DigitalOutputsSTATIC.OUT_08_DIAG.Task3 DIAG_DigitalOutputsSTATIC.OUT_08_SENSE_PULSE_DIAG.Task3 DIAG_DigitalOutputsSTATIC.OUT_08_TD_DIAG.Task3 DIAG_DigitalOutputsSTATIC.OUT_09_DIAG.Task3 DIAG_DigitalOutputsSTATIC.OUT_10_DIAG.Task3 DIAG_DigitalOutputsSTATIC.OUT_11_DIAG.Task3 DIAG_DigitalOutputsSTATIC.OUT_12_DIAG.Task3 DIAG_DigitalOutputsSTATIC.OUT_12_SENSE_PULSE_DIAG.Task3 DIAG_DigitalOutputsSTATIC.OUT_12_TD_DIAG.Task3 DIAG_DigitalOutputsSTATIC.OUT_13_DIAG.Task3 DIAG_DigitalOutputsSTATIC.OUT_13_SENSE_PULSE_DIAG.Task3 DIAG_DigitalOutputsSTATIC.OUT_13_TD_DIAG.Task3 DIAG_DigitalOutputsSTATIC.OUT_14_DIAG.Task3 DIAG_DigitalOutputsSTATIC.OUT_14_SENSE_PULSE_DIAG.Task3 DIAG_DigitalOutputsSTATIC.OUT_14_TD_DIAG.Task3 DIAG_DigitalOutputsSTATIC.OUT_15_DIAG.Task3 DIAG_DigitalOutputsSTATIC.OUT_15_SENSE_PULSE_DIAG.Task3 DIAG_DigitalOutputsSTATIC.OUT_15_TD_DIAG.Task3 DIAG_DigitalOutputsSTATIC.OUT_16_DIAG.Task3 DIAG_DigitalOutputsSTATIC.OUT_17_DIAG.Task3 DIAG_DigitalOutputsSTATIC.OUT_19_DIAG.Task3 /end REF_MEASUREMENT
/end GROUP
/begin GROUP SYSTEM.Digital_Output__PWM_ "Digital Output (PWM)"
 /begin ANNOTATION ANNOTATION_LABEL "Instance" ANNOTATION_ORIGIN "Group" /begin ANNOTATION_TEXT "0" /end ANNOTATION_TEXT /end ANNOTATION
 /begin ANNOTATION ANNOTATION_LABEL "TaskCycleTime" ANNOTATION_ORIGIN "Group" /begin ANNOTATION_TEXT "0" /end ANNOTATION_TEXT /end ANNOTATION
 /begin ANNOTATION ANNOTATION_LABEL "TimeResolution" ANNOTATION_ORIGIN "Group" /begin ANNOTATION_TEXT "0" /end ANNOTATION_TEXT /end ANNOTATION
 /begin REF_MEASUREMENT IN_DigitalOutputPWM.OUT_18_SENSE.Task3 IN_DigitalOutputPWM.OUT_20_SENSE.Task3 IN_DigitalOutputPWM.OUT_20_SENSE_PULSE.Task3 IN_DigitalOutputPWM.OUT_21_SENSE.Task3 IN_DigitalOutputPWM.OUT_21_SENSE_PULSE.Task3 IN_DigitalOutputPWM.OUT_22_SENSE.Task3 IN_DigitalOutputPWM.OUT_23_SENSE.Task3 IN_DigitalOutputPWM.OUT_24_SENSE.Task3 IN_DigitalOutputPWM.OUT_25_SENSE.Task3 IN_DigitalOutputPWM.OUT_26_SENSE.Task3 IN_DigitalOutputPWM.OUT_27_SENSE.Task3 IN_DigitalOutputPWM.OUT_20_TD.Task3 IN_DigitalOutputPWM.OUT_21_TD.Task3 OUT_DigitalOutputPWM.OUT_18_PWM.Task3 OUT_DigitalOutputPWM.OUT_20_PWM.Task3 OUT_DigitalOutputPWM.OUT_20_TD_START.Task3 OUT_DigitalOutputPWM.OUT_21_PWM.Task3 OUT_DigitalOutputPWM.OUT_21_TD_START.Task3 OUT_DigitalOutputPWM.OUT_22_PWM.Task3 OUT_DigitalOutputPWM.OUT_23_PWM.Task3 OUT_DigitalOutputPWM.OUT_24_PWM.Task3 OUT_DigitalOutputPWM.OUT_25_PWM.Task3 OUT_DigitalOutputPWM.OUT_26_PWM.Task3 OUT_DigitalOutputPWM.OUT_27_PWM.Task3 DIAG_DigitalOutputPWM.OUT_18_PWM_DIAG.Task3 DIAG_DigitalOutputPWM.OUT_20_PWM_DIAG.Task3 DIAG_DigitalOutputPWM.OUT_20_SENSE_PULSE_DIAG.Task3 DIAG_DigitalOutputPWM.OUT_20_TD_DIAG.Task3 DIAG_DigitalOutputPWM.OUT_21_PWM_DIAG.Task3 DIAG_DigitalOutputPWM.OUT_21_SENSE_PULSE_DIAG.Task3 DIAG_DigitalOutputPWM.OUT_21_TD_DIAG.Task3 DIAG_DigitalOutputPWM.OUT_22_PWM_DIAG.Task3 DIAG_DigitalOutputPWM.OUT_23_PWM_DIAG.Task3 DIAG_DigitalOutputPWM.OUT_24_PWM_DIAG.Task3 DIAG_DigitalOutputPWM.OUT_25_PWM_DIAG.Task3 DIAG_DigitalOutputPWM.OUT_26_PWM_DIAG.Task3 DIAG_DigitalOutputPWM.OUT_27_PWM_DIAG.Task3 /end REF_MEASUREMENT
/end GROUP
/begin GROUP SYSTEM.NVM._0x0000A000__Parameter_ "0x0000A000 (Parameter)"
 /begin ANNOTATION ANNOTATION_LABEL "Instance" ANNOTATION_ORIGIN "Group" /begin ANNOTATION_TEXT "0" /end ANNOTATION_TEXT /end ANNOTATION
 /begin ANNOTATION ANNOTATION_LABEL "TaskCycleTime" ANNOTATION_ORIGIN "Group" /begin ANNOTATION_TEXT "0" /end ANNOTATION_TEXT /end ANNOTATION
 /begin ANNOTATION ANNOTATION_LABEL "TimeResolution" ANNOTATION_ORIGIN "Group" /begin ANNOTATION_TEXT "0" /end ANNOTATION_TEXT /end ANNOTATION
 /begin REF_MEASUREMENT IN_NVM.Parameter.ModelHoldMinTimeAfterPOR.Task1 IN_NVM.Parameter.BlinkSourcePeriod.Task3 IN_NVM.Parameter.TrailerDetectionTime.Task3 IN_NVM.Parameter.HBrakeTime.Task4 IN_NVM.Parameter.HMaxActivationTimeTime.Task4 IN_NVM.Parameter.HOpenLoadDetectTime.Task4 IN_NVM.Parameter.HOpenLoadIntervalTime.Task4 /end REF_MEASUREMENT
/end GROUP
/begin GROUP SYSTEM.NVM "NVM"
 /begin ANNOTATION ANNOTATION_LABEL "Instance" ANNOTATION_ORIGIN "Group" /begin ANNOTATION_TEXT "0" /end ANNOTATION_TEXT /end ANNOTATION
 /begin ANNOTATION ANNOTATION_LABEL "TaskCycleTime" ANNOTATION_ORIGIN "Group" /begin ANNOTATION_TEXT "0" /end ANNOTATION_TEXT /end ANNOTATION
 /begin ANNOTATION ANNOTATION_LABEL "TimeResolution" ANNOTATION_ORIGIN "Group" /begin ANNOTATION_TEXT "0" /end ANNOTATION_TEXT /end ANNOTATION
 /begin SUB_GROUP SYSTEM.NVM._0x0000A000__Parameter_ /end SUB_GROUP
/end GROUP
/begin GROUP SYSTEM.RAM_Device "RAM Device"
 /begin ANNOTATION ANNOTATION_LABEL "Instance" ANNOTATION_ORIGIN "Group" /begin ANNOTATION_TEXT "0" /end ANNOTATION_TEXT /end ANNOTATION
 /begin ANNOTATION ANNOTATION_LABEL "TaskCycleTime" ANNOTATION_ORIGIN "Group" /begin ANNOTATION_TEXT "0" /end ANNOTATION_TEXT /end ANNOTATION
 /begin ANNOTATION ANNOTATION_LABEL "TimeResolution" ANNOTATION_ORIGIN "Group" /begin ANNOTATION_TEXT "0" /end ANNOTATION_TEXT /end ANNOTATION
 /begin REF_MEASUREMENT INOUT_RAMDevice.boSystemWake.Task1 INOUT_RAMDevice.boSystemWake.Task3 INOUT_RAMDevice.boSystemWake.Task4 INOUT_RAMDevice.boSystemWake.Task5 /end REF_MEASUREMENT
/end GROUP
/begin GROUP SYSTEM.DEM_Diagnostic_Event_Manager.DEM_List "DEM List"
 /begin ANNOTATION ANNOTATION_LABEL "Instance" ANNOTATION_ORIGIN "Group" /begin ANNOTATION_TEXT "0" /end ANNOTATION_TEXT /end ANNOTATION
 /begin ANNOTATION ANNOTATION_LABEL "TaskCycleTime" ANNOTATION_ORIGIN "Group" /begin ANNOTATION_TEXT "0" /end ANNOTATION_TEXT /end ANNOTATION
 /begin ANNOTATION ANNOTATION_LABEL "TimeResolution" ANNOTATION_ORIGIN "Group" /begin ANNOTATION_TEXT "0" /end ANNOTATION_TEXT /end ANNOTATION
 /begin REF_MEASUREMENT OUT_DEMDiagnosticEventManager.DEMList.DTC_01.Task2 /end REF_MEASUREMENT
/end GROUP
/begin GROUP SYSTEM.DEM_Diagnostic_Event_Manager "DEM Diagnostic Event Manager"
 /begin ANNOTATION ANNOTATION_LABEL "Instance" ANNOTATION_ORIGIN "Group" /begin ANNOTATION_TEXT "0" /end ANNOTATION_TEXT /end ANNOTATION
 /begin ANNOTATION ANNOTATION_LABEL "TaskCycleTime" ANNOTATION_ORIGIN "Group" /begin ANNOTATION_TEXT "0" /end ANNOTATION_TEXT /end ANNOTATION
 /begin ANNOTATION ANNOTATION_LABEL "TimeResolution" ANNOTATION_ORIGIN "Group" /begin ANNOTATION_TEXT "0" /end ANNOTATION_TEXT /end ANNOTATION
 /begin SUB_GROUP SYSTEM.DEM_Diagnostic_Event_Manager.DEM_List /end SUB_GROUP
 /begin REF_MEASUREMENT IN_DEMDiagnosticEventManager.DeviceState.Task2 OUT_DEMDiagnosticEventManager.DateAndTime.Task2 OUT_DEMDiagnosticEventManager.Distance.Task2 OUT_DEMDiagnosticEventManager.FreezeFrame1.Task2 OUT_DEMDiagnosticEventManager.FreezeFrame10.Task2 OUT_DEMDiagnosticEventManager.FreezeFrame2.Task2 OUT_DEMDiagnosticEventManager.FreezeFrame3.Task2 OUT_DEMDiagnosticEventManager.FreezeFrame4.Task2 OUT_DEMDiagnosticEventManager.FreezeFrame5.Task2 OUT_DEMDiagnosticEventManager.FreezeFrame6.Task2 OUT_DEMDiagnosticEventManager.FreezeFrame7.Task2 OUT_DEMDiagnosticEventManager.FreezeFrame8.Task2 OUT_DEMDiagnosticEventManager.FreezeFrame9.Task2 OUT_DEMDiagnosticEventManager.EnableCondition00.Task2 OUT_DEMDiagnosticEventManager.EnableCondition01.Task2 OUT_DEMDiagnosticEventManager.EnableCondition02.Task2 OUT_DEMDiagnosticEventManager.EnableCondition03.Task2 OUT_DEMDiagnosticEventManager.EnableCondition04.Task2 OUT_DEMDiagnosticEventManager.EnableCondition05.Task2 OUT_DEMDiagnosticEventManager.EnableCondition06.Task2 OUT_DEMDiagnosticEventManager.EnableCondition07.Task2 OUT_DEMDiagnosticEventManager.EnableCondition08.Task2 OUT_DEMDiagnosticEventManager.EnableCondition09.Task2 OUT_DEMDiagnosticEventManager.OperationCycle.Task2 OUT_DEMDiagnosticEventManager.StorageCondition00.Task2 OUT_DEMDiagnosticEventManager.StorageCondition01.Task2 OUT_DEMDiagnosticEventManager.StorageCondition02.Task2 OUT_DEMDiagnosticEventManager.StorageCondition03.Task2 OUT_DEMDiagnosticEventManager.StorageCondition04.Task2 OUT_DEMDiagnosticEventManager.StorageCondition05.Task2 OUT_DEMDiagnosticEventManager.StorageCondition06.Task2 OUT_DEMDiagnosticEventManager.StorageCondition07.Task2 OUT_DEMDiagnosticEventManager.StorageCondition08.Task2 OUT_DEMDiagnosticEventManager.StorageCondition09.Task2 /end REF_MEASUREMENT
/end GROUP
/begin GROUP SYSTEM.D_CAN.GW_00000501 "GW_00000501"
 /begin ANNOTATION ANNOTATION_LABEL "Instance" ANNOTATION_ORIGIN "Group" /begin ANNOTATION_TEXT "1" /end ANNOTATION_TEXT /end ANNOTATION
 /begin ANNOTATION ANNOTATION_LABEL "TaskCycleTime" ANNOTATION_ORIGIN "Group" /begin ANNOTATION_TEXT "0" /end ANNOTATION_TEXT /end ANNOTATION
 /begin ANNOTATION ANNOTATION_LABEL "TimeResolution" ANNOTATION_ORIGIN "Group" /begin ANNOTATION_TEXT "0" /end ANNOTATION_TEXT /end ANNOTATION
 /begin REF_MEASUREMENT OUT_DCAN.GW_00000501.MessageEnable.Task2 /end REF_MEASUREMENT
/end GROUP
/begin GROUP SYSTEM.D_CAN.GW_00000502 "GW_00000502"
 /begin ANNOTATION ANNOTATION_LABEL "Instance" ANNOTATION_ORIGIN "Group" /begin ANNOTATION_TEXT "2" /end ANNOTATION_TEXT /end ANNOTATION
 /begin ANNOTATION ANNOTATION_LABEL "TaskCycleTime" ANNOTATION_ORIGIN "Group" /begin ANNOTATION_TEXT "0" /end ANNOTATION_TEXT /end ANNOTATION
 /begin ANNOTATION ANNOTATION_LABEL "TimeResolution" ANNOTATION_ORIGIN "Group" /begin ANNOTATION_TEXT "0" /end ANNOTATION_TEXT /end ANNOTATION
 /begin REF_MEASUREMENT OUT_DCAN.GW_00000502.MessageEnable.Task2 /end REF_MEASUREMENT
/end GROUP
/begin GROUP SYSTEM.D_CAN.GW_00000503 "GW_00000503"
 /begin ANNOTATION ANNOTATION_LABEL "Instance" ANNOTATION_ORIGIN "Group" /begin ANNOTATION_TEXT "3" /end ANNOTATION_TEXT /end ANNOTATION
 /begin ANNOTATION ANNOTATION_LABEL "TaskCycleTime" ANNOTATION_ORIGIN "Group" /begin ANNOTATION_TEXT "0" /end ANNOTATION_TEXT /end ANNOTATION
 /begin ANNOTATION ANNOTATION_LABEL "TimeResolution" ANNOTATION_ORIGIN "Group" /begin ANNOTATION_TEXT "0" /end ANNOTATION_TEXT /end ANNOTATION
 /begin REF_MEASUREMENT OUT_DCAN.GW_00000503.MessageEnable.Task2 /end REF_MEASUREMENT
/end GROUP
/begin GROUP SYSTEM.D_CAN.GW_00000504 "GW_00000504"
 /begin ANNOTATION ANNOTATION_LABEL "Instance" ANNOTATION_ORIGIN "Group" /begin ANNOTATION_TEXT "4" /end ANNOTATION_TEXT /end ANNOTATION
 /begin ANNOTATION ANNOTATION_LABEL "TaskCycleTime" ANNOTATION_ORIGIN "Group" /begin ANNOTATION_TEXT "0" /end ANNOTATION_TEXT /end ANNOTATION
 /begin ANNOTATION ANNOTATION_LABEL "TimeResolution" ANNOTATION_ORIGIN "Group" /begin ANNOTATION_TEXT "0" /end ANNOTATION_TEXT /end ANNOTATION
 /begin REF_MEASUREMENT OUT_DCAN.GW_00000504.MessageEnable.Task2 /end REF_MEASUREMENT
/end GROUP
/begin GROUP SYSTEM.D_CAN.GW_00000FF1 "GW_00000FF1"
 /begin ANNOTATION ANNOTATION_LABEL "Instance" ANNOTATION_ORIGIN "Group" /begin ANNOTATION_TEXT "5" /end ANNOTATION_TEXT /end ANNOTATION
 /begin ANNOTATION ANNOTATION_LABEL "TaskCycleTime" ANNOTATION_ORIGIN "Group" /begin ANNOTATION_TEXT "0" /end ANNOTATION_TEXT /end ANNOTATION
 /begin ANNOTATION ANNOTATION_LABEL "TimeResolution" ANNOTATION_ORIGIN "Group" /begin ANNOTATION_TEXT "0" /end ANNOTATION_TEXT /end ANNOTATION
 /begin REF_MEASUREMENT OUT_DCAN.GW_00000FF1.MessageEnable.Task2 /end REF_MEASUREMENT
/end GROUP
/begin GROUP SYSTEM.D_CAN.GW_18DA17F0 "GW_18DA17F0"
 /begin ANNOTATION ANNOTATION_LABEL "Instance" ANNOTATION_ORIGIN "Group" /begin ANNOTATION_TEXT "6" /end ANNOTATION_TEXT /end ANNOTATION
 /begin ANNOTATION ANNOTATION_LABEL "TaskCycleTime" ANNOTATION_ORIGIN "Group" /begin ANNOTATION_TEXT "0" /end ANNOTATION_TEXT /end ANNOTATION
 /begin ANNOTATION ANNOTATION_LABEL "TimeResolution" ANNOTATION_ORIGIN "Group" /begin ANNOTATION_TEXT "0" /end ANNOTATION_TEXT /end ANNOTATION
 /begin REF_MEASUREMENT OUT_DCAN.GW_18DA17F0.MessageEnable.Task2 /end REF_MEASUREMENT
/end GROUP
/begin GROUP SYSTEM.D_CAN.GW_18DA17F1 "GW_18DA17F1"
 /begin ANNOTATION ANNOTATION_LABEL "Instance" ANNOTATION_ORIGIN "Group" /begin ANNOTATION_TEXT "7" /end ANNOTATION_TEXT /end ANNOTATION
 /begin ANNOTATION ANNOTATION_LABEL "TaskCycleTime" ANNOTATION_ORIGIN "Group" /begin ANNOTATION_TEXT "0" /end ANNOTATION_TEXT /end ANNOTATION
 /begin ANNOTATION ANNOTATION_LABEL "TimeResolution" ANNOTATION_ORIGIN "Group" /begin ANNOTATION_TEXT "0" /end ANNOTATION_TEXT /end ANNOTATION
 /begin REF_MEASUREMENT OUT_DCAN.GW_18DA17F1.MessageEnable.Task2 /end REF_MEASUREMENT
/end GROUP
/begin GROUP SYSTEM.D_CAN.GW_18DAE1F1 "GW_18DAE1F1"
 /begin ANNOTATION ANNOTATION_LABEL "Instance" ANNOTATION_ORIGIN "Group" /begin ANNOTATION_TEXT "8" /end ANNOTATION_TEXT /end ANNOTATION
 /begin ANNOTATION ANNOTATION_LABEL "TaskCycleTime" ANNOTATION_ORIGIN "Group" /begin ANNOTATION_TEXT "0" /end ANNOTATION_TEXT /end ANNOTATION
 /begin ANNOTATION ANNOTATION_LABEL "TimeResolution" ANNOTATION_ORIGIN "Group" /begin ANNOTATION_TEXT "0" /end ANNOTATION_TEXT /end ANNOTATION
 /begin REF_MEASUREMENT OUT_DCAN.GW_18DAE1F1.MessageEnable.Task2 /end REF_MEASUREMENT
/end GROUP
/begin GROUP SYSTEM.D_CAN "D-CAN"
 /begin ANNOTATION ANNOTATION_LABEL "Instance" ANNOTATION_ORIGIN "Group" /begin ANNOTATION_TEXT "0" /end ANNOTATION_TEXT /end ANNOTATION
 /begin ANNOTATION ANNOTATION_LABEL "TaskCycleTime" ANNOTATION_ORIGIN "Group" /begin ANNOTATION_TEXT "0" /end ANNOTATION_TEXT /end ANNOTATION
 /begin ANNOTATION ANNOTATION_LABEL "TimeResolution" ANNOTATION_ORIGIN "Group" /begin ANNOTATION_TEXT "0" /end ANNOTATION_TEXT /end ANNOTATION
 /begin SUB_GROUP SYSTEM.D_CAN.GW_00000501 SYSTEM.D_CAN.GW_00000502 SYSTEM.D_CAN.GW_00000503 SYSTEM.D_CAN.GW_00000504 SYSTEM.D_CAN.GW_00000FF1 SYSTEM.D_CAN.GW_18DA17F0 SYSTEM.D_CAN.GW_18DA17F1 SYSTEM.D_CAN.GW_18DAE1F1 /end SUB_GROUP
 /begin REF_MEASUREMENT OUT_DCAN.MessageForwardingEnable.Task2 /end REF_MEASUREMENT
/end GROUP
/begin GROUP SYSTEM.A_CAN.BSG_EXPA "BSG_EXPA"
 /begin ANNOTATION ANNOTATION_LABEL "Instance" ANNOTATION_ORIGIN "Group" /begin ANNOTATION_TEXT "0" /end ANNOTATION_TEXT /end ANNOTATION
 /begin ANNOTATION ANNOTATION_LABEL "TaskCycleTime" ANNOTATION_ORIGIN "Group" /begin ANNOTATION_TEXT "0" /end ANNOTATION_TEXT /end ANNOTATION
 /begin ANNOTATION ANNOTATION_LABEL "TimeResolution" ANNOTATION_ORIGIN "Group" /begin ANNOTATION_TEXT "0" /end ANNOTATION_TEXT /end ANNOTATION
 /begin REF_MEASUREMENT IN_ACAN.BSG_EXPA.IN_ANA_01.Task4 IN_ACAN.BSG_EXPA.IN_ANA_02.Task4 IN_ACAN.BSG_EXPA.IN_ANA_03.Task4 IN_ACAN.BSG_EXPA.IN_ANA_04.Task4 IN_ACAN.BSG_EXPA.IN_ANA_05.Task4 IN_ACAN.BSG_EXPA.IN_ANA_06.Task4 IN_ACAN.BSG_EXPA.IN_ANA_07.Task4 IN_ACAN.BSG_EXPA.IN_ANA_08.Task4 IN_ACAN.BSG_EXPA.IN_ANA_09.Task4 IN_ACAN.BSG_EXPA.IN_PWR.Task4 IN_ACAN.BSG_EXPA.Frequency.Task4 IN_ACAN.BSG_EXPA.IN_ANA_11.Task4 IN_ACAN.BSG_EXPA.IN_ANA_12.Task4 IN_ACAN.BSG_EXPA.IN_PWR_G1.Task4 IN_ACAN.BSG_EXPA.IN_PWR_G2.Task4 IN_ACAN.BSG_EXPA.IN_PWR_G3.Task4 IN_ACAN.BSG_EXPA.IN_PWR_G4.Task4 IN_ACAN.BSG_EXPA.IN_PWR_G5.Task4 IN_ACAN.BSG_EXPA.OUT_01_HB_SENSE.Task4 IN_ACAN.BSG_EXPA.OUT_02_HB_SENSE.Task4 IN_ACAN.BSG_EXPA.OUT_03_SENSE.Task4 IN_ACAN.BSG_EXPA.OUT_04_SENSE.Task4 IN_ACAN.BSG_EXPA.OUT_05_HB_SENSE.Task4 IN_ACAN.BSG_EXPA.OUT_06_HB_SENSE.Task4 IN_ACAN.BSG_EXPA.OUT_07_HB_SENSE.Task4 IN_ACAN.BSG_EXPA.OUT_08_HB_SENSE.Task4 IN_ACAN.BSG_EXPA.OUT_09_HB_SENSE.Task4 IN_ACAN.BSG_EXPA.OUT_10_HB_SENSE.Task4 IN_ACAN.BSG_EXPA.OUT_11_SENSE.Task4 IN_ACAN.BSG_EXPA.OUT_12_SENSE.Task4 IN_ACAN.BSG_EXPA.OUT_12_SENSE_PULSE.Task4 IN_ACAN.BSG_EXPA.OUT_13_SENSE.Task4 IN_ACAN.BSG_EXPA.OUT_14_SENSE.Task4 IN_ACAN.BSG_EXPA.OUT_15_SENSE.Task4 IN_ACAN.BSG_EXPA.OUT_16_SENSE.Task4 IN_ACAN.BSG_EXPA.OUT_17_SENSE.Task4 IN_ACAN.BSG_EXPA.OUT_18_SENSE.Task4 IN_ACAN.BSG_EXPA.OUT_19_SENSE.Task4 IN_ACAN.BSG_EXPA.OUT_20_SENSE.Task4 IN_ACAN.BSG_EXPA.OUT_21_SENSE.Task4 IN_ACAN.BSG_EXPA.OUT_21_SENSE_PULSE.Task4 IN_ACAN.BSG_EXPA.OUT_22_SENSE.Task4 IN_ACAN.BSG_EXPA.OUT_23_SENSE.Task4 IN_ACAN.BSG_EXPA.OUT_24_SENSE.Task4 IN_ACAN.BSG_EXPA.OUT_25_SENSE.Task4 IN_ACAN.BSG_EXPA.OUT_26_SENSE.Task4 IN_ACAN.BSG_EXPA.OUT_27_SENSE.Task4 IN_ACAN.BSG_EXPA.OUT_28_SENSE.Task4 IN_ACAN.BSG_EXPA.OUT_ANA_PWR_01.Task4 IN_ACAN.BSG_EXPA.IN_DIG_01.Task4 IN_ACAN.BSG_EXPA.IN_DIG_02.Task4 IN_ACAN.BSG_EXPA.IN_DIG_03.Task4 IN_ACAN.BSG_EXPA.IN_DIG_04.Task4 IN_ACAN.BSG_EXPA.IN_DIG_05.Task4 IN_ACAN.BSG_EXPA.IN_DIG_06.Task4 IN_ACAN.BSG_EXPA.IN_DIG_07.Task4 IN_ACAN.BSG_EXPA.IN_DIG_08.Task4 IN_ACAN.BSG_EXPA.IN_DIG_09.Task4 IN_ACAN.BSG_EXPA.IN_DIG_10.Task4 IN_ACAN.BSG_EXPA.IN_DIG_11.Task4 IN_ACAN.BSG_EXPA.IN_DIG_12.Task4 IN_ACAN.BSG_EXPA.IN_DIG_13.Task4 IN_ACAN.BSG_EXPA.IN_DIG_14.Task4 IN_ACAN.BSG_EXPA.IN_DIG_15.Task4 IN_ACAN.BSG_EXPA.IN_DIG_16.Task4 IN_ACAN.BSG_EXPA.IN_DIG_17.Task4 IN_ACAN.BSG_EXPA.IN_DIG_18.Task4 IN_ACAN.BSG_EXPA.IN_DIG_19.Task4 IN_ACAN.BSG_EXPA.IN_DIG_20.Task4 IN_ACAN.BSG_EXPA.IN_DIG_21.Task4 IN_ACAN.BSG_EXPA.IN_DIG_22.Task4 IN_ACAN.BSG_EXPA.OUT_12_TD.Task4 IN_ACAN.BSG_EXPA.OUT_21_TD.Task4 OUT_ACAN.BSG_EXPA.OUT_01_HB.Task4 OUT_ACAN.BSG_EXPA.OUT_02_HB.Task4 OUT_ACAN.BSG_EXPA.OUT_03.Task4 OUT_ACAN.BSG_EXPA.OUT_04.Task4 OUT_ACAN.BSG_EXPA.OUT_05_HB.Task4 OUT_ACAN.BSG_EXPA.OUT_06_HB.Task4 OUT_ACAN.BSG_EXPA.OUT_07_HB.Task4 OUT_ACAN.BSG_EXPA.OUT_08_HB.Task4 OUT_ACAN.BSG_EXPA.OUT_09_HB.Task4 OUT_ACAN.BSG_EXPA.OUT_10_HB.Task4 OUT_ACAN.BSG_EXPA.OUT_11.Task4 OUT_ACAN.BSG_EXPA.OUT_12.Task4 OUT_ACAN.BSG_EXPA.OUT_12_TD_START.Task4 OUT_ACAN.BSG_EXPA.OUT_13.Task4 OUT_ACAN.BSG_EXPA.OUT_14.Task4 OUT_ACAN.BSG_EXPA.OUT_15.Task4 OUT_ACAN.BSG_EXPA.OUT_16.Task4 OUT_ACAN.BSG_EXPA.OUT_17.Task4 OUT_ACAN.BSG_EXPA.OUT_18.Task4 OUT_ACAN.BSG_EXPA.OUT_19.Task4 OUT_ACAN.BSG_EXPA.OUT_20.Task4 OUT_ACAN.BSG_EXPA.OUT_21.Task4 OUT_ACAN.BSG_EXPA.OUT_21_TD_START.Task4 OUT_ACAN.BSG_EXPA.OUT_22.Task4 OUT_ACAN.BSG_EXPA.OUT_23.Task4 OUT_ACAN.BSG_EXPA.OUT_24.Task4 OUT_ACAN.BSG_EXPA.OUT_25.Task4 OUT_ACAN.BSG_EXPA.OUT_26.Task4 OUT_ACAN.BSG_EXPA.OUT_27.Task4 OUT_ACAN.BSG_EXPA.OUT_28.Task4 OUT_ACAN.BSG_EXPA.OUT_29_HB.Task4 OUT_ACAN.BSG_EXPA.OUT_30_HB.Task4 OUT_ACAN.BSG_EXPA.OUT_31_HB.Task4 OUT_ACAN.BSG_EXPA.OUT_32_HB.Task4 OUT_ACAN.BSG_EXPA.OUT_33_HB.Task4 OUT_ACAN.BSG_EXPA.OUT_34_HB.Task4 OUT_ACAN.BSG_EXPA.OUT_OLD_01.Task4 OUT_ACAN.BSG_EXPA.OUT_OLD_02.Task4 OUT_ACAN.BSG_EXPA.OUT_OLD_03.Task4 OUT_ACAN.BSG_EXPA.OUT_OLD_04.Task4 OUT_ACAN.BSG_EXPA.OUT_SUP_ANA_01.Task4 DIAG_ACAN.BSG_EXPA.IN_ANA_01_DIAG.Task4 DIAG_ACAN.BSG_EXPA.IN_ANA_02_DIAG.Task4 DIAG_ACAN.BSG_EXPA.IN_ANA_03_DIAG.Task4 DIAG_ACAN.BSG_EXPA.IN_ANA_04_DIAG.Task4 DIAG_ACAN.BSG_EXPA.IN_ANA_05_DIAG.Task4 DIAG_ACAN.BSG_EXPA.IN_ANA_06_DIAG.Task4 DIAG_ACAN.BSG_EXPA.IN_ANA_07_DIAG.Task4 DIAG_ACAN.BSG_EXPA.IN_ANA_08_DIAG.Task4 DIAG_ACAN.BSG_EXPA.IN_ANA_09_DIAG.Task4 DIAG_ACAN.BSG_EXPA.IN_ANA_11_DIAG.Task4 DIAG_ACAN.BSG_EXPA.IN_ANA_12_DIAG.Task4 DIAG_ACAN.BSG_EXPA.IN_DIG_01_DIAG.Task4 DIAG_ACAN.BSG_EXPA.IN_DIG_02_DIAG.Task4 DIAG_ACAN.BSG_EXPA.IN_DIG_03_DIAG.Task4 DIAG_ACAN.BSG_EXPA.IN_DIG_04_DIAG.Task4 DIAG_ACAN.BSG_EXPA.IN_DIG_05_DIAG.Task4 DIAG_ACAN.BSG_EXPA.IN_DIG_06_DIAG.Task4 DIAG_ACAN.BSG_EXPA.IN_DIG_07_DIAG.Task4 DIAG_ACAN.BSG_EXPA.IN_DIG_08_DIAG.Task4 DIAG_ACAN.BSG_EXPA.IN_DIG_09_DIAG.Task4 DIAG_ACAN.BSG_EXPA.IN_DIG_10_DIAG.Task4 DIAG_ACAN.BSG_EXPA.IN_DIG_11_DIAG.Task4 DIAG_ACAN.BSG_EXPA.IN_DIG_12_DIAG.Task4 DIAG_ACAN.BSG_EXPA.IN_DIG_13_DIAG.Task4 DIAG_ACAN.BSG_EXPA.IN_DIG_14_DIAG.Task4 DIAG_ACAN.BSG_EXPA.IN_DIG_15_DIAG.Task4 DIAG_ACAN.BSG_EXPA.IN_DIG_16_DIAG.Task4 DIAG_ACAN.BSG_EXPA.IN_DIG_17_DIAG.Task4 DIAG_ACAN.BSG_EXPA.IN_DIG_18_DIAG.Task4 DIAG_ACAN.BSG_EXPA.IN_DIG_19_DIAG.Task4 DIAG_ACAN.BSG_EXPA.IN_DIG_20_DIAG.Task4 DIAG_ACAN.BSG_EXPA.IN_DIG_21_DIAG.Task4 DIAG_ACAN.BSG_EXPA.IN_DIG_22_DIAG.Task4 DIAG_ACAN.BSG_EXPA.IN_PWR_DIAG.Task4 DIAG_ACAN.BSG_EXPA.IN_PWR_G1_DIAG.Task4 DIAG_ACAN.BSG_EXPA.IN_PWR_G2_DIAG.Task4 DIAG_ACAN.BSG_EXPA.IN_PWR_G3_DIAG.Task4 DIAG_ACAN.BSG_EXPA.IN_PWR_G4_DIAG.Task4 DIAG_ACAN.BSG_EXPA.IN_PWR_G5_DIAG.Task4 DIAG_ACAN.BSG_EXPA.OUT_01_HB_DIAG.Task4 DIAG_ACAN.BSG_EXPA.OUT_02_HB_DIAG.Task4 DIAG_ACAN.BSG_EXPA.OUT_03_DIAG.Task4 DIAG_ACAN.BSG_EXPA.OUT_04_DIAG.Task4 DIAG_ACAN.BSG_EXPA.OUT_05_HB_DIAG.Task4 DIAG_ACAN.BSG_EXPA.OUT_06_HB_DIAG.Task4 DIAG_ACAN.BSG_EXPA.OUT_07_HB_DIAG.Task4 DIAG_ACAN.BSG_EXPA.OUT_08_HB_DIAG.Task4 DIAG_ACAN.BSG_EXPA.OUT_09_HB_DIAG.Task4 DIAG_ACAN.BSG_EXPA.OUT_10_HB_DIAG.Task4 DIAG_ACAN.BSG_EXPA.OUT_11_DIAG.Task4 DIAG_ACAN.BSG_EXPA.OUT_12_DIAG.Task4 DIAG_ACAN.BSG_EXPA.OUT_12_SENSE_PULSE_DIAG.Task4 DIAG_ACAN.BSG_EXPA.OUT_12_TD_DIAG.Task4 DIAG_ACAN.BSG_EXPA.OUT_13_DIAG.Task4 DIAG_ACAN.BSG_EXPA.OUT_14_DIAG.Task4 DIAG_ACAN.BSG_EXPA.OUT_15_DIAG.Task4 DIAG_ACAN.BSG_EXPA.OUT_16_DIAG.Task4 DIAG_ACAN.BSG_EXPA.OUT_17_DIAG.Task4 DIAG_ACAN.BSG_EXPA.OUT_18_DIAG.Task4 DIAG_ACAN.BSG_EXPA.OUT_19_DIAG.Task4 DIAG_ACAN.BSG_EXPA.OUT_20_DIAG.Task4 DIAG_ACAN.BSG_EXPA.OUT_21_DIAG.Task4 DIAG_ACAN.BSG_EXPA.OUT_21_SENSE_PULSE_DIAG.Task4 DIAG_ACAN.BSG_EXPA.OUT_21_TD_DIAG.Task4 DIAG_ACAN.BSG_EXPA.OUT_22_DIAG.Task4 DIAG_ACAN.BSG_EXPA.OUT_23_DIAG.Task4 DIAG_ACAN.BSG_EXPA.OUT_24_DIAG.Task4 DIAG_ACAN.BSG_EXPA.OUT_25_DIAG.Task4 DIAG_ACAN.BSG_EXPA.OUT_26_DIAG.Task4 DIAG_ACAN.BSG_EXPA.OUT_27_DIAG.Task4 DIAG_ACAN.BSG_EXPA.OUT_28_DIAG.Task4 DIAG_ACAN.BSG_EXPA.OUT_29_HB_DIAG.Task4 DIAG_ACAN.BSG_EXPA.OUT_30_HB_DIAG.Task4 DIAG_ACAN.BSG_EXPA.OUT_31_HB_DIAG.Task4 DIAG_ACAN.BSG_EXPA.OUT_32_HB_DIAG.Task4 DIAG_ACAN.BSG_EXPA.OUT_33_HB_DIAG.Task4 DIAG_ACAN.BSG_EXPA.OUT_34_HB_DIAG.Task4 DIAG_ACAN.BSG_EXPA.OUT_ANA_PWR_01_DIAG.Task4 /end REF_MEASUREMENT
/end GROUP
/begin GROUP SYSTEM.A_CAN.GW_18DAF1E1 "GW_18DAF1E1"
 /begin ANNOTATION ANNOTATION_LABEL "Instance" ANNOTATION_ORIGIN "Group" /begin ANNOTATION_TEXT "0" /end ANNOTATION_TEXT /end ANNOTATION
 /begin ANNOTATION ANNOTATION_LABEL "TaskCycleTime" ANNOTATION_ORIGIN "Group" /begin ANNOTATION_TEXT "0" /end ANNOTATION_TEXT /end ANNOTATION
 /begin ANNOTATION ANNOTATION_LABEL "TimeResolution" ANNOTATION_ORIGIN "Group" /begin ANNOTATION_TEXT "0" /end ANNOTATION_TEXT /end ANNOTATION
 /begin REF_MEASUREMENT OUT_ACAN.GW_18DAF1E1.MessageEnable.Task2 /end REF_MEASUREMENT
/end GROUP
/begin GROUP SYSTEM.A_CAN "A-CAN"
 /begin ANNOTATION ANNOTATION_LABEL "Instance" ANNOTATION_ORIGIN "Group" /begin ANNOTATION_TEXT "0" /end ANNOTATION_TEXT /end ANNOTATION
 /begin ANNOTATION ANNOTATION_LABEL "TaskCycleTime" ANNOTATION_ORIGIN "Group" /begin ANNOTATION_TEXT "0" /end ANNOTATION_TEXT /end ANNOTATION
 /begin ANNOTATION ANNOTATION_LABEL "TimeResolution" ANNOTATION_ORIGIN "Group" /begin ANNOTATION_TEXT "0" /end ANNOTATION_TEXT /end ANNOTATION
 /begin SUB_GROUP SYSTEM.A_CAN.BSG_EXPA SYSTEM.A_CAN.GW_18DAF1E1 /end SUB_GROUP
 /begin REF_MEASUREMENT OUT_ACAN.MessageForwardingEnable.Task2 /end REF_MEASUREMENT
/end GROUP
/begin GROUP SYSTEM.P_CAN.Out_PWM_Ctrl "Out_PWM_Ctrl"
 /begin ANNOTATION ANNOTATION_LABEL "Instance" ANNOTATION_ORIGIN "Group" /begin ANNOTATION_TEXT "1" /end ANNOTATION_TEXT /end ANNOTATION
 /begin ANNOTATION ANNOTATION_LABEL "TaskCycleTime" ANNOTATION_ORIGIN "Group" /begin ANNOTATION_TEXT "0" /end ANNOTATION_TEXT /end ANNOTATION
 /begin ANNOTATION ANNOTATION_LABEL "TimeResolution" ANNOTATION_ORIGIN "Group" /begin ANNOTATION_TEXT "0" /end ANNOTATION_TEXT /end ANNOTATION
 /begin REF_MEASUREMENT IN_PCAN.Rx_Ctrl.Out_PWM_Ctrl.MessageState.Task3 IN_PCAN.Rx_Ctrl.Out_PWM_Ctrl.Out_20_PWM_Ctrl.Task3 IN_PCAN.Rx_Ctrl.Out_PWM_Ctrl.Out_21_PWM_Ctrl.Task3 IN_PCAN.Rx_Ctrl.Out_PWM_Ctrl.Out_22_PWM_Ctrl.Task3 IN_PCAN.Rx_Ctrl.Out_PWM_Ctrl.Out_23_PWM_Ctrl.Task3 IN_PCAN.Rx_Ctrl.Out_PWM_Ctrl.Out_24_PWM_Ctrl.Task3 IN_PCAN.Rx_Ctrl.Out_PWM_Ctrl.Out_25_PWM_Ctrl.Task3 IN_PCAN.Rx_Ctrl.Out_PWM_Ctrl.Out_26_PWM_Ctrl.Task3 IN_PCAN.Rx_Ctrl.Out_PWM_Ctrl.Out_27_PWM_Ctrl.Task3 OUT_PCAN.Rx_Ctrl.Out_PWM_Ctrl.MessageEnable.Task3 /end REF_MEASUREMENT
/end GROUP
/begin GROUP SYSTEM.P_CAN.Out_Ctrl "Out_Ctrl"
 /begin ANNOTATION ANNOTATION_LABEL "Instance" ANNOTATION_ORIGIN "Group" /begin ANNOTATION_TEXT "2" /end ANNOTATION_TEXT /end ANNOTATION
 /begin ANNOTATION ANNOTATION_LABEL "TaskCycleTime" ANNOTATION_ORIGIN "Group" /begin ANNOTATION_TEXT "0" /end ANNOTATION_TEXT /end ANNOTATION
 /begin ANNOTATION ANNOTATION_LABEL "TimeResolution" ANNOTATION_ORIGIN "Group" /begin ANNOTATION_TEXT "0" /end ANNOTATION_TEXT /end ANNOTATION
 /begin REF_MEASUREMENT IN_PCAN.Rx_Ctrl.Out_Ctrl.MessageState.Task3 IN_PCAN.Rx_Ctrl.Out_Ctrl.Out_01_Ctrl.Task3 IN_PCAN.Rx_Ctrl.Out_Ctrl.Out_02_Ctrl.Task3 IN_PCAN.Rx_Ctrl.Out_Ctrl.Out_03_Ctrl.Task3 IN_PCAN.Rx_Ctrl.Out_Ctrl.Out_04_Ctrl.Task3 IN_PCAN.Rx_Ctrl.Out_Ctrl.Out_05_Ctrl.Task3 IN_PCAN.Rx_Ctrl.Out_Ctrl.Out_06_Ctrl.Task3 IN_PCAN.Rx_Ctrl.Out_Ctrl.Out_07_Ctrl.Task3 IN_PCAN.Rx_Ctrl.Out_Ctrl.Out_08_Ctrl.Task3 IN_PCAN.Rx_Ctrl.Out_Ctrl.Out_09_Ctrl.Task3 IN_PCAN.Rx_Ctrl.Out_Ctrl.Out_10_Ctrl.Task3 IN_PCAN.Rx_Ctrl.Out_Ctrl.Out_11_Ctrl.Task3 IN_PCAN.Rx_Ctrl.Out_Ctrl.Out_12_Ctrl.Task3 IN_PCAN.Rx_Ctrl.Out_Ctrl.Out_13_Ctrl.Task3 IN_PCAN.Rx_Ctrl.Out_Ctrl.Out_14_Ctrl.Task3 IN_PCAN.Rx_Ctrl.Out_Ctrl.Out_15_Ctrl.Task3 IN_PCAN.Rx_Ctrl.Out_Ctrl.Out_16_Ctrl.Task3 IN_PCAN.Rx_Ctrl.Out_Ctrl.Out_17_Ctrl.Task3 IN_PCAN.Rx_Ctrl.Out_Ctrl.Out_18_PWM_Ctrl.Task3 IN_PCAN.Rx_Ctrl.Out_Ctrl.Out_19_Ctrl.Task3 IN_PCAN.Rx_Ctrl.Out_Ctrl.Out_Supply_ANA_01_Ctrl.Task3 IN_PCAN.Rx_Ctrl.Out_Ctrl.Out_Supply_ANA_02_Ctrl.Task3 IN_PCAN.Rx_Ctrl.Out_Ctrl.Out_Supply_ANA_03_Ctrl.Task3 IN_PCAN.Rx_Ctrl.Out_Ctrl.WorkingMode.Task3 OUT_PCAN.Rx_Ctrl.Out_Ctrl.MessageEnable.Task3 /end REF_MEASUREMENT
/end GROUP
/begin GROUP SYSTEM.P_CAN.DateTime_SetTime_Ctrl "DateTime_SetTime_Ctrl"
 /begin ANNOTATION ANNOTATION_LABEL "Instance" ANNOTATION_ORIGIN "Group" /begin ANNOTATION_TEXT "3" /end ANNOTATION_TEXT /end ANNOTATION
 /begin ANNOTATION ANNOTATION_LABEL "TaskCycleTime" ANNOTATION_ORIGIN "Group" /begin ANNOTATION_TEXT "0" /end ANNOTATION_TEXT /end ANNOTATION
 /begin ANNOTATION ANNOTATION_LABEL "TimeResolution" ANNOTATION_ORIGIN "Group" /begin ANNOTATION_TEXT "0" /end ANNOTATION_TEXT /end ANNOTATION
 /begin REF_MEASUREMENT IN_PCAN.Rx_Ctrl.DateTime_SetTime_Ctrl.DateTime_NewSystemTime.Task5 IN_PCAN.Rx_Ctrl.DateTime_SetTime_Ctrl.MessageState.Task5 IN_PCAN.Rx_Ctrl.DateTime_SetTime_Ctrl.DateTime_HourOffset.Task5 IN_PCAN.Rx_Ctrl.DateTime_SetTime_Ctrl.DateTime_MinuteOffset.Task5 IN_PCAN.Rx_Ctrl.DateTime_SetTime_Ctrl.DateTime_SetTime.Task5 OUT_PCAN.Rx_Ctrl.DateTime_SetTime_Ctrl.MessageEnable.Task5 /end REF_MEASUREMENT
/end GROUP
/begin GROUP SYSTEM.P_CAN.In_Ana_Ctrl "In_Ana_Ctrl"
 /begin ANNOTATION ANNOTATION_LABEL "Instance" ANNOTATION_ORIGIN "Group" /begin ANNOTATION_TEXT "0" /end ANNOTATION_TEXT /end ANNOTATION
 /begin ANNOTATION ANNOTATION_LABEL "TaskCycleTime" ANNOTATION_ORIGIN "Group" /begin ANNOTATION_TEXT "0" /end ANNOTATION_TEXT /end ANNOTATION
 /begin ANNOTATION ANNOTATION_LABEL "TimeResolution" ANNOTATION_ORIGIN "Group" /begin ANNOTATION_TEXT "0" /end ANNOTATION_TEXT /end ANNOTATION
 /begin REF_MEASUREMENT IN_PCAN.Rx_Ctrl.In_Ana_Ctrl.MessageState.Task3 IN_PCAN.Rx_Ctrl.In_Ana_Ctrl.IN_ANA_08_SWT1.Task3 IN_PCAN.Rx_Ctrl.In_Ana_Ctrl.IN_ANA_09_SWT1.Task3 IN_PCAN.Rx_Ctrl.In_Ana_Ctrl.IN_ANA_10_SWT1.Task3 IN_PCAN.Rx_Ctrl.In_Ana_Ctrl.IN_ANA_11_SWT1.Task3 OUT_PCAN.Rx_Ctrl.In_Ana_Ctrl.MessageEnable.Task3 /end REF_MEASUREMENT
/end GROUP
/begin GROUP SYSTEM.P_CAN.Out_20_TD_Sts "Out_20_TD_Sts"
 /begin ANNOTATION ANNOTATION_LABEL "Instance" ANNOTATION_ORIGIN "Group" /begin ANNOTATION_TEXT "1" /end ANNOTATION_TEXT /end ANNOTATION
 /begin ANNOTATION ANNOTATION_LABEL "TaskCycleTime" ANNOTATION_ORIGIN "Group" /begin ANNOTATION_TEXT "0" /end ANNOTATION_TEXT /end ANNOTATION
 /begin ANNOTATION ANNOTATION_LABEL "TimeResolution" ANNOTATION_ORIGIN "Group" /begin ANNOTATION_TEXT "0" /end ANNOTATION_TEXT /end ANNOTATION
 /begin REF_MEASUREMENT OUT_PCAN.Tx_Out.Out_20_TD_Sts.Out_SENSE_PULSE.Task3 OUT_PCAN.Tx_Out.Out_20_TD_Sts.Out_SENSE_PULSE_DIAG.Task3 OUT_PCAN.Tx_Out.Out_20_TD_Sts.MessageEnable.Task3 /end REF_MEASUREMENT
/end GROUP
/begin GROUP SYSTEM.P_CAN.Out_15_TD_Sts "Out_15_TD_Sts"
 /begin ANNOTATION ANNOTATION_LABEL "Instance" ANNOTATION_ORIGIN "Group" /begin ANNOTATION_TEXT "2" /end ANNOTATION_TEXT /end ANNOTATION
 /begin ANNOTATION ANNOTATION_LABEL "TaskCycleTime" ANNOTATION_ORIGIN "Group" /begin ANNOTATION_TEXT "0" /end ANNOTATION_TEXT /end ANNOTATION
 /begin ANNOTATION ANNOTATION_LABEL "TimeResolution" ANNOTATION_ORIGIN "Group" /begin ANNOTATION_TEXT "0" /end ANNOTATION_TEXT /end ANNOTATION
 /begin REF_MEASUREMENT OUT_PCAN.Tx_Out.Out_15_TD_Sts.Out_SENSE_PULSE.Task3 OUT_PCAN.Tx_Out.Out_15_TD_Sts.Out_SENSE_PULSE_DIAG.Task3 OUT_PCAN.Tx_Out.Out_15_TD_Sts.MessageEnable.Task3 /end REF_MEASUREMENT
/end GROUP
/begin GROUP SYSTEM.P_CAN.Out_14_TD_Sts "Out_14_TD_Sts"
 /begin ANNOTATION ANNOTATION_LABEL "Instance" ANNOTATION_ORIGIN "Group" /begin ANNOTATION_TEXT "3" /end ANNOTATION_TEXT /end ANNOTATION
 /begin ANNOTATION ANNOTATION_LABEL "TaskCycleTime" ANNOTATION_ORIGIN "Group" /begin ANNOTATION_TEXT "0" /end ANNOTATION_TEXT /end ANNOTATION
 /begin ANNOTATION ANNOTATION_LABEL "TimeResolution" ANNOTATION_ORIGIN "Group" /begin ANNOTATION_TEXT "0" /end ANNOTATION_TEXT /end ANNOTATION
 /begin REF_MEASUREMENT OUT_PCAN.Tx_Out.Out_14_TD_Sts.Out_SENSE_PULSE.Task3 OUT_PCAN.Tx_Out.Out_14_TD_Sts.Out_SENSE_PULSE_DIAG.Task3 OUT_PCAN.Tx_Out.Out_14_TD_Sts.MessageEnable.Task3 /end REF_MEASUREMENT
/end GROUP
/begin GROUP SYSTEM.P_CAN.Out_13_TD_Sts "Out_13_TD_Sts"
 /begin ANNOTATION ANNOTATION_LABEL "Instance" ANNOTATION_ORIGIN "Group" /begin ANNOTATION_TEXT "4" /end ANNOTATION_TEXT /end ANNOTATION
 /begin ANNOTATION ANNOTATION_LABEL "TaskCycleTime" ANNOTATION_ORIGIN "Group" /begin ANNOTATION_TEXT "0" /end ANNOTATION_TEXT /end ANNOTATION
 /begin ANNOTATION ANNOTATION_LABEL "TimeResolution" ANNOTATION_ORIGIN "Group" /begin ANNOTATION_TEXT "0" /end ANNOTATION_TEXT /end ANNOTATION
 /begin REF_MEASUREMENT OUT_PCAN.Tx_Out.Out_13_TD_Sts.Out_SENSE_PULSE.Task3 OUT_PCAN.Tx_Out.Out_13_TD_Sts.Out_SENSE_PULSE_DIAG.Task3 OUT_PCAN.Tx_Out.Out_13_TD_Sts.MessageEnable.Task3 /end REF_MEASUREMENT
/end GROUP
/begin GROUP SYSTEM.P_CAN.Out_12_TD_Sts "Out_12_TD_Sts"
 /begin ANNOTATION ANNOTATION_LABEL "Instance" ANNOTATION_ORIGIN "Group" /begin ANNOTATION_TEXT "5" /end ANNOTATION_TEXT /end ANNOTATION
 /begin ANNOTATION ANNOTATION_LABEL "TaskCycleTime" ANNOTATION_ORIGIN "Group" /begin ANNOTATION_TEXT "0" /end ANNOTATION_TEXT /end ANNOTATION
 /begin ANNOTATION ANNOTATION_LABEL "TimeResolution" ANNOTATION_ORIGIN "Group" /begin ANNOTATION_TEXT "0" /end ANNOTATION_TEXT /end ANNOTATION
 /begin REF_MEASUREMENT OUT_PCAN.Tx_Out.Out_12_TD_Sts.Out_SENSE_PULSE.Task3 OUT_PCAN.Tx_Out.Out_12_TD_Sts.Out_SENSE_PULSE_DIAG.Task3 OUT_PCAN.Tx_Out.Out_12_TD_Sts.MessageEnable.Task3 /end REF_MEASUREMENT
/end GROUP
/begin GROUP SYSTEM.P_CAN.Out_08_TD_Sts "Out_08_TD_Sts"
 /begin ANNOTATION ANNOTATION_LABEL "Instance" ANNOTATION_ORIGIN "Group" /begin ANNOTATION_TEXT "6" /end ANNOTATION_TEXT /end ANNOTATION
 /begin ANNOTATION ANNOTATION_LABEL "TaskCycleTime" ANNOTATION_ORIGIN "Group" /begin ANNOTATION_TEXT "0" /end ANNOTATION_TEXT /end ANNOTATION
 /begin ANNOTATION ANNOTATION_LABEL "TimeResolution" ANNOTATION_ORIGIN "Group" /begin ANNOTATION_TEXT "0" /end ANNOTATION_TEXT /end ANNOTATION
 /begin REF_MEASUREMENT OUT_PCAN.Tx_Out.Out_08_TD_Sts.Out_SENSE_PULSE.Task3 OUT_PCAN.Tx_Out.Out_08_TD_Sts.Out_SENSE_PULSE_DIAG.Task3 OUT_PCAN.Tx_Out.Out_08_TD_Sts.MessageEnable.Task3 /end REF_MEASUREMENT
/end GROUP
/begin GROUP SYSTEM.P_CAN.Out_07_TD_Sts "Out_07_TD_Sts"
 /begin ANNOTATION ANNOTATION_LABEL "Instance" ANNOTATION_ORIGIN "Group" /begin ANNOTATION_TEXT "7" /end ANNOTATION_TEXT /end ANNOTATION
 /begin ANNOTATION ANNOTATION_LABEL "TaskCycleTime" ANNOTATION_ORIGIN "Group" /begin ANNOTATION_TEXT "0" /end ANNOTATION_TEXT /end ANNOTATION
 /begin ANNOTATION ANNOTATION_LABEL "TimeResolution" ANNOTATION_ORIGIN "Group" /begin ANNOTATION_TEXT "0" /end ANNOTATION_TEXT /end ANNOTATION
 /begin REF_MEASUREMENT OUT_PCAN.Tx_Out.Out_07_TD_Sts.Out_SENSE_PULSE.Task3 OUT_PCAN.Tx_Out.Out_07_TD_Sts.Out_SENSE_PULSE_DIAG.Task3 OUT_PCAN.Tx_Out.Out_07_TD_Sts.MessageEnable.Task3 /end REF_MEASUREMENT
/end GROUP
/begin COMPU_METHOD COMP_DEFAULT "" RAT_FUNC "%11.5" "Increments" COEFFS 0 1 0 0 0 1 /end COMPU_METHOD
/begin COMPU_METHOD IS_BOOLEAN_TRUE "" RAT_FUNC "%11.5" "" COEFFS 0 1 0 0 0 1 /end COMPU_METHOD
/begin COMPU_METHOD COMP_LINEAR.IN_NVM.Parameter.ModelHoldMinTimeAfterPOR "" RAT_FUNC "%11.5" "" COEFFS 0 1 0 0 0 0.1 /end COMPU_METHOD
/begin COMPU_METHOD COMP_LINEAR.IN_NVM.Parameter.BlinkSourcePeriod "" RAT_FUNC "%11.5" "" COEFFS 0 1 0 0 0 0.04 /end COMPU_METHOD
/begin COMPU_METHOD COMP_LINEAR.IN_NVM.Parameter.TrailerDetectionTime "" RAT_FUNC "%11.5" "" COEFFS 0 1 0 0 0 0.02 /end COMPU_METHOD
/begin COMPU_METHOD COMP_LINEAR.IN_NVM.Parameter.HBrakeTime "" RAT_FUNC "%11.5" "" COEFFS 0 1 0 0 0 0.05 /end COMPU_METHOD
/begin COMPU_METHOD COMP_LINEAR.IN_NVM.Parameter.HMaxActivationTimeTime "" RAT_FUNC "%11.5" "" COEFFS 0 1 0 0 0 0.05 /end COMPU_METHOD
/begin COMPU_METHOD COMP_LINEAR.IN_NVM.Parameter.HOpenLoadDetectTime "" RAT_FUNC "%11.5" "" COEFFS 0 1 0 0 0 0.05 /end COMPU_METHOD
/begin COMPU_METHOD COMP_LINEAR.IN_NVM.Parameter.HOpenLoadIntervalTime "" RAT_FUNC "%11.5" "" COEFFS 0 1 0 0 0 0.05 /end COMPU_METHOD
/begin COMPU_VTAB BSGEvo_Illumi_DutyCycle_Encoding ". " TAB_VERB 4 251 "BSGEvo_Illumi_DutyCycle_Encoding__Parameter_Specific_Indicator" 252 "BSGEvo_Illumi_DutyCycle_Encoding__Reserved_Range_For_Future_Indication" 254 "BSGEvo_Illumi_DutyCycle_Encoding__Error_Indicator" 255 "BSGEvo_Illumi_DutyCycle_Encoding__Not_Available" /end COMPU_VTAB
/end MODULE
/end PROJECT
