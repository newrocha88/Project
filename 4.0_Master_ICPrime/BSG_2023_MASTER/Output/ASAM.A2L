ASAP2_VERSION 1 7
/begin PROJECT BSG_2023_MASTER "BSG_EVO_Master_MBDS_BSG_2023_MASTER"
/begin HEADER "D:\SDBox_MAN_Master_Expansion\Master_ICPrime\BSG_2023_MASTER" VERSION "8.27.01.01_1210" PROJECT_NO _245850671 /end HEADER
/begin MODULE BSG_2023_MASTER "D:\SDBox_MAN_Master_Expansion\Master_ICPrime\BSG_2023_MASTER"
/begin MOD_COMMON "" BYTE_ORDER MSB_LAST /end MOD_COMMON
/begin MEASUREMENT OUT_PCAN.MessageForwardingEnable.Task2 "3.1.2.2.2 MessageForwardingEnable" UBYTE IS_BOOLEAN_TRUE 0 0 0 1 ECU_ADDRESS 0x2049046 READ_WRITE /end MEASUREMENT
/begin MEASUREMENT OUT_PCAN.GW_00000FF3.MessageEnable.Task2 "3.1.2.2.1 MessageEnable" UBYTE IS_BOOLEAN_TRUE 0 0 0 1 ECU_ADDRESS 0x2049045 READ_WRITE /end MEASUREMENT
/begin MEASUREMENT OUT_ICAN.MessageForwardingEnable.Task2 "" UBYTE IS_BOOLEAN_TRUE 0 0 0 1 ECU_ADDRESS 0x2049053 READ_WRITE /end MEASUREMENT
/begin MEASUREMENT OUT_ICAN.BSG_TX_18DA1721.Ctrl50_ScrDA2.MessageEnable.Task2 "" UBYTE IS_BOOLEAN_TRUE 0 0 0 1 ECU_ADDRESS 0x2049049 READ_WRITE /end MEASUREMENT
/begin MEASUREMENT OUT_ICAN.BSG_TX_18DA1721.Ctrl50_ScrDA1.MessageEnable.Task2 "" UBYTE IS_BOOLEAN_TRUE 0 0 0 1 ECU_ADDRESS 0x204904A READ_WRITE /end MEASUREMENT
/begin MEASUREMENT OUT_ICAN.BSG_TX_18DA1721.Ctrl50_FcnDA2.MessageEnable.Task2 "" UBYTE IS_BOOLEAN_TRUE 0 0 0 1 ECU_ADDRESS 0x204904B READ_WRITE /end MEASUREMENT
/begin MEASUREMENT OUT_ICAN.BSG_TX_18DA1721.Ctrl50_FcnDA1.MessageEnable.Task2 "" UBYTE IS_BOOLEAN_TRUE 0 0 0 1 ECU_ADDRESS 0x204904C READ_WRITE /end MEASUREMENT
/begin MEASUREMENT OUT_ICAN.BSG_TX_18DA1721.Ctrl50_SubView.MessageEnable.Task2 "" UBYTE IS_BOOLEAN_TRUE 0 0 0 1 ECU_ADDRESS 0x204904D READ_WRITE /end MEASUREMENT
/begin MEASUREMENT OUT_ICAN.BSG_TX_18DA1721.ICHMI1CTRL.MessageEnable.Task2 "" UBYTE IS_BOOLEAN_TRUE 0 0 0 1 ECU_ADDRESS 0x204904E READ_WRITE /end MEASUREMENT
/begin MEASUREMENT OUT_ICAN.BSG_TX_18DA1721.ICOM1CTRL.ICOMCtrl.Task2 "" UBYTE COMP_DEFAULT 0 0 0 15 ECU_ADDRESS 0x2049047 READ_WRITE /end MEASUREMENT
/begin MEASUREMENT OUT_ICAN.BSG_TX_18DA1721.ICOM1CTRL.MessageEnable.Task2 "" UBYTE IS_BOOLEAN_TRUE 0 0 0 1 ECU_ADDRESS 0x2049048 READ_WRITE /end MEASUREMENT
/begin MEASUREMENT OUT_ICAN.GW_00000FF4.MessageEnable.Task2 "3.1.2.2.1 MessageEnable" UBYTE IS_BOOLEAN_TRUE 0 0 0 1 ECU_ADDRESS 0x2049050 READ_WRITE /end MEASUREMENT
/begin MEASUREMENT OUT_ICAN.GW_18DAF017.MessageEnable.Task2 "3.1.2.2.1 MessageEnable" UBYTE IS_BOOLEAN_TRUE 0 0 0 1 ECU_ADDRESS 0x2049051 READ_WRITE /end MEASUREMENT
/begin MEASUREMENT OUT_ICAN.GW_18DAF117.MessageEnable.Task2 "3.1.2.2.1 MessageEnable" UBYTE IS_BOOLEAN_TRUE 0 0 0 1 ECU_ADDRESS 0x2049052 READ_WRITE /end MEASUREMENT
/begin MEASUREMENT OUT_ICAN.GW_00000600.MessageEnable.Task2 "3.1.2.2.1 MessageEnable" UBYTE IS_BOOLEAN_TRUE 0 0 0 1 ECU_ADDRESS 0x204904F READ_WRITE /end MEASUREMENT
/begin MEASUREMENT OUT_FMSCAN.MessageForwardingEnable.Task2 "3.1.2.2.2 MessageForwardingEnable" UBYTE IS_BOOLEAN_TRUE 0 0 0 1 ECU_ADDRESS 0x2049055 READ_WRITE /end MEASUREMENT
/begin MEASUREMENT IN_FMSCAN.Rx_Ctrl.Out_HB_Ctrl.MessageState.Task4 "3.2.2.1.1 MessageState" UWORD COMP_DEFAULT 0 0 0 65535 ECU_ADDRESS 0x20401C8 READ_WRITE /end MEASUREMENT
/begin MEASUREMENT IN_FMSCAN.Rx_Ctrl.Out_HB_Ctrl.Out_01_HB_Ctrl.Task4 "" UBYTE COMP_DEFAULT 0 0 0 255 ECU_ADDRESS 0x20401CA READ_WRITE /end MEASUREMENT
/begin MEASUREMENT IN_FMSCAN.Rx_Ctrl.Out_HB_Ctrl.Out_02_HB_Ctrl.Task4 "" UBYTE COMP_DEFAULT 0 0 0 255 ECU_ADDRESS 0x20401CB READ_WRITE /end MEASUREMENT
/begin MEASUREMENT IN_FMSCAN.Rx_Ctrl.Out_HB_Ctrl.Out_05_HB_Ctrl.Task4 "" UBYTE COMP_DEFAULT 0 0 0 255 ECU_ADDRESS 0x20401CC READ_WRITE /end MEASUREMENT
/begin MEASUREMENT IN_FMSCAN.Rx_Ctrl.Out_HB_Ctrl.Out_06_HB_Ctrl.Task4 "" UBYTE COMP_DEFAULT 0 0 0 255 ECU_ADDRESS 0x20401CD READ_WRITE /end MEASUREMENT
/begin MEASUREMENT IN_FMSCAN.Rx_Ctrl.Out_HB_Ctrl.Out_07_HB_Ctrl.Task4 "" UBYTE COMP_DEFAULT 0 0 0 255 ECU_ADDRESS 0x20401CE READ_WRITE /end MEASUREMENT
/begin MEASUREMENT IN_FMSCAN.Rx_Ctrl.Out_HB_Ctrl.Out_08_HB_Ctrl.Task4 "" UBYTE COMP_DEFAULT 0 0 0 255 ECU_ADDRESS 0x20401CF READ_WRITE /end MEASUREMENT
/begin MEASUREMENT IN_FMSCAN.Rx_Ctrl.Out_HB_Ctrl.Out_09_HB_Ctrl.Task4 "" UBYTE COMP_DEFAULT 0 0 0 255 ECU_ADDRESS 0x20401D0 READ_WRITE /end MEASUREMENT
/begin MEASUREMENT IN_FMSCAN.Rx_Ctrl.Out_HB_Ctrl.Out_10_HB_Ctrl.Task4 "" UBYTE COMP_DEFAULT 0 0 0 255 ECU_ADDRESS 0x20401D1 READ_WRITE /end MEASUREMENT
/begin MEASUREMENT OUT_FMSCAN.Rx_Ctrl.Out_HB_Ctrl.MessageEnable.Task4 "3.2.2.2.1 MessageEnable" UBYTE IS_BOOLEAN_TRUE 0 0 0 1 ECU_ADDRESS 0x204B02D READ_WRITE /end MEASUREMENT
/begin MEASUREMENT IN_FMSCAN.Rx_Ctrl.Out_Ctrl.MessageState.Task4 "3.2.2.1.1 MessageState" UWORD COMP_DEFAULT 0 0 0 65535 ECU_ADDRESS 0x20401D2 READ_WRITE /end MEASUREMENT
/begin MEASUREMENT IN_FMSCAN.Rx_Ctrl.Out_Ctrl.Out_03_Ctrl.Task4 "" UBYTE IS_BOOLEAN_TRUE 0 0 0 1 ECU_ADDRESS 0x20401D4 READ_WRITE /end MEASUREMENT
/begin MEASUREMENT IN_FMSCAN.Rx_Ctrl.Out_Ctrl.Out_04_Ctrl.Task4 "" UBYTE IS_BOOLEAN_TRUE 0 0 0 1 ECU_ADDRESS 0x20401D5 READ_WRITE /end MEASUREMENT
/begin MEASUREMENT IN_FMSCAN.Rx_Ctrl.Out_Ctrl.Out_11_Ctrl.Task4 "" UBYTE IS_BOOLEAN_TRUE 0 0 0 1 ECU_ADDRESS 0x20401D6 READ_WRITE /end MEASUREMENT
/begin MEASUREMENT IN_FMSCAN.Rx_Ctrl.Out_Ctrl.Out_12_Ctrl.Task4 "" UBYTE IS_BOOLEAN_TRUE 0 0 0 1 ECU_ADDRESS 0x20401D7 READ_WRITE /end MEASUREMENT
/begin MEASUREMENT IN_FMSCAN.Rx_Ctrl.Out_Ctrl.Out_13_Ctrl.Task4 "" UBYTE IS_BOOLEAN_TRUE 0 0 0 1 ECU_ADDRESS 0x20401D8 READ_WRITE /end MEASUREMENT
/begin MEASUREMENT IN_FMSCAN.Rx_Ctrl.Out_Ctrl.Out_14_Ctrl.Task4 "" UBYTE IS_BOOLEAN_TRUE 0 0 0 1 ECU_ADDRESS 0x20401D9 READ_WRITE /end MEASUREMENT
/begin MEASUREMENT IN_FMSCAN.Rx_Ctrl.Out_Ctrl.Out_15_Ctrl.Task4 "" UBYTE IS_BOOLEAN_TRUE 0 0 0 1 ECU_ADDRESS 0x20401DA READ_WRITE /end MEASUREMENT
/begin MEASUREMENT IN_FMSCAN.Rx_Ctrl.Out_Ctrl.Out_16_Ctrl.Task4 "" UBYTE IS_BOOLEAN_TRUE 0 0 0 1 ECU_ADDRESS 0x20401DB READ_WRITE /end MEASUREMENT
/begin MEASUREMENT IN_FMSCAN.Rx_Ctrl.Out_Ctrl.Out_17_Ctrl.Task4 "" UBYTE IS_BOOLEAN_TRUE 0 0 0 1 ECU_ADDRESS 0x20401DC READ_WRITE /end MEASUREMENT
/begin MEASUREMENT IN_FMSCAN.Rx_Ctrl.Out_Ctrl.Out_18_Ctrl.Task4 "" UBYTE IS_BOOLEAN_TRUE 0 0 0 1 ECU_ADDRESS 0x20401DD READ_WRITE /end MEASUREMENT
/begin MEASUREMENT IN_FMSCAN.Rx_Ctrl.Out_Ctrl.Out_19_Ctrl.Task4 "" UBYTE IS_BOOLEAN_TRUE 0 0 0 1 ECU_ADDRESS 0x20401DE READ_WRITE /end MEASUREMENT
/begin MEASUREMENT IN_FMSCAN.Rx_Ctrl.Out_Ctrl.Out_20_Ctrl.Task4 "" UBYTE IS_BOOLEAN_TRUE 0 0 0 1 ECU_ADDRESS 0x20401DF READ_WRITE /end MEASUREMENT
/begin MEASUREMENT IN_FMSCAN.Rx_Ctrl.Out_Ctrl.Out_21_Ctrl.Task4 "" UBYTE IS_BOOLEAN_TRUE 0 0 0 1 ECU_ADDRESS 0x20401E0 READ_WRITE /end MEASUREMENT
/begin MEASUREMENT IN_FMSCAN.Rx_Ctrl.Out_Ctrl.Out_22_Ctrl.Task4 "" UBYTE IS_BOOLEAN_TRUE 0 0 0 1 ECU_ADDRESS 0x20401E1 READ_WRITE /end MEASUREMENT
/begin MEASUREMENT IN_FMSCAN.Rx_Ctrl.Out_Ctrl.Out_23_Ctrl.Task4 "" UBYTE IS_BOOLEAN_TRUE 0 0 0 1 ECU_ADDRESS 0x20401E2 READ_WRITE /end MEASUREMENT
/begin MEASUREMENT IN_FMSCAN.Rx_Ctrl.Out_Ctrl.Out_24_Ctrl.Task4 "" UBYTE IS_BOOLEAN_TRUE 0 0 0 1 ECU_ADDRESS 0x20401E3 READ_WRITE /end MEASUREMENT
/begin MEASUREMENT IN_FMSCAN.Rx_Ctrl.Out_Ctrl.Out_25_Ctrl.Task4 "" UBYTE IS_BOOLEAN_TRUE 0 0 0 1 ECU_ADDRESS 0x20401E4 READ_WRITE /end MEASUREMENT
/begin MEASUREMENT IN_FMSCAN.Rx_Ctrl.Out_Ctrl.Out_26_Ctrl.Task4 "" UBYTE IS_BOOLEAN_TRUE 0 0 0 1 ECU_ADDRESS 0x20401E5 READ_WRITE /end MEASUREMENT
/begin MEASUREMENT IN_FMSCAN.Rx_Ctrl.Out_Ctrl.Out_27_Ctrl.Task4 "" UBYTE IS_BOOLEAN_TRUE 0 0 0 1 ECU_ADDRESS 0x20401E6 READ_WRITE /end MEASUREMENT
/begin MEASUREMENT IN_FMSCAN.Rx_Ctrl.Out_Ctrl.Out_28_Ctrl.Task4 "" UBYTE IS_BOOLEAN_TRUE 0 0 0 1 ECU_ADDRESS 0x20401E7 READ_WRITE /end MEASUREMENT
/begin MEASUREMENT IN_FMSCAN.Rx_Ctrl.Out_Ctrl.Out_OLD_01_Ctrl.Task4 "" UBYTE IS_BOOLEAN_TRUE 0 0 0 1 ECU_ADDRESS 0x20401E8 READ_WRITE /end MEASUREMENT
/begin MEASUREMENT IN_FMSCAN.Rx_Ctrl.Out_Ctrl.Out_OLD_02_Ctrl.Task4 "" UBYTE IS_BOOLEAN_TRUE 0 0 0 1 ECU_ADDRESS 0x20401E9 READ_WRITE /end MEASUREMENT
/begin MEASUREMENT IN_FMSCAN.Rx_Ctrl.Out_Ctrl.Out_OLD_03_Ctrl.Task4 "" UBYTE IS_BOOLEAN_TRUE 0 0 0 1 ECU_ADDRESS 0x20401EA READ_WRITE /end MEASUREMENT
/begin MEASUREMENT IN_FMSCAN.Rx_Ctrl.Out_Ctrl.Out_OLD_04_Ctrl.Task4 "" UBYTE IS_BOOLEAN_TRUE 0 0 0 1 ECU_ADDRESS 0x20401EB READ_WRITE /end MEASUREMENT
/begin MEASUREMENT IN_FMSCAN.Rx_Ctrl.Out_Ctrl.Out_Supply_ANA_01_Ctrl.Task4 "" UBYTE IS_BOOLEAN_TRUE 0 0 0 1 ECU_ADDRESS 0x20401EC READ_WRITE /end MEASUREMENT
/begin MEASUREMENT IN_FMSCAN.Rx_Ctrl.Out_Ctrl.WorkingMode.Task4 "" UBYTE IS_BOOLEAN_TRUE 0 0 0 1 ECU_ADDRESS 0x20401ED READ_WRITE /end MEASUREMENT
/begin MEASUREMENT OUT_FMSCAN.Rx_Ctrl.Out_Ctrl.MessageEnable.Task4 "3.2.2.2.1 MessageEnable" UBYTE IS_BOOLEAN_TRUE 0 0 0 1 ECU_ADDRESS 0x204B02E READ_WRITE /end MEASUREMENT
/begin MEASUREMENT IN_FMSCAN.Rx_Ctrl.Out_Mirror_HB_Ctrl.MessageState.Task4 "3.2.2.1.1 MessageState" UWORD COMP_DEFAULT 0 0 0 65535 ECU_ADDRESS 0x20401C0 READ_WRITE /end MEASUREMENT
/begin MEASUREMENT IN_FMSCAN.Rx_Ctrl.Out_Mirror_HB_Ctrl.Out_29_HB_Ctrl.Task4 "" UBYTE COMP_DEFAULT 0 0 0 255 ECU_ADDRESS 0x20401C2 READ_WRITE /end MEASUREMENT
/begin MEASUREMENT IN_FMSCAN.Rx_Ctrl.Out_Mirror_HB_Ctrl.Out_30_HB_Ctrl.Task4 "" UBYTE COMP_DEFAULT 0 0 0 255 ECU_ADDRESS 0x20401C3 READ_WRITE /end MEASUREMENT
/begin MEASUREMENT IN_FMSCAN.Rx_Ctrl.Out_Mirror_HB_Ctrl.Out_31_HB_Ctrl.Task4 "" UBYTE COMP_DEFAULT 0 0 0 255 ECU_ADDRESS 0x20401C4 READ_WRITE /end MEASUREMENT
/begin MEASUREMENT IN_FMSCAN.Rx_Ctrl.Out_Mirror_HB_Ctrl.Out_32_HB_Ctrl.Task4 "" UBYTE COMP_DEFAULT 0 0 0 255 ECU_ADDRESS 0x20401C5 READ_WRITE /end MEASUREMENT
/begin MEASUREMENT IN_FMSCAN.Rx_Ctrl.Out_Mirror_HB_Ctrl.Out_33_HB_Ctrl.Task4 "" UBYTE COMP_DEFAULT 0 0 0 255 ECU_ADDRESS 0x20401C6 READ_WRITE /end MEASUREMENT
/begin MEASUREMENT IN_FMSCAN.Rx_Ctrl.Out_Mirror_HB_Ctrl.Out_34_HB_Ctrl.Task4 "" UBYTE COMP_DEFAULT 0 0 0 255 ECU_ADDRESS 0x20401C7 READ_WRITE /end MEASUREMENT
/begin MEASUREMENT OUT_FMSCAN.Rx_Ctrl.Out_Mirror_HB_Ctrl.MessageEnable.Task4 "3.2.2.2.1 MessageEnable" UBYTE IS_BOOLEAN_TRUE 0 0 0 1 ECU_ADDRESS 0x204B02C READ_WRITE /end MEASUREMENT
/begin MEASUREMENT OUT_FMSCAN.Tx_Out.Out_12_TD_Sts.Out_SENSE_PULSE.Task4 "" UWORD COMP_DEFAULT 0 0 0 0 ECU_ADDRESS 0x204B036 READ_WRITE /end MEASUREMENT
/begin MEASUREMENT OUT_FMSCAN.Tx_Out.Out_12_TD_Sts.Out_SENSE_PULSE_DIAG.Task4 "" UWORD COMP_DEFAULT 0 0 0 0 ECU_ADDRESS 0x204B038 READ_WRITE /end MEASUREMENT
/begin MEASUREMENT OUT_FMSCAN.Tx_Out.Out_12_TD_Sts.MessageEnable.Task4 "3.3.2.2.1 MessageEnable" UBYTE IS_BOOLEAN_TRUE 0 0 0 1 ECU_ADDRESS 0x204B03A READ_WRITE /end MEASUREMENT
/begin MEASUREMENT OUT_FMSCAN.Tx_Ana.In_Ana_12_Sts.IN_ANA_Val.Task4 "" ULONG COMP_DEFAULT 0 0 0 4294967295 ECU_ADDRESS 0x204B03C READ_WRITE /end MEASUREMENT
/begin MEASUREMENT OUT_FMSCAN.Tx_Ana.In_Ana_12_Sts.IN_ANA_DIAG.Task4 "" UWORD COMP_DEFAULT 0 0 0 65535 ECU_ADDRESS 0x204B040 READ_WRITE /end MEASUREMENT
/begin MEASUREMENT OUT_FMSCAN.Tx_Ana.In_Ana_12_Sts.MessageEnable.Task4 "3.3.2.2.1 MessageEnable" UBYTE IS_BOOLEAN_TRUE 0 0 0 1 ECU_ADDRESS 0x204B042 READ_WRITE /end MEASUREMENT
/begin MEASUREMENT OUT_FMSCAN.Tx_Ana.In_Ana_11_Sts.IN_ANA_Val.Task4 "" ULONG COMP_DEFAULT 0 0 0 4294967295 ECU_ADDRESS 0x204B044 READ_WRITE /end MEASUREMENT
/begin MEASUREMENT OUT_FMSCAN.Tx_Ana.In_Ana_11_Sts.IN_ANA_DIAG.Task4 "" UWORD COMP_DEFAULT 0 0 0 65535 ECU_ADDRESS 0x204B048 READ_WRITE /end MEASUREMENT
/begin MEASUREMENT OUT_FMSCAN.Tx_Ana.In_Ana_11_Sts.MessageEnable.Task4 "3.3.2.2.1 MessageEnable" UBYTE IS_BOOLEAN_TRUE 0 0 0 1 ECU_ADDRESS 0x204B04A READ_WRITE /end MEASUREMENT
/begin MEASUREMENT OUT_FMSCAN.Tx_Ana.In_Ana_09_Sts.IN_ANA_Val.Task4 "" ULONG COMP_DEFAULT 0 0 0 4294967295 ECU_ADDRESS 0x204B04C READ_WRITE /end MEASUREMENT
/begin MEASUREMENT OUT_FMSCAN.Tx_Ana.In_Ana_09_Sts.IN_ANA_DIAG.Task4 "" UWORD COMP_DEFAULT 0 0 0 65535 ECU_ADDRESS 0x204B050 READ_WRITE /end MEASUREMENT
/begin MEASUREMENT OUT_FMSCAN.Tx_Ana.In_Ana_09_Sts.MessageEnable.Task4 "3.3.2.2.1 MessageEnable" UBYTE IS_BOOLEAN_TRUE 0 0 0 1 ECU_ADDRESS 0x204B052 READ_WRITE /end MEASUREMENT
/begin MEASUREMENT OUT_FMSCAN.Tx_Ana.In_Ana_08_Sts.IN_ANA_Val.Task4 "" ULONG COMP_DEFAULT 0 0 0 4294967295 ECU_ADDRESS 0x204B054 READ_WRITE /end MEASUREMENT
/begin MEASUREMENT OUT_FMSCAN.Tx_Ana.In_Ana_08_Sts.IN_ANA_DIAG.Task4 "" UWORD COMP_DEFAULT 0 0 0 65535 ECU_ADDRESS 0x204B058 READ_WRITE /end MEASUREMENT
/begin MEASUREMENT OUT_FMSCAN.Tx_Ana.In_Ana_08_Sts.MessageEnable.Task4 "3.3.2.2.1 MessageEnable" UBYTE IS_BOOLEAN_TRUE 0 0 0 1 ECU_ADDRESS 0x204B05A READ_WRITE /end MEASUREMENT
/begin MEASUREMENT OUT_FMSCAN.Tx_Ana.In_Ana_07_Sts.IN_ANA_Val.Task4 "" ULONG COMP_DEFAULT 0 0 0 4294967295 ECU_ADDRESS 0x204B05C READ_WRITE /end MEASUREMENT
/begin MEASUREMENT OUT_FMSCAN.Tx_Ana.In_Ana_07_Sts.IN_ANA_DIAG.Task4 "" UWORD COMP_DEFAULT 0 0 0 65535 ECU_ADDRESS 0x204B060 READ_WRITE /end MEASUREMENT
/begin MEASUREMENT OUT_FMSCAN.Tx_Ana.In_Ana_07_Sts.MessageEnable.Task4 "3.3.2.2.1 MessageEnable" UBYTE IS_BOOLEAN_TRUE 0 0 0 1 ECU_ADDRESS 0x204B062 READ_WRITE /end MEASUREMENT
/begin MEASUREMENT OUT_FMSCAN.Tx_Ana.In_Ana_06_Sts.IN_ANA_Val.Task4 "" ULONG COMP_DEFAULT 0 0 0 4294967295 ECU_ADDRESS 0x204B064 READ_WRITE /end MEASUREMENT
/begin MEASUREMENT OUT_FMSCAN.Tx_Ana.In_Ana_06_Sts.IN_ANA_DIAG.Task4 "" UWORD COMP_DEFAULT 0 0 0 65535 ECU_ADDRESS 0x204B068 READ_WRITE /end MEASUREMENT
/begin MEASUREMENT OUT_FMSCAN.Tx_Ana.In_Ana_06_Sts.MessageEnable.Task4 "3.3.2.2.1 MessageEnable" UBYTE IS_BOOLEAN_TRUE 0 0 0 1 ECU_ADDRESS 0x204B06A READ_WRITE /end MEASUREMENT
/begin MEASUREMENT OUT_FMSCAN.Tx_Ana.In_Ana_05_Sts.IN_ANA_Val.Task4 "" ULONG COMP_DEFAULT 0 0 0 4294967295 ECU_ADDRESS 0x204B06C READ_WRITE /end MEASUREMENT
/begin MEASUREMENT OUT_FMSCAN.Tx_Ana.In_Ana_05_Sts.IN_ANA_DIAG.Task4 "" UWORD COMP_DEFAULT 0 0 0 65535 ECU_ADDRESS 0x204B070 READ_WRITE /end MEASUREMENT
/begin MEASUREMENT OUT_FMSCAN.Tx_Ana.In_Ana_05_Sts.MessageEnable.Task4 "3.3.2.2.1 MessageEnable" UBYTE IS_BOOLEAN_TRUE 0 0 0 1 ECU_ADDRESS 0x204B072 READ_WRITE /end MEASUREMENT
/begin MEASUREMENT OUT_FMSCAN.Tx_Ana.In_Ana_04_Sts.IN_ANA_Val.Task4 "" ULONG COMP_DEFAULT 0 0 0 4294967295 ECU_ADDRESS 0x204B074 READ_WRITE /end MEASUREMENT
/begin MEASUREMENT OUT_FMSCAN.Tx_Ana.In_Ana_04_Sts.IN_ANA_DIAG.Task4 "" UWORD COMP_DEFAULT 0 0 0 65535 ECU_ADDRESS 0x204B078 READ_WRITE /end MEASUREMENT
/begin MEASUREMENT OUT_FMSCAN.Tx_Ana.In_Ana_04_Sts.MessageEnable.Task4 "3.3.2.2.1 MessageEnable" UBYTE IS_BOOLEAN_TRUE 0 0 0 1 ECU_ADDRESS 0x204B07A READ_WRITE /end MEASUREMENT
/begin MEASUREMENT OUT_FMSCAN.Tx_Ana.In_Ana_03_Sts.IN_ANA_Val.Task4 "" ULONG COMP_DEFAULT 0 0 0 4294967295 ECU_ADDRESS 0x204B07C READ_WRITE /end MEASUREMENT
/begin MEASUREMENT OUT_FMSCAN.Tx_Ana.In_Ana_03_Sts.IN_ANA_DIAG.Task4 "" UWORD COMP_DEFAULT 0 0 0 65535 ECU_ADDRESS 0x204B080 READ_WRITE /end MEASUREMENT
/begin MEASUREMENT OUT_FMSCAN.Tx_Ana.In_Ana_03_Sts.MessageEnable.Task4 "3.3.2.2.1 MessageEnable" UBYTE IS_BOOLEAN_TRUE 0 0 0 1 ECU_ADDRESS 0x204B082 READ_WRITE /end MEASUREMENT
/begin MEASUREMENT OUT_FMSCAN.Tx_Ana.In_Ana_02_Sts.IN_ANA_Val.Task4 "" ULONG COMP_DEFAULT 0 0 0 4294967295 ECU_ADDRESS 0x204B084 READ_WRITE /end MEASUREMENT
/begin MEASUREMENT OUT_FMSCAN.Tx_Ana.In_Ana_02_Sts.IN_ANA_DIAG.Task4 "" UWORD COMP_DEFAULT 0 0 0 65535 ECU_ADDRESS 0x204B088 READ_WRITE /end MEASUREMENT
/begin MEASUREMENT OUT_FMSCAN.Tx_Ana.In_Ana_02_Sts.MessageEnable.Task4 "3.3.2.2.1 MessageEnable" UBYTE IS_BOOLEAN_TRUE 0 0 0 1 ECU_ADDRESS 0x204B08A READ_WRITE /end MEASUREMENT
/begin MEASUREMENT OUT_FMSCAN.Tx_Ana.In_Ana_01_Sts.IN_ANA_Val.Task4 "" ULONG COMP_DEFAULT 0 0 0 4294967295 ECU_ADDRESS 0x204B08C READ_WRITE /end MEASUREMENT
/begin MEASUREMENT OUT_FMSCAN.Tx_Ana.In_Ana_01_Sts.IN_ANA_DIAG.Task4 "" UWORD COMP_DEFAULT 0 0 0 65535 ECU_ADDRESS 0x204B090 READ_WRITE /end MEASUREMENT
/begin MEASUREMENT OUT_FMSCAN.Tx_Ana.In_Ana_01_Sts.MessageEnable.Task4 "3.3.2.2.1 MessageEnable" UBYTE IS_BOOLEAN_TRUE 0 0 0 1 ECU_ADDRESS 0x204B092 READ_WRITE /end MEASUREMENT
/begin MEASUREMENT OUT_FMSCAN.Tx_Freq.In_Freq_01_Sts.Value.Task4 "" UWORD COMP_DEFAULT 0 0 0 0 ECU_ADDRESS 0x204B094 READ_WRITE /end MEASUREMENT
/begin MEASUREMENT OUT_FMSCAN.Tx_Freq.In_Freq_01_Sts.MessageEnable.Task4 "3.3.2.2.1 MessageEnable" UBYTE IS_BOOLEAN_TRUE 0 0 0 1 ECU_ADDRESS 0x204B096 READ_WRITE /end MEASUREMENT
/begin MEASUREMENT OUT_FMSCAN.Tx_Exp.BSG_Expansion_Sts.BatteryVoltage.Task4 "" UWORD COMP_DEFAULT 0 0 0 65535 ECU_ADDRESS 0x204B098 READ_WRITE /end MEASUREMENT
/begin MEASUREMENT OUT_FMSCAN.Tx_Exp.BSG_Expansion_Sts.MessageEnable.Task4 "3.3.2.2.1 MessageEnable" UBYTE IS_BOOLEAN_TRUE 0 0 0 1 ECU_ADDRESS 0x204B09A READ_WRITE /end MEASUREMENT
/begin MEASUREMENT OUT_FMSCAN.Tx_Pwr.PWR_G5_Sts.PWR_Gx_DIAG.Task4 "" UWORD COMP_DEFAULT 0 0 0 65535 ECU_ADDRESS 0x204B09C READ_WRITE /end MEASUREMENT
/begin MEASUREMENT OUT_FMSCAN.Tx_Pwr.PWR_G5_Sts.PWR_Gx_Val.Task4 "" UWORD COMP_DEFAULT 0 0 0 65535 ECU_ADDRESS 0x204B09E READ_WRITE /end MEASUREMENT
/begin MEASUREMENT OUT_FMSCAN.Tx_Pwr.PWR_G5_Sts.MessageEnable.Task4 "3.3.2.2.1 MessageEnable" UBYTE IS_BOOLEAN_TRUE 0 0 0 1 ECU_ADDRESS 0x204B0A0 READ_WRITE /end MEASUREMENT
/begin MEASUREMENT OUT_FMSCAN.Tx_Pwr.PWR_G4_Sts.PWR_Gx_DIAG.Task4 "" UWORD COMP_DEFAULT 0 0 0 65535 ECU_ADDRESS 0x204B0A2 READ_WRITE /end MEASUREMENT
/begin MEASUREMENT OUT_FMSCAN.Tx_Pwr.PWR_G4_Sts.PWR_Gx_Val.Task4 "" UWORD COMP_DEFAULT 0 0 0 65535 ECU_ADDRESS 0x204B0A4 READ_WRITE /end MEASUREMENT
/begin MEASUREMENT OUT_FMSCAN.Tx_Pwr.PWR_G4_Sts.MessageEnable.Task4 "3.3.2.2.1 MessageEnable" UBYTE IS_BOOLEAN_TRUE 0 0 0 1 ECU_ADDRESS 0x204B0A6 READ_WRITE /end MEASUREMENT
/begin MEASUREMENT OUT_FMSCAN.Tx_Pwr.PWR_G3_Sts.PWR_Gx_DIAG.Task4 "" UWORD COMP_DEFAULT 0 0 0 65535 ECU_ADDRESS 0x204B0A8 READ_WRITE /end MEASUREMENT
/begin MEASUREMENT OUT_FMSCAN.Tx_Pwr.PWR_G3_Sts.PWR_Gx_Val.Task4 "" UWORD COMP_DEFAULT 0 0 0 65535 ECU_ADDRESS 0x204B0AA READ_WRITE /end MEASUREMENT
/begin MEASUREMENT OUT_FMSCAN.Tx_Pwr.PWR_G3_Sts.MessageEnable.Task4 "3.3.2.2.1 MessageEnable" UBYTE IS_BOOLEAN_TRUE 0 0 0 1 ECU_ADDRESS 0x204B0AC READ_WRITE /end MEASUREMENT
/begin MEASUREMENT OUT_FMSCAN.Tx_Pwr.PWR_G2_Sts.PWR_Gx_DIAG.Task4 "" UWORD COMP_DEFAULT 0 0 0 65535 ECU_ADDRESS 0x204B0AE READ_WRITE /end MEASUREMENT
/begin MEASUREMENT OUT_FMSCAN.Tx_Pwr.PWR_G2_Sts.PWR_Gx_Val.Task4 "" UWORD COMP_DEFAULT 0 0 0 65535 ECU_ADDRESS 0x204B0B0 READ_WRITE /end MEASUREMENT
/begin MEASUREMENT OUT_FMSCAN.Tx_Pwr.PWR_G2_Sts.MessageEnable.Task4 "3.3.2.2.1 MessageEnable" UBYTE IS_BOOLEAN_TRUE 0 0 0 1 ECU_ADDRESS 0x204B0B2 READ_WRITE /end MEASUREMENT
/begin MEASUREMENT OUT_FMSCAN.Tx_Pwr.PWR_G1_Sts.PWR_Gx_DIAG.Task4 "" UWORD COMP_DEFAULT 0 0 0 65535 ECU_ADDRESS 0x204B0B4 READ_WRITE /end MEASUREMENT
/begin MEASUREMENT OUT_FMSCAN.Tx_Pwr.PWR_G1_Sts.PWR_Gx_Val.Task4 "" UWORD COMP_DEFAULT 0 0 0 65535 ECU_ADDRESS 0x204B0B6 READ_WRITE /end MEASUREMENT
/begin MEASUREMENT OUT_FMSCAN.Tx_Pwr.PWR_G1_Sts.MessageEnable.Task4 "3.3.2.2.1 MessageEnable" UBYTE IS_BOOLEAN_TRUE 0 0 0 1 ECU_ADDRESS 0x204B0B8 READ_WRITE /end MEASUREMENT
/begin MEASUREMENT OUT_FMSCAN.Tx_Pwr.PWR_Sts.PWR_Val.Task4 "" ULONG COMP_DEFAULT 0 0 0 4294967295 ECU_ADDRESS 0x204B0BC READ_WRITE /end MEASUREMENT
/begin MEASUREMENT OUT_FMSCAN.Tx_Pwr.PWR_Sts.PWR_DIAG.Task4 "" UWORD COMP_DEFAULT 0 0 0 65535 ECU_ADDRESS 0x204B0C0 READ_WRITE /end MEASUREMENT
/begin MEASUREMENT OUT_FMSCAN.Tx_Pwr.PWR_Sts.MessageEnable.Task4 "3.3.2.2.1 MessageEnable" UBYTE IS_BOOLEAN_TRUE 0 0 0 1 ECU_ADDRESS 0x204B0C2 READ_WRITE /end MEASUREMENT
/begin MEASUREMENT OUT_FMSCAN.Tx_Dig.In_Dig_22_Sts.IN_DIG_DIAG.Task4 "" UWORD COMP_DEFAULT 0 0 0 65535 ECU_ADDRESS 0x204B0C4 READ_WRITE /end MEASUREMENT
/begin MEASUREMENT OUT_FMSCAN.Tx_Dig.In_Dig_22_Sts.IN_DIG_Val.Task4 "" UBYTE IS_BOOLEAN_TRUE 0 0 0 1 ECU_ADDRESS 0x204B0C6 READ_WRITE /end MEASUREMENT
/begin MEASUREMENT OUT_FMSCAN.Tx_Dig.In_Dig_22_Sts.MessageEnable.Task4 "3.3.2.2.1 MessageEnable" UBYTE IS_BOOLEAN_TRUE 0 0 0 1 ECU_ADDRESS 0x204B0C7 READ_WRITE /end MEASUREMENT
/begin MEASUREMENT OUT_FMSCAN.Tx_Dig.In_Dig_21_Sts.IN_DIG_DIAG.Task4 "" UWORD COMP_DEFAULT 0 0 0 65535 ECU_ADDRESS 0x204B0C8 READ_WRITE /end MEASUREMENT
/begin MEASUREMENT OUT_FMSCAN.Tx_Dig.In_Dig_21_Sts.IN_DIG_Val.Task4 "" UBYTE IS_BOOLEAN_TRUE 0 0 0 1 ECU_ADDRESS 0x204B0CA READ_WRITE /end MEASUREMENT
/begin MEASUREMENT OUT_FMSCAN.Tx_Dig.In_Dig_21_Sts.MessageEnable.Task4 "3.3.2.2.1 MessageEnable" UBYTE IS_BOOLEAN_TRUE 0 0 0 1 ECU_ADDRESS 0x204B0CB READ_WRITE /end MEASUREMENT
/begin MEASUREMENT OUT_FMSCAN.Tx_Dig.In_Dig_20_Sts.IN_DIG_DIAG.Task4 "" UWORD COMP_DEFAULT 0 0 0 65535 ECU_ADDRESS 0x204B0CC READ_WRITE /end MEASUREMENT
/begin MEASUREMENT OUT_FMSCAN.Tx_Dig.In_Dig_20_Sts.IN_DIG_Val.Task4 "" UBYTE IS_BOOLEAN_TRUE 0 0 0 1 ECU_ADDRESS 0x204B0CE READ_WRITE /end MEASUREMENT
/begin MEASUREMENT OUT_FMSCAN.Tx_Dig.In_Dig_20_Sts.MessageEnable.Task4 "3.3.2.2.1 MessageEnable" UBYTE IS_BOOLEAN_TRUE 0 0 0 1 ECU_ADDRESS 0x204B0CF READ_WRITE /end MEASUREMENT
/begin MEASUREMENT OUT_FMSCAN.Tx_Dig.In_Dig_19_Sts.IN_DIG_DIAG.Task4 "" UWORD COMP_DEFAULT 0 0 0 65535 ECU_ADDRESS 0x204B0D0 READ_WRITE /end MEASUREMENT
/begin MEASUREMENT OUT_FMSCAN.Tx_Dig.In_Dig_19_Sts.IN_DIG_Val.Task4 "" UBYTE IS_BOOLEAN_TRUE 0 0 0 1 ECU_ADDRESS 0x204B0D2 READ_WRITE /end MEASUREMENT
/begin MEASUREMENT OUT_FMSCAN.Tx_Dig.In_Dig_19_Sts.MessageEnable.Task4 "3.3.2.2.1 MessageEnable" UBYTE IS_BOOLEAN_TRUE 0 0 0 1 ECU_ADDRESS 0x204B0D3 READ_WRITE /end MEASUREMENT
/begin MEASUREMENT OUT_FMSCAN.Tx_Dig.In_Dig_18_Sts.IN_DIG_DIAG.Task4 "" UWORD COMP_DEFAULT 0 0 0 65535 ECU_ADDRESS 0x204B0D4 READ_WRITE /end MEASUREMENT
/begin MEASUREMENT OUT_FMSCAN.Tx_Dig.In_Dig_18_Sts.IN_DIG_Val.Task4 "" UBYTE IS_BOOLEAN_TRUE 0 0 0 1 ECU_ADDRESS 0x204B0D6 READ_WRITE /end MEASUREMENT
/begin MEASUREMENT OUT_FMSCAN.Tx_Dig.In_Dig_18_Sts.MessageEnable.Task4 "3.3.2.2.1 MessageEnable" UBYTE IS_BOOLEAN_TRUE 0 0 0 1 ECU_ADDRESS 0x204B0D7 READ_WRITE /end MEASUREMENT
/begin MEASUREMENT OUT_FMSCAN.Tx_Dig.In_Dig_17_Sts.IN_DIG_DIAG.Task4 "" UWORD COMP_DEFAULT 0 0 0 65535 ECU_ADDRESS 0x204B0D8 READ_WRITE /end MEASUREMENT
/begin MEASUREMENT OUT_FMSCAN.Tx_Dig.In_Dig_17_Sts.IN_DIG_Val.Task4 "" UBYTE IS_BOOLEAN_TRUE 0 0 0 1 ECU_ADDRESS 0x204B0DA READ_WRITE /end MEASUREMENT
/begin MEASUREMENT OUT_FMSCAN.Tx_Dig.In_Dig_17_Sts.MessageEnable.Task4 "3.3.2.2.1 MessageEnable" UBYTE IS_BOOLEAN_TRUE 0 0 0 1 ECU_ADDRESS 0x204B0DB READ_WRITE /end MEASUREMENT
/begin MEASUREMENT OUT_FMSCAN.Tx_Dig.In_Dig_16_Sts.IN_DIG_DIAG.Task4 "" UWORD COMP_DEFAULT 0 0 0 65535 ECU_ADDRESS 0x204B0DC READ_WRITE /end MEASUREMENT
/begin MEASUREMENT OUT_FMSCAN.Tx_Dig.In_Dig_16_Sts.IN_DIG_Val.Task4 "" UBYTE IS_BOOLEAN_TRUE 0 0 0 1 ECU_ADDRESS 0x204B0DE READ_WRITE /end MEASUREMENT
/begin MEASUREMENT OUT_FMSCAN.Tx_Dig.In_Dig_16_Sts.MessageEnable.Task4 "3.3.2.2.1 MessageEnable" UBYTE IS_BOOLEAN_TRUE 0 0 0 1 ECU_ADDRESS 0x204B0DF READ_WRITE /end MEASUREMENT
/begin MEASUREMENT OUT_FMSCAN.Tx_Dig.In_Dig_15_Sts.IN_DIG_DIAG.Task4 "" UWORD COMP_DEFAULT 0 0 0 65535 ECU_ADDRESS 0x204B0E0 READ_WRITE /end MEASUREMENT
/begin MEASUREMENT OUT_FMSCAN.Tx_Dig.In_Dig_15_Sts.IN_DIG_Val.Task4 "" UBYTE IS_BOOLEAN_TRUE 0 0 0 1 ECU_ADDRESS 0x204B0E2 READ_WRITE /end MEASUREMENT
/begin MEASUREMENT OUT_FMSCAN.Tx_Dig.In_Dig_15_Sts.MessageEnable.Task4 "3.3.2.2.1 MessageEnable" UBYTE IS_BOOLEAN_TRUE 0 0 0 1 ECU_ADDRESS 0x204B0E3 READ_WRITE /end MEASUREMENT
/begin MEASUREMENT OUT_FMSCAN.Tx_Dig.In_Dig_14_Sts.IN_DIG_DIAG.Task4 "" UWORD COMP_DEFAULT 0 0 0 65535 ECU_ADDRESS 0x204B0E4 READ_WRITE /end MEASUREMENT
/begin MEASUREMENT OUT_FMSCAN.Tx_Dig.In_Dig_14_Sts.IN_DIG_Val.Task4 "" UBYTE IS_BOOLEAN_TRUE 0 0 0 1 ECU_ADDRESS 0x204B0E6 READ_WRITE /end MEASUREMENT
/begin MEASUREMENT OUT_FMSCAN.Tx_Dig.In_Dig_14_Sts.MessageEnable.Task4 "3.3.2.2.1 MessageEnable" UBYTE IS_BOOLEAN_TRUE 0 0 0 1 ECU_ADDRESS 0x204B0E7 READ_WRITE /end MEASUREMENT
/begin MEASUREMENT OUT_FMSCAN.Tx_Dig.In_Dig_13_Sts.IN_DIG_DIAG.Task4 "" UWORD COMP_DEFAULT 0 0 0 65535 ECU_ADDRESS 0x204B0E8 READ_WRITE /end MEASUREMENT
/begin MEASUREMENT OUT_FMSCAN.Tx_Dig.In_Dig_13_Sts.IN_DIG_Val.Task4 "" UBYTE IS_BOOLEAN_TRUE 0 0 0 1 ECU_ADDRESS 0x204B0EA READ_WRITE /end MEASUREMENT
/begin MEASUREMENT OUT_FMSCAN.Tx_Dig.In_Dig_13_Sts.MessageEnable.Task4 "3.3.2.2.1 MessageEnable" UBYTE IS_BOOLEAN_TRUE 0 0 0 1 ECU_ADDRESS 0x204B0EB READ_WRITE /end MEASUREMENT
/begin MEASUREMENT OUT_FMSCAN.Tx_Dig.In_Dig_12_Sts.IN_DIG_DIAG.Task4 "" UWORD COMP_DEFAULT 0 0 0 65535 ECU_ADDRESS 0x204B0EC READ_WRITE /end MEASUREMENT
/begin MEASUREMENT OUT_FMSCAN.Tx_Dig.In_Dig_12_Sts.IN_DIG_Val.Task4 "" UBYTE IS_BOOLEAN_TRUE 0 0 0 1 ECU_ADDRESS 0x204B0EE READ_WRITE /end MEASUREMENT
/begin MEASUREMENT OUT_FMSCAN.Tx_Dig.In_Dig_12_Sts.MessageEnable.Task4 "3.3.2.2.1 MessageEnable" UBYTE IS_BOOLEAN_TRUE 0 0 0 1 ECU_ADDRESS 0x204B0EF READ_WRITE /end MEASUREMENT
/begin MEASUREMENT OUT_FMSCAN.Tx_Dig.In_Dig_11_Sts.IN_DIG_DIAG.Task4 "" UWORD COMP_DEFAULT 0 0 0 65535 ECU_ADDRESS 0x204B0F0 READ_WRITE /end MEASUREMENT
/begin MEASUREMENT OUT_FMSCAN.Tx_Dig.In_Dig_11_Sts.IN_DIG_Val.Task4 "" UBYTE IS_BOOLEAN_TRUE 0 0 0 1 ECU_ADDRESS 0x204B0F2 READ_WRITE /end MEASUREMENT
/begin MEASUREMENT OUT_FMSCAN.Tx_Dig.In_Dig_11_Sts.MessageEnable.Task4 "3.3.2.2.1 MessageEnable" UBYTE IS_BOOLEAN_TRUE 0 0 0 1 ECU_ADDRESS 0x204B0F3 READ_WRITE /end MEASUREMENT
/begin MEASUREMENT OUT_FMSCAN.Tx_Dig.In_Dig_10_Sts.IN_DIG_DIAG.Task4 "" UWORD COMP_DEFAULT 0 0 0 65535 ECU_ADDRESS 0x204B0F4 READ_WRITE /end MEASUREMENT
/begin MEASUREMENT OUT_FMSCAN.Tx_Dig.In_Dig_10_Sts.IN_DIG_Val.Task4 "" UBYTE IS_BOOLEAN_TRUE 0 0 0 1 ECU_ADDRESS 0x204B0F6 READ_WRITE /end MEASUREMENT
/begin MEASUREMENT OUT_FMSCAN.Tx_Dig.In_Dig_10_Sts.MessageEnable.Task4 "3.3.2.2.1 MessageEnable" UBYTE IS_BOOLEAN_TRUE 0 0 0 1 ECU_ADDRESS 0x204B0F7 READ_WRITE /end MEASUREMENT
/begin MEASUREMENT OUT_FMSCAN.Tx_Dig.In_Dig_09_Sts.IN_DIG_DIAG.Task4 "" UWORD COMP_DEFAULT 0 0 0 65535 ECU_ADDRESS 0x204B0F8 READ_WRITE /end MEASUREMENT
/begin MEASUREMENT OUT_FMSCAN.Tx_Dig.In_Dig_09_Sts.IN_DIG_Val.Task4 "" UBYTE IS_BOOLEAN_TRUE 0 0 0 1 ECU_ADDRESS 0x204B0FA READ_WRITE /end MEASUREMENT
/begin MEASUREMENT OUT_FMSCAN.Tx_Dig.In_Dig_09_Sts.MessageEnable.Task4 "3.3.2.2.1 MessageEnable" UBYTE IS_BOOLEAN_TRUE 0 0 0 1 ECU_ADDRESS 0x204B0FB READ_WRITE /end MEASUREMENT
/begin MEASUREMENT OUT_FMSCAN.Tx_Dig.In_Dig_08_Sts.IN_DIG_DIAG.Task4 "" UWORD COMP_DEFAULT 0 0 0 65535 ECU_ADDRESS 0x204B0FC READ_WRITE /end MEASUREMENT
/begin MEASUREMENT OUT_FMSCAN.Tx_Dig.In_Dig_08_Sts.IN_DIG_Val.Task4 "" UBYTE IS_BOOLEAN_TRUE 0 0 0 1 ECU_ADDRESS 0x204B0FE READ_WRITE /end MEASUREMENT
/begin MEASUREMENT OUT_FMSCAN.Tx_Dig.In_Dig_08_Sts.MessageEnable.Task4 "3.3.2.2.1 MessageEnable" UBYTE IS_BOOLEAN_TRUE 0 0 0 1 ECU_ADDRESS 0x204B0FF READ_WRITE /end MEASUREMENT
/begin MEASUREMENT OUT_FMSCAN.Tx_Dig.In_Dig_07_Sts.IN_DIG_DIAG.Task4 "" UWORD COMP_DEFAULT 0 0 0 65535 ECU_ADDRESS 0x204B100 READ_WRITE /end MEASUREMENT
/begin MEASUREMENT OUT_FMSCAN.Tx_Dig.In_Dig_07_Sts.IN_DIG_Val.Task4 "" UBYTE IS_BOOLEAN_TRUE 0 0 0 1 ECU_ADDRESS 0x204B102 READ_WRITE /end MEASUREMENT
/begin MEASUREMENT OUT_FMSCAN.Tx_Dig.In_Dig_07_Sts.MessageEnable.Task4 "3.3.2.2.1 MessageEnable" UBYTE IS_BOOLEAN_TRUE 0 0 0 1 ECU_ADDRESS 0x204B103 READ_WRITE /end MEASUREMENT
/begin MEASUREMENT OUT_FMSCAN.Tx_Dig.In_Dig_06_Sts.IN_DIG_DIAG.Task4 "" UWORD COMP_DEFAULT 0 0 0 65535 ECU_ADDRESS 0x204B104 READ_WRITE /end MEASUREMENT
/begin MEASUREMENT OUT_FMSCAN.Tx_Dig.In_Dig_06_Sts.IN_DIG_Val.Task4 "" UBYTE IS_BOOLEAN_TRUE 0 0 0 1 ECU_ADDRESS 0x204B106 READ_WRITE /end MEASUREMENT
/begin MEASUREMENT OUT_FMSCAN.Tx_Dig.In_Dig_06_Sts.MessageEnable.Task4 "3.3.2.2.1 MessageEnable" UBYTE IS_BOOLEAN_TRUE 0 0 0 1 ECU_ADDRESS 0x204B107 READ_WRITE /end MEASUREMENT
/begin MEASUREMENT OUT_FMSCAN.Tx_Dig.In_Dig_05_Sts.IN_DIG_DIAG.Task4 "" UWORD COMP_DEFAULT 0 0 0 65535 ECU_ADDRESS 0x204B108 READ_WRITE /end MEASUREMENT
/begin MEASUREMENT OUT_FMSCAN.Tx_Dig.In_Dig_05_Sts.IN_DIG_Val.Task4 "" UBYTE IS_BOOLEAN_TRUE 0 0 0 1 ECU_ADDRESS 0x204B10A READ_WRITE /end MEASUREMENT
/begin MEASUREMENT OUT_FMSCAN.Tx_Dig.In_Dig_05_Sts.MessageEnable.Task4 "3.3.2.2.1 MessageEnable" UBYTE IS_BOOLEAN_TRUE 0 0 0 1 ECU_ADDRESS 0x204B10B READ_WRITE /end MEASUREMENT
/begin MEASUREMENT OUT_FMSCAN.Tx_Dig.In_Dig_04_Sts.IN_DIG_DIAG.Task4 "" UWORD COMP_DEFAULT 0 0 0 65535 ECU_ADDRESS 0x204B10C READ_WRITE /end MEASUREMENT
/begin MEASUREMENT OUT_FMSCAN.Tx_Dig.In_Dig_04_Sts.IN_DIG_Val.Task4 "" UBYTE IS_BOOLEAN_TRUE 0 0 0 1 ECU_ADDRESS 0x204B10E READ_WRITE /end MEASUREMENT
/begin MEASUREMENT OUT_FMSCAN.Tx_Dig.In_Dig_04_Sts.MessageEnable.Task4 "3.3.2.2.1 MessageEnable" UBYTE IS_BOOLEAN_TRUE 0 0 0 1 ECU_ADDRESS 0x204B10F READ_WRITE /end MEASUREMENT
/begin MEASUREMENT OUT_FMSCAN.Tx_Dig.In_Dig_03_Sts.IN_DIG_DIAG.Task4 "" UWORD COMP_DEFAULT 0 0 0 65535 ECU_ADDRESS 0x204B110 READ_WRITE /end MEASUREMENT
/begin MEASUREMENT OUT_FMSCAN.Tx_Dig.In_Dig_03_Sts.IN_DIG_Val.Task4 "" UBYTE IS_BOOLEAN_TRUE 0 0 0 1 ECU_ADDRESS 0x204B112 READ_WRITE /end MEASUREMENT
/begin MEASUREMENT OUT_FMSCAN.Tx_Dig.In_Dig_03_Sts.MessageEnable.Task4 "3.3.2.2.1 MessageEnable" UBYTE IS_BOOLEAN_TRUE 0 0 0 1 ECU_ADDRESS 0x204B113 READ_WRITE /end MEASUREMENT
/begin MEASUREMENT OUT_FMSCAN.Tx_Dig.In_Dig_02_Sts.IN_DIG_DIAG.Task4 "" UWORD COMP_DEFAULT 0 0 0 65535 ECU_ADDRESS 0x204B114 READ_WRITE /end MEASUREMENT
/begin MEASUREMENT OUT_FMSCAN.Tx_Dig.In_Dig_02_Sts.IN_DIG_Val.Task4 "" UBYTE IS_BOOLEAN_TRUE 0 0 0 1 ECU_ADDRESS 0x204B116 READ_WRITE /end MEASUREMENT
/begin MEASUREMENT OUT_FMSCAN.Tx_Dig.In_Dig_02_Sts.MessageEnable.Task4 "3.3.2.2.1 MessageEnable" UBYTE IS_BOOLEAN_TRUE 0 0 0 1 ECU_ADDRESS 0x204B117 READ_WRITE /end MEASUREMENT
/begin MEASUREMENT OUT_FMSCAN.Tx_Dig.In_Dig_01_Sts.IN_DIG_DIAG.Task4 "" UWORD COMP_DEFAULT 0 0 0 65535 ECU_ADDRESS 0x204B118 READ_WRITE /end MEASUREMENT
/begin MEASUREMENT OUT_FMSCAN.Tx_Dig.In_Dig_01_Sts.IN_DIG_Val.Task4 "" UBYTE IS_BOOLEAN_TRUE 0 0 0 1 ECU_ADDRESS 0x204B11A READ_WRITE /end MEASUREMENT
/begin MEASUREMENT OUT_FMSCAN.Tx_Dig.In_Dig_01_Sts.MessageEnable.Task4 "3.3.2.2.1 MessageEnable" UBYTE IS_BOOLEAN_TRUE 0 0 0 1 ECU_ADDRESS 0x204B11B READ_WRITE /end MEASUREMENT
/begin MEASUREMENT OUT_FMSCAN.Tx_Pwr.Out_Supply_ANA_01_Sts.Supply_ANA_DIAG.Task4 "" UWORD COMP_DEFAULT 0 0 0 65535 ECU_ADDRESS 0x204B11C READ_WRITE /end MEASUREMENT
/begin MEASUREMENT OUT_FMSCAN.Tx_Pwr.Out_Supply_ANA_01_Sts.Supply_ANA_Val.Task4 "" UWORD COMP_DEFAULT 0 0 0 65535 ECU_ADDRESS 0x204B11E READ_WRITE /end MEASUREMENT
/begin MEASUREMENT OUT_FMSCAN.Tx_Pwr.Out_Supply_ANA_01_Sts.MessageEnable.Task4 "3.3.2.2.1 MessageEnable" UBYTE IS_BOOLEAN_TRUE 0 0 0 1 ECU_ADDRESS 0x204B120 READ_WRITE /end MEASUREMENT
/begin MEASUREMENT OUT_FMSCAN.Tx_Out.Out_34_Sts.Out_DIAG.Task4 "" UWORD COMP_DEFAULT 0 0 0 65535 ECU_ADDRESS 0x204B122 READ_WRITE /end MEASUREMENT
/begin MEASUREMENT OUT_FMSCAN.Tx_Out.Out_34_Sts.MessageEnable.Task4 "3.3.2.2.1 MessageEnable" UBYTE IS_BOOLEAN_TRUE 0 0 0 1 ECU_ADDRESS 0x204B124 READ_WRITE /end MEASUREMENT
/begin MEASUREMENT OUT_FMSCAN.Tx_Out.Out_34_Sts.Out_STATUS.Task4 "" UBYTE COMP_DEFAULT 0 0 0 255 ECU_ADDRESS 0x204B125 READ_WRITE /end MEASUREMENT
/begin MEASUREMENT OUT_FMSCAN.Tx_Out.Out_33_Sts.Out_DIAG.Task4 "" UWORD COMP_DEFAULT 0 0 0 65535 ECU_ADDRESS 0x204B126 READ_WRITE /end MEASUREMENT
/begin MEASUREMENT OUT_FMSCAN.Tx_Out.Out_33_Sts.MessageEnable.Task4 "3.3.2.2.1 MessageEnable" UBYTE IS_BOOLEAN_TRUE 0 0 0 1 ECU_ADDRESS 0x204B128 READ_WRITE /end MEASUREMENT
/begin MEASUREMENT OUT_FMSCAN.Tx_Out.Out_33_Sts.Out_STATUS.Task4 "" UBYTE COMP_DEFAULT 0 0 0 255 ECU_ADDRESS 0x204B129 READ_WRITE /end MEASUREMENT
/begin MEASUREMENT OUT_FMSCAN.Tx_Out.Out_32_Sts.Out_DIAG.Task4 "" UWORD COMP_DEFAULT 0 0 0 65535 ECU_ADDRESS 0x204B12A READ_WRITE /end MEASUREMENT
/begin MEASUREMENT OUT_FMSCAN.Tx_Out.Out_32_Sts.MessageEnable.Task4 "3.3.2.2.1 MessageEnable" UBYTE IS_BOOLEAN_TRUE 0 0 0 1 ECU_ADDRESS 0x204B12C READ_WRITE /end MEASUREMENT
/begin MEASUREMENT OUT_FMSCAN.Tx_Out.Out_32_Sts.Out_STATUS.Task4 "" UBYTE COMP_DEFAULT 0 0 0 255 ECU_ADDRESS 0x204B12D READ_WRITE /end MEASUREMENT
/begin MEASUREMENT OUT_FMSCAN.Tx_Out.Out_31_Sts.Out_DIAG.Task4 "" UWORD COMP_DEFAULT 0 0 0 65535 ECU_ADDRESS 0x204B12E READ_WRITE /end MEASUREMENT
/begin MEASUREMENT OUT_FMSCAN.Tx_Out.Out_31_Sts.MessageEnable.Task4 "3.3.2.2.1 MessageEnable" UBYTE IS_BOOLEAN_TRUE 0 0 0 1 ECU_ADDRESS 0x204B130 READ_WRITE /end MEASUREMENT
/begin MEASUREMENT OUT_FMSCAN.Tx_Out.Out_31_Sts.Out_STATUS.Task4 "" UBYTE COMP_DEFAULT 0 0 0 255 ECU_ADDRESS 0x204B131 READ_WRITE /end MEASUREMENT
/begin MEASUREMENT OUT_FMSCAN.Tx_Out.Out_30_Sts.Out_DIAG.Task4 "" UWORD COMP_DEFAULT 0 0 0 65535 ECU_ADDRESS 0x204B132 READ_WRITE /end MEASUREMENT
/begin MEASUREMENT OUT_FMSCAN.Tx_Out.Out_30_Sts.MessageEnable.Task4 "3.3.2.2.1 MessageEnable" UBYTE IS_BOOLEAN_TRUE 0 0 0 1 ECU_ADDRESS 0x204B134 READ_WRITE /end MEASUREMENT
/begin MEASUREMENT OUT_FMSCAN.Tx_Out.Out_30_Sts.Out_STATUS.Task4 "" UBYTE COMP_DEFAULT 0 0 0 255 ECU_ADDRESS 0x204B135 READ_WRITE /end MEASUREMENT
/begin MEASUREMENT OUT_FMSCAN.Tx_Out.Out_29_Sts.Out_DIAG.Task4 "" UWORD COMP_DEFAULT 0 0 0 65535 ECU_ADDRESS 0x204B136 READ_WRITE /end MEASUREMENT
/begin MEASUREMENT OUT_FMSCAN.Tx_Out.Out_29_Sts.MessageEnable.Task4 "3.3.2.2.1 MessageEnable" UBYTE IS_BOOLEAN_TRUE 0 0 0 1 ECU_ADDRESS 0x204B138 READ_WRITE /end MEASUREMENT
/begin MEASUREMENT OUT_FMSCAN.Tx_Out.Out_29_Sts.Out_STATUS.Task4 "" UBYTE COMP_DEFAULT 0 0 0 255 ECU_ADDRESS 0x204B139 READ_WRITE /end MEASUREMENT
/begin MEASUREMENT OUT_FMSCAN.Tx_Out.Out_28_Sts.Out_DIAG.Task4 "" UWORD COMP_DEFAULT 0 0 0 65535 ECU_ADDRESS 0x204B13A READ_WRITE /end MEASUREMENT
/begin MEASUREMENT OUT_FMSCAN.Tx_Out.Out_28_Sts.Out_SENSE.Task4 "" UWORD COMP_DEFAULT 0 0 0 65535 ECU_ADDRESS 0x204B13C READ_WRITE /end MEASUREMENT
/begin MEASUREMENT OUT_FMSCAN.Tx_Out.Out_28_Sts.MessageEnable.Task4 "3.3.2.2.1 MessageEnable" UBYTE IS_BOOLEAN_TRUE 0 0 0 1 ECU_ADDRESS 0x204B13E READ_WRITE /end MEASUREMENT
/begin MEASUREMENT OUT_FMSCAN.Tx_Out.Out_28_Sts.Out_STATUS.Task4 "" UBYTE COMP_DEFAULT 0 0 0 255 ECU_ADDRESS 0x204B13F READ_WRITE /end MEASUREMENT
/begin MEASUREMENT OUT_FMSCAN.Tx_Out.Out_27_Sts.Out_DIAG.Task4 "" UWORD COMP_DEFAULT 0 0 0 65535 ECU_ADDRESS 0x204B140 READ_WRITE /end MEASUREMENT
/begin MEASUREMENT OUT_FMSCAN.Tx_Out.Out_27_Sts.Out_SENSE.Task4 "" UWORD COMP_DEFAULT 0 0 0 65535 ECU_ADDRESS 0x204B142 READ_WRITE /end MEASUREMENT
/begin MEASUREMENT OUT_FMSCAN.Tx_Out.Out_27_Sts.MessageEnable.Task4 "3.3.2.2.1 MessageEnable" UBYTE IS_BOOLEAN_TRUE 0 0 0 1 ECU_ADDRESS 0x204B144 READ_WRITE /end MEASUREMENT
/begin MEASUREMENT OUT_FMSCAN.Tx_Out.Out_27_Sts.Out_STATUS.Task4 "" UBYTE COMP_DEFAULT 0 0 0 255 ECU_ADDRESS 0x204B145 READ_WRITE /end MEASUREMENT
/begin MEASUREMENT OUT_FMSCAN.Tx_Out.Out_26_Sts.Out_DIAG.Task4 "" UWORD COMP_DEFAULT 0 0 0 65535 ECU_ADDRESS 0x204B146 READ_WRITE /end MEASUREMENT
/begin MEASUREMENT OUT_FMSCAN.Tx_Out.Out_26_Sts.Out_SENSE.Task4 "" UWORD COMP_DEFAULT 0 0 0 65535 ECU_ADDRESS 0x204B148 READ_WRITE /end MEASUREMENT
/begin MEASUREMENT OUT_FMSCAN.Tx_Out.Out_26_Sts.MessageEnable.Task4 "3.3.2.2.1 MessageEnable" UBYTE IS_BOOLEAN_TRUE 0 0 0 1 ECU_ADDRESS 0x204B14A READ_WRITE /end MEASUREMENT
/begin MEASUREMENT OUT_FMSCAN.Tx_Out.Out_26_Sts.Out_STATUS.Task4 "" UBYTE COMP_DEFAULT 0 0 0 255 ECU_ADDRESS 0x204B14B READ_WRITE /end MEASUREMENT
/begin MEASUREMENT OUT_FMSCAN.Tx_Out.Out_25_Sts.Out_DIAG.Task4 "" UWORD COMP_DEFAULT 0 0 0 65535 ECU_ADDRESS 0x204B14C READ_WRITE /end MEASUREMENT
/begin MEASUREMENT OUT_FMSCAN.Tx_Out.Out_25_Sts.Out_SENSE.Task4 "" UWORD COMP_DEFAULT 0 0 0 65535 ECU_ADDRESS 0x204B14E READ_WRITE /end MEASUREMENT
/begin MEASUREMENT OUT_FMSCAN.Tx_Out.Out_25_Sts.MessageEnable.Task4 "3.3.2.2.1 MessageEnable" UBYTE IS_BOOLEAN_TRUE 0 0 0 1 ECU_ADDRESS 0x204B150 READ_WRITE /end MEASUREMENT
/begin MEASUREMENT OUT_FMSCAN.Tx_Out.Out_25_Sts.Out_STATUS.Task4 "" UBYTE COMP_DEFAULT 0 0 0 255 ECU_ADDRESS 0x204B151 READ_WRITE /end MEASUREMENT
/begin MEASUREMENT OUT_FMSCAN.Tx_Out.Out_24_Sts.Out_DIAG.Task4 "" UWORD COMP_DEFAULT 0 0 0 65535 ECU_ADDRESS 0x204B152 READ_WRITE /end MEASUREMENT
/begin MEASUREMENT OUT_FMSCAN.Tx_Out.Out_24_Sts.Out_SENSE.Task4 "" UWORD COMP_DEFAULT 0 0 0 65535 ECU_ADDRESS 0x204B154 READ_WRITE /end MEASUREMENT
/begin MEASUREMENT OUT_FMSCAN.Tx_Out.Out_24_Sts.MessageEnable.Task4 "3.3.2.2.1 MessageEnable" UBYTE IS_BOOLEAN_TRUE 0 0 0 1 ECU_ADDRESS 0x204B156 READ_WRITE /end MEASUREMENT
/begin MEASUREMENT OUT_FMSCAN.Tx_Out.Out_24_Sts.Out_STATUS.Task4 "" UBYTE COMP_DEFAULT 0 0 0 255 ECU_ADDRESS 0x204B157 READ_WRITE /end MEASUREMENT
/begin MEASUREMENT OUT_FMSCAN.Tx_Out.Out_23_Sts.Out_DIAG.Task4 "" UWORD COMP_DEFAULT 0 0 0 65535 ECU_ADDRESS 0x204B158 READ_WRITE /end MEASUREMENT
/begin MEASUREMENT OUT_FMSCAN.Tx_Out.Out_23_Sts.Out_SENSE.Task4 "" UWORD COMP_DEFAULT 0 0 0 65535 ECU_ADDRESS 0x204B15A READ_WRITE /end MEASUREMENT
/begin MEASUREMENT OUT_FMSCAN.Tx_Out.Out_23_Sts.MessageEnable.Task4 "3.3.2.2.1 MessageEnable" UBYTE IS_BOOLEAN_TRUE 0 0 0 1 ECU_ADDRESS 0x204B15C READ_WRITE /end MEASUREMENT
/begin MEASUREMENT OUT_FMSCAN.Tx_Out.Out_23_Sts.Out_STATUS.Task4 "" UBYTE COMP_DEFAULT 0 0 0 255 ECU_ADDRESS 0x204B15D READ_WRITE /end MEASUREMENT
/begin MEASUREMENT OUT_FMSCAN.Tx_Out.Out_22_Sts.Out_DIAG.Task4 "" UWORD COMP_DEFAULT 0 0 0 65535 ECU_ADDRESS 0x204B15E READ_WRITE /end MEASUREMENT
/begin MEASUREMENT OUT_FMSCAN.Tx_Out.Out_22_Sts.Out_SENSE.Task4 "" UWORD COMP_DEFAULT 0 0 0 65535 ECU_ADDRESS 0x204B160 READ_WRITE /end MEASUREMENT
/begin MEASUREMENT OUT_FMSCAN.Tx_Out.Out_22_Sts.MessageEnable.Task4 "3.3.2.2.1 MessageEnable" UBYTE IS_BOOLEAN_TRUE 0 0 0 1 ECU_ADDRESS 0x204B162 READ_WRITE /end MEASUREMENT
/begin MEASUREMENT OUT_FMSCAN.Tx_Out.Out_22_Sts.Out_STATUS.Task4 "" UBYTE COMP_DEFAULT 0 0 0 255 ECU_ADDRESS 0x204B163 READ_WRITE /end MEASUREMENT
/begin MEASUREMENT OUT_FMSCAN.Tx_Out.Out_21_Sts.Out_DIAG.Task4 "" UWORD COMP_DEFAULT 0 0 0 65535 ECU_ADDRESS 0x204B164 READ_WRITE /end MEASUREMENT
/begin MEASUREMENT OUT_FMSCAN.Tx_Out.Out_21_Sts.Out_SENSE.Task4 "" UWORD COMP_DEFAULT 0 0 0 65535 ECU_ADDRESS 0x204B166 READ_WRITE /end MEASUREMENT
/begin MEASUREMENT OUT_FMSCAN.Tx_Out.Out_21_Sts.Out_TD_DIAG.Task4 "" UWORD COMP_DEFAULT 0 0 0 0 ECU_ADDRESS 0x204B168 READ_WRITE /end MEASUREMENT
/begin MEASUREMENT OUT_FMSCAN.Tx_Out.Out_21_Sts.MessageEnable.Task4 "3.3.2.2.1 MessageEnable" UBYTE IS_BOOLEAN_TRUE 0 0 0 1 ECU_ADDRESS 0x204B16A READ_WRITE /end MEASUREMENT
/begin MEASUREMENT OUT_FMSCAN.Tx_Out.Out_21_Sts.Out_STATUS.Task4 "" UBYTE COMP_DEFAULT 0 0 0 255 ECU_ADDRESS 0x204B16B READ_WRITE /end MEASUREMENT
/begin MEASUREMENT OUT_FMSCAN.Tx_Out.Out_21_Sts.Out_TD.Task4 "" UBYTE IS_BOOLEAN_TRUE 0 0 0 0 ECU_ADDRESS 0x204B16C READ_WRITE /end MEASUREMENT
/begin MEASUREMENT OUT_FMSCAN.Tx_Out.Out_20_Sts.Out_DIAG.Task4 "" UWORD COMP_DEFAULT 0 0 0 65535 ECU_ADDRESS 0x204B16E READ_WRITE /end MEASUREMENT
/begin MEASUREMENT OUT_FMSCAN.Tx_Out.Out_20_Sts.Out_SENSE.Task4 "" UWORD COMP_DEFAULT 0 0 0 65535 ECU_ADDRESS 0x204B170 READ_WRITE /end MEASUREMENT
/begin MEASUREMENT OUT_FMSCAN.Tx_Out.Out_20_Sts.MessageEnable.Task4 "3.3.2.2.1 MessageEnable" UBYTE IS_BOOLEAN_TRUE 0 0 0 1 ECU_ADDRESS 0x204B172 READ_WRITE /end MEASUREMENT
/begin MEASUREMENT OUT_FMSCAN.Tx_Out.Out_20_Sts.Out_STATUS.Task4 "" UBYTE COMP_DEFAULT 0 0 0 255 ECU_ADDRESS 0x204B173 READ_WRITE /end MEASUREMENT
/begin MEASUREMENT OUT_FMSCAN.Tx_Out.Out_19_Sts.Out_DIAG.Task4 "" UWORD COMP_DEFAULT 0 0 0 65535 ECU_ADDRESS 0x204B174 READ_WRITE /end MEASUREMENT
/begin MEASUREMENT OUT_FMSCAN.Tx_Out.Out_19_Sts.Out_SENSE.Task4 "" UWORD COMP_DEFAULT 0 0 0 65535 ECU_ADDRESS 0x204B176 READ_WRITE /end MEASUREMENT
/begin MEASUREMENT OUT_FMSCAN.Tx_Out.Out_19_Sts.MessageEnable.Task4 "3.3.2.2.1 MessageEnable" UBYTE IS_BOOLEAN_TRUE 0 0 0 1 ECU_ADDRESS 0x204B178 READ_WRITE /end MEASUREMENT
/begin MEASUREMENT OUT_FMSCAN.Tx_Out.Out_19_Sts.Out_STATUS.Task4 "" UBYTE COMP_DEFAULT 0 0 0 255 ECU_ADDRESS 0x204B179 READ_WRITE /end MEASUREMENT
/begin MEASUREMENT OUT_FMSCAN.Tx_Out.Out_18_Sts.Out_DIAG.Task4 "" UWORD COMP_DEFAULT 0 0 0 65535 ECU_ADDRESS 0x204B17A READ_WRITE /end MEASUREMENT
/begin MEASUREMENT OUT_FMSCAN.Tx_Out.Out_18_Sts.Out_SENSE.Task4 "" UWORD COMP_DEFAULT 0 0 0 65535 ECU_ADDRESS 0x204B17C READ_WRITE /end MEASUREMENT
/begin MEASUREMENT OUT_FMSCAN.Tx_Out.Out_18_Sts.MessageEnable.Task4 "3.3.2.2.1 MessageEnable" UBYTE IS_BOOLEAN_TRUE 0 0 0 1 ECU_ADDRESS 0x204B17E READ_WRITE /end MEASUREMENT
/begin MEASUREMENT OUT_FMSCAN.Tx_Out.Out_18_Sts.Out_STATUS.Task4 "" UBYTE COMP_DEFAULT 0 0 0 255 ECU_ADDRESS 0x204B17F READ_WRITE /end MEASUREMENT
/begin MEASUREMENT OUT_FMSCAN.Tx_Out.Out_17_Sts.Out_DIAG.Task4 "" UWORD COMP_DEFAULT 0 0 0 65535 ECU_ADDRESS 0x204B180 READ_WRITE /end MEASUREMENT
/begin MEASUREMENT OUT_FMSCAN.Tx_Out.Out_17_Sts.Out_SENSE.Task4 "" UWORD COMP_DEFAULT 0 0 0 65535 ECU_ADDRESS 0x204B182 READ_WRITE /end MEASUREMENT
/begin MEASUREMENT OUT_FMSCAN.Tx_Out.Out_17_Sts.MessageEnable.Task4 "3.3.2.2.1 MessageEnable" UBYTE IS_BOOLEAN_TRUE 0 0 0 1 ECU_ADDRESS 0x204B184 READ_WRITE /end MEASUREMENT
/begin MEASUREMENT OUT_FMSCAN.Tx_Out.Out_17_Sts.Out_STATUS.Task4 "" UBYTE COMP_DEFAULT 0 0 0 255 ECU_ADDRESS 0x204B185 READ_WRITE /end MEASUREMENT
/begin MEASUREMENT OUT_FMSCAN.Tx_Out.Out_16_Sts.Out_DIAG.Task4 "" UWORD COMP_DEFAULT 0 0 0 65535 ECU_ADDRESS 0x204B186 READ_WRITE /end MEASUREMENT
/begin MEASUREMENT OUT_FMSCAN.Tx_Out.Out_16_Sts.Out_SENSE.Task4 "" UWORD COMP_DEFAULT 0 0 0 65535 ECU_ADDRESS 0x204B188 READ_WRITE /end MEASUREMENT
/begin MEASUREMENT OUT_FMSCAN.Tx_Out.Out_16_Sts.MessageEnable.Task4 "3.3.2.2.1 MessageEnable" UBYTE IS_BOOLEAN_TRUE 0 0 0 1 ECU_ADDRESS 0x204B18A READ_WRITE /end MEASUREMENT
/begin MEASUREMENT OUT_FMSCAN.Tx_Out.Out_16_Sts.Out_STATUS.Task4 "" UBYTE COMP_DEFAULT 0 0 0 255 ECU_ADDRESS 0x204B18B READ_WRITE /end MEASUREMENT
/begin MEASUREMENT OUT_FMSCAN.Tx_Out.Out_15_Sts.Out_DIAG.Task4 "" UWORD COMP_DEFAULT 0 0 0 65535 ECU_ADDRESS 0x204B18C READ_WRITE /end MEASUREMENT
/begin MEASUREMENT OUT_FMSCAN.Tx_Out.Out_15_Sts.Out_SENSE.Task4 "" UWORD COMP_DEFAULT 0 0 0 65535 ECU_ADDRESS 0x204B18E READ_WRITE /end MEASUREMENT
/begin MEASUREMENT OUT_FMSCAN.Tx_Out.Out_15_Sts.MessageEnable.Task4 "3.3.2.2.1 MessageEnable" UBYTE IS_BOOLEAN_TRUE 0 0 0 1 ECU_ADDRESS 0x204B190 READ_WRITE /end MEASUREMENT
/begin MEASUREMENT OUT_FMSCAN.Tx_Out.Out_15_Sts.Out_STATUS.Task4 "" UBYTE COMP_DEFAULT 0 0 0 255 ECU_ADDRESS 0x204B191 READ_WRITE /end MEASUREMENT
/begin MEASUREMENT OUT_FMSCAN.Tx_Out.Out_14_Sts.Out_DIAG.Task4 "" UWORD COMP_DEFAULT 0 0 0 65535 ECU_ADDRESS 0x204B192 READ_WRITE /end MEASUREMENT
/begin MEASUREMENT OUT_FMSCAN.Tx_Out.Out_14_Sts.Out_SENSE.Task4 "" UWORD COMP_DEFAULT 0 0 0 65535 ECU_ADDRESS 0x204B194 READ_WRITE /end MEASUREMENT
/begin MEASUREMENT OUT_FMSCAN.Tx_Out.Out_14_Sts.MessageEnable.Task4 "3.3.2.2.1 MessageEnable" UBYTE IS_BOOLEAN_TRUE 0 0 0 1 ECU_ADDRESS 0x204B196 READ_WRITE /end MEASUREMENT
/begin MEASUREMENT OUT_FMSCAN.Tx_Out.Out_14_Sts.Out_STATUS.Task4 "" UBYTE COMP_DEFAULT 0 0 0 255 ECU_ADDRESS 0x204B197 READ_WRITE /end MEASUREMENT
/begin MEASUREMENT OUT_FMSCAN.Tx_Out.Out_13_Sts.Out_DIAG.Task4 "" UWORD COMP_DEFAULT 0 0 0 65535 ECU_ADDRESS 0x204B198 READ_WRITE /end MEASUREMENT
/begin MEASUREMENT OUT_FMSCAN.Tx_Out.Out_13_Sts.Out_SENSE.Task4 "" UWORD COMP_DEFAULT 0 0 0 65535 ECU_ADDRESS 0x204B19A READ_WRITE /end MEASUREMENT
/begin MEASUREMENT OUT_FMSCAN.Tx_Out.Out_13_Sts.MessageEnable.Task4 "3.3.2.2.1 MessageEnable" UBYTE IS_BOOLEAN_TRUE 0 0 0 1 ECU_ADDRESS 0x204B19C READ_WRITE /end MEASUREMENT
/begin MEASUREMENT OUT_FMSCAN.Tx_Out.Out_13_Sts.Out_STATUS.Task4 "" UBYTE COMP_DEFAULT 0 0 0 255 ECU_ADDRESS 0x204B19D READ_WRITE /end MEASUREMENT
/begin MEASUREMENT OUT_FMSCAN.Tx_Out.Out_12_Sts.Out_DIAG.Task4 "" UWORD COMP_DEFAULT 0 0 0 65535 ECU_ADDRESS 0x204B19E READ_WRITE /end MEASUREMENT
/begin MEASUREMENT OUT_FMSCAN.Tx_Out.Out_12_Sts.Out_SENSE.Task4 "" UWORD COMP_DEFAULT 0 0 0 65535 ECU_ADDRESS 0x204B1A0 READ_WRITE /end MEASUREMENT
/begin MEASUREMENT OUT_FMSCAN.Tx_Out.Out_12_Sts.Out_TD_DIAG.Task4 "" UWORD COMP_DEFAULT 0 0 0 0 ECU_ADDRESS 0x204B1A2 READ_WRITE /end MEASUREMENT
/begin MEASUREMENT OUT_FMSCAN.Tx_Out.Out_12_Sts.MessageEnable.Task4 "3.3.2.2.1 MessageEnable" UBYTE IS_BOOLEAN_TRUE 0 0 0 1 ECU_ADDRESS 0x204B1A4 READ_WRITE /end MEASUREMENT
/begin MEASUREMENT OUT_FMSCAN.Tx_Out.Out_12_Sts.Out_STATUS.Task4 "" UBYTE COMP_DEFAULT 0 0 0 255 ECU_ADDRESS 0x204B1A5 READ_WRITE /end MEASUREMENT
/begin MEASUREMENT OUT_FMSCAN.Tx_Out.Out_12_Sts.Out_TD.Task4 "" UBYTE IS_BOOLEAN_TRUE 0 0 0 0 ECU_ADDRESS 0x204B1A6 READ_WRITE /end MEASUREMENT
/begin MEASUREMENT OUT_FMSCAN.Tx_Out.Out_11_Sts.Out_DIAG.Task4 "" UWORD COMP_DEFAULT 0 0 0 65535 ECU_ADDRESS 0x204B1A8 READ_WRITE /end MEASUREMENT
/begin MEASUREMENT OUT_FMSCAN.Tx_Out.Out_11_Sts.Out_SENSE.Task4 "" UWORD COMP_DEFAULT 0 0 0 65535 ECU_ADDRESS 0x204B1AA READ_WRITE /end MEASUREMENT
/begin MEASUREMENT OUT_FMSCAN.Tx_Out.Out_11_Sts.MessageEnable.Task4 "3.3.2.2.1 MessageEnable" UBYTE IS_BOOLEAN_TRUE 0 0 0 1 ECU_ADDRESS 0x204B1AC READ_WRITE /end MEASUREMENT
/begin MEASUREMENT OUT_FMSCAN.Tx_Out.Out_11_Sts.Out_STATUS.Task4 "" UBYTE COMP_DEFAULT 0 0 0 255 ECU_ADDRESS 0x204B1AD READ_WRITE /end MEASUREMENT
/begin MEASUREMENT OUT_FMSCAN.Tx_Out.Out_10_Sts.Out_DIAG.Task4 "" UWORD COMP_DEFAULT 0 0 0 65535 ECU_ADDRESS 0x204B1AE READ_WRITE /end MEASUREMENT
/begin MEASUREMENT OUT_FMSCAN.Tx_Out.Out_10_Sts.Out_SENSE.Task4 "" UWORD COMP_DEFAULT 0 0 0 65535 ECU_ADDRESS 0x204B1B0 READ_WRITE /end MEASUREMENT
/begin MEASUREMENT OUT_FMSCAN.Tx_Out.Out_10_Sts.MessageEnable.Task4 "3.3.2.2.1 MessageEnable" UBYTE IS_BOOLEAN_TRUE 0 0 0 1 ECU_ADDRESS 0x204B1B2 READ_WRITE /end MEASUREMENT
/begin MEASUREMENT OUT_FMSCAN.Tx_Out.Out_10_Sts.Out_STATUS.Task4 "" UBYTE COMP_DEFAULT 0 0 0 255 ECU_ADDRESS 0x204B1B3 READ_WRITE /end MEASUREMENT
/begin MEASUREMENT OUT_FMSCAN.Tx_Out.Out_09_Sts.Out_DIAG.Task4 "" UWORD COMP_DEFAULT 0 0 0 65535 ECU_ADDRESS 0x204B1B4 READ_WRITE /end MEASUREMENT
/begin MEASUREMENT OUT_FMSCAN.Tx_Out.Out_09_Sts.Out_SENSE.Task4 "" UWORD COMP_DEFAULT 0 0 0 65535 ECU_ADDRESS 0x204B1B6 READ_WRITE /end MEASUREMENT
/begin MEASUREMENT OUT_FMSCAN.Tx_Out.Out_09_Sts.MessageEnable.Task4 "3.3.2.2.1 MessageEnable" UBYTE IS_BOOLEAN_TRUE 0 0 0 1 ECU_ADDRESS 0x204B1B8 READ_WRITE /end MEASUREMENT
/begin MEASUREMENT OUT_FMSCAN.Tx_Out.Out_09_Sts.Out_STATUS.Task4 "" UBYTE COMP_DEFAULT 0 0 0 255 ECU_ADDRESS 0x204B1B9 READ_WRITE /end MEASUREMENT
/begin MEASUREMENT OUT_FMSCAN.Tx_Out.Out_08_Sts.Out_DIAG.Task4 "" UWORD COMP_DEFAULT 0 0 0 65535 ECU_ADDRESS 0x204B1BA READ_WRITE /end MEASUREMENT
/begin MEASUREMENT OUT_FMSCAN.Tx_Out.Out_08_Sts.Out_SENSE.Task4 "" UWORD COMP_DEFAULT 0 0 0 65535 ECU_ADDRESS 0x204B1BC READ_WRITE /end MEASUREMENT
/begin MEASUREMENT OUT_FMSCAN.Tx_Out.Out_08_Sts.MessageEnable.Task4 "3.3.2.2.1 MessageEnable" UBYTE IS_BOOLEAN_TRUE 0 0 0 1 ECU_ADDRESS 0x204B1BE READ_WRITE /end MEASUREMENT
/begin MEASUREMENT OUT_FMSCAN.Tx_Out.Out_08_Sts.Out_STATUS.Task4 "" UBYTE COMP_DEFAULT 0 0 0 255 ECU_ADDRESS 0x204B1BF READ_WRITE /end MEASUREMENT
/begin MEASUREMENT OUT_FMSCAN.Tx_Out.Out_07_Sts.Out_DIAG.Task4 "" UWORD COMP_DEFAULT 0 0 0 65535 ECU_ADDRESS 0x204B1C0 READ_WRITE /end MEASUREMENT
/begin MEASUREMENT OUT_FMSCAN.Tx_Out.Out_07_Sts.Out_SENSE.Task4 "" UWORD COMP_DEFAULT 0 0 0 65535 ECU_ADDRESS 0x204B1C2 READ_WRITE /end MEASUREMENT
/begin MEASUREMENT OUT_FMSCAN.Tx_Out.Out_07_Sts.MessageEnable.Task4 "3.3.2.2.1 MessageEnable" UBYTE IS_BOOLEAN_TRUE 0 0 0 1 ECU_ADDRESS 0x204B1C4 READ_WRITE /end MEASUREMENT
/begin MEASUREMENT OUT_FMSCAN.Tx_Out.Out_07_Sts.Out_STATUS.Task4 "" UBYTE COMP_DEFAULT 0 0 0 255 ECU_ADDRESS 0x204B1C5 READ_WRITE /end MEASUREMENT
/begin MEASUREMENT OUT_FMSCAN.Tx_Out.Out_06_Sts.Out_DIAG.Task4 "" UWORD COMP_DEFAULT 0 0 0 65535 ECU_ADDRESS 0x204B1C6 READ_WRITE /end MEASUREMENT
/begin MEASUREMENT OUT_FMSCAN.Tx_Out.Out_06_Sts.Out_SENSE.Task4 "" UWORD COMP_DEFAULT 0 0 0 65535 ECU_ADDRESS 0x204B1C8 READ_WRITE /end MEASUREMENT
/begin MEASUREMENT OUT_FMSCAN.Tx_Out.Out_06_Sts.MessageEnable.Task4 "3.3.2.2.1 MessageEnable" UBYTE IS_BOOLEAN_TRUE 0 0 0 1 ECU_ADDRESS 0x204B1CA READ_WRITE /end MEASUREMENT
/begin MEASUREMENT OUT_FMSCAN.Tx_Out.Out_06_Sts.Out_STATUS.Task4 "" UBYTE COMP_DEFAULT 0 0 0 255 ECU_ADDRESS 0x204B1CB READ_WRITE /end MEASUREMENT
/begin MEASUREMENT OUT_FMSCAN.Tx_Out.Out_05_Sts.Out_DIAG.Task4 "" UWORD COMP_DEFAULT 0 0 0 65535 ECU_ADDRESS 0x204B1CC READ_WRITE /end MEASUREMENT
/begin MEASUREMENT OUT_FMSCAN.Tx_Out.Out_05_Sts.Out_SENSE.Task4 "" UWORD COMP_DEFAULT 0 0 0 65535 ECU_ADDRESS 0x204B1CE READ_WRITE /end MEASUREMENT
/begin MEASUREMENT OUT_FMSCAN.Tx_Out.Out_05_Sts.MessageEnable.Task4 "3.3.2.2.1 MessageEnable" UBYTE IS_BOOLEAN_TRUE 0 0 0 1 ECU_ADDRESS 0x204B1D0 READ_WRITE /end MEASUREMENT
/begin MEASUREMENT OUT_FMSCAN.Tx_Out.Out_05_Sts.Out_STATUS.Task4 "" UBYTE COMP_DEFAULT 0 0 0 255 ECU_ADDRESS 0x204B1D1 READ_WRITE /end MEASUREMENT
/begin MEASUREMENT OUT_FMSCAN.Tx_Out.Out_04_Sts.Out_DIAG.Task4 "" UWORD COMP_DEFAULT 0 0 0 65535 ECU_ADDRESS 0x204B1D2 READ_WRITE /end MEASUREMENT
/begin MEASUREMENT OUT_FMSCAN.Tx_Out.Out_04_Sts.Out_SENSE.Task4 "" UWORD COMP_DEFAULT 0 0 0 65535 ECU_ADDRESS 0x204B1D4 READ_WRITE /end MEASUREMENT
/begin MEASUREMENT OUT_FMSCAN.Tx_Out.Out_04_Sts.MessageEnable.Task4 "3.3.2.2.1 MessageEnable" UBYTE IS_BOOLEAN_TRUE 0 0 0 1 ECU_ADDRESS 0x204B1D6 READ_WRITE /end MEASUREMENT
/begin MEASUREMENT OUT_FMSCAN.Tx_Out.Out_04_Sts.Out_STATUS.Task4 "" UBYTE COMP_DEFAULT 0 0 0 255 ECU_ADDRESS 0x204B1D7 READ_WRITE /end MEASUREMENT
/begin MEASUREMENT OUT_FMSCAN.Tx_Out.Out_03_Sts.Out_DIAG.Task4 "" UWORD COMP_DEFAULT 0 0 0 65535 ECU_ADDRESS 0x204B1D8 READ_WRITE /end MEASUREMENT
/begin MEASUREMENT OUT_FMSCAN.Tx_Out.Out_03_Sts.Out_SENSE.Task4 "" UWORD COMP_DEFAULT 0 0 0 65535 ECU_ADDRESS 0x204B1DA READ_WRITE /end MEASUREMENT
/begin MEASUREMENT OUT_FMSCAN.Tx_Out.Out_03_Sts.MessageEnable.Task4 "3.3.2.2.1 MessageEnable" UBYTE IS_BOOLEAN_TRUE 0 0 0 1 ECU_ADDRESS 0x204B1DC READ_WRITE /end MEASUREMENT
/begin MEASUREMENT OUT_FMSCAN.Tx_Out.Out_03_Sts.Out_STATUS.Task4 "" UBYTE COMP_DEFAULT 0 0 0 255 ECU_ADDRESS 0x204B1DD READ_WRITE /end MEASUREMENT
/begin MEASUREMENT OUT_FMSCAN.Tx_Out.Out_02_Sts.Out_DIAG.Task4 "" UWORD COMP_DEFAULT 0 0 0 65535 ECU_ADDRESS 0x204B1DE READ_WRITE /end MEASUREMENT
/begin MEASUREMENT OUT_FMSCAN.Tx_Out.Out_02_Sts.Out_SENSE.Task4 "" UWORD COMP_DEFAULT 0 0 0 65535 ECU_ADDRESS 0x204B1E0 READ_WRITE /end MEASUREMENT
/begin MEASUREMENT OUT_FMSCAN.Tx_Out.Out_02_Sts.MessageEnable.Task4 "3.3.2.2.1 MessageEnable" UBYTE IS_BOOLEAN_TRUE 0 0 0 1 ECU_ADDRESS 0x204B1E2 READ_WRITE /end MEASUREMENT
/begin MEASUREMENT OUT_FMSCAN.Tx_Out.Out_02_Sts.Out_STATUS.Task4 "" UBYTE COMP_DEFAULT 0 0 0 255 ECU_ADDRESS 0x204B1E3 READ_WRITE /end MEASUREMENT
/begin MEASUREMENT OUT_FMSCAN.Tx_Out.Out_01_Sts.Out_DIAG.Task4 "" UWORD COMP_DEFAULT 0 0 0 65535 ECU_ADDRESS 0x204B1E4 READ_WRITE /end MEASUREMENT
/begin MEASUREMENT OUT_FMSCAN.Tx_Out.Out_01_Sts.Out_SENSE.Task4 "" UWORD COMP_DEFAULT 0 0 0 65535 ECU_ADDRESS 0x204B1E6 READ_WRITE /end MEASUREMENT
/begin MEASUREMENT OUT_FMSCAN.Tx_Out.Out_01_Sts.MessageEnable.Task4 "3.3.2.2.1 MessageEnable" UBYTE IS_BOOLEAN_TRUE 0 0 0 1 ECU_ADDRESS 0x204B1E8 READ_WRITE /end MEASUREMENT
/begin MEASUREMENT OUT_FMSCAN.Tx_Out.Out_01_Sts.Out_STATUS.Task4 "" UBYTE COMP_DEFAULT 0 0 0 255 ECU_ADDRESS 0x204B1E9 READ_WRITE /end MEASUREMENT
/begin MEASUREMENT OUT_FMSCAN.Tx_Out.Out_21_TD_Sts.Out_SENSE_PULSE.Task4 "" UWORD COMP_DEFAULT 0 0 0 0 ECU_ADDRESS 0x204B030 READ_WRITE /end MEASUREMENT
/begin MEASUREMENT OUT_FMSCAN.Tx_Out.Out_21_TD_Sts.Out_SENSE_PULSE_DIAG.Task4 "" UWORD COMP_DEFAULT 0 0 0 0 ECU_ADDRESS 0x204B032 READ_WRITE /end MEASUREMENT
/begin MEASUREMENT OUT_FMSCAN.Tx_Out.Out_21_TD_Sts.MessageEnable.Task4 "3.3.2.2.1 MessageEnable" UBYTE IS_BOOLEAN_TRUE 0 0 0 1 ECU_ADDRESS 0x204B034 READ_WRITE /end MEASUREMENT
/begin MEASUREMENT OUT_FMSCAN.GW_00000FF5.MessageEnable.Task2 "3.1.2.2.1 MessageEnable" UBYTE IS_BOOLEAN_TRUE 0 0 0 1 ECU_ADDRESS 0x2049054 READ_WRITE /end MEASUREMENT
/begin MEASUREMENT OUT_DRCAN.MessageForwardingEnable.Task2 "3.1.2.2.2 MessageForwardingEnable" UBYTE IS_BOOLEAN_TRUE 0 0 0 1 ECU_ADDRESS 0x2049057 READ_WRITE /end MEASUREMENT
/begin MEASUREMENT OUT_DRCAN.GW_00000FF6.MessageEnable.Task2 "3.1.2.2.1 MessageEnable" UBYTE IS_BOOLEAN_TRUE 0 0 0 1 ECU_ADDRESS 0x2049056 READ_WRITE /end MEASUREMENT
/begin MEASUREMENT OUT_HCAN.MessageForwardingEnable.Task2 "3.1.2.2.2 MessageForwardingEnable" UBYTE IS_BOOLEAN_TRUE 0 0 0 1 ECU_ADDRESS 0x2049059 READ_WRITE /end MEASUREMENT
/begin MEASUREMENT OUT_HCAN.GW_00000FF7.MessageEnable.Task2 "3.1.2.2.1 MessageEnable" UBYTE IS_BOOLEAN_TRUE 0 0 0 1 ECU_ADDRESS 0x2049058 READ_WRITE /end MEASUREMENT
/begin MEASUREMENT OUT_LIN_01.LinNetworkRequest1.Task5 "" UBYTE IS_BOOLEAN_TRUE 0 0 0 1 ECU_ADDRESS 0x204C04C READ_WRITE /end MEASUREMENT
/begin MEASUREMENT OUT_LIN_01.ScheduleTable.Task5 "" UBYTE COMP_DEFAULT 0 0 0 255 ECU_ADDRESS 0x204C04D READ_WRITE /end MEASUREMENT
/begin MEASUREMENT IN_NodeMFL.MFL_BtnInfo.DeviceState.Task5 "" UWORD COMP_DEFAULT 0 0 0 65535 ECU_ADDRESS 0x204021C READ_WRITE /end MEASUREMENT
/begin MEASUREMENT IN_NodeMFL.MFL_BtnInfo.MFL_BtnInfo_Btn1.Task5 "" UBYTE COMP_DEFAULT 0 0 0 1 ECU_ADDRESS 0x204021E READ_WRITE /end MEASUREMENT
/begin MEASUREMENT IN_NodeMFL.MFL_BtnInfo.MFL_BtnInfo_Btn10.Task5 "" UBYTE COMP_DEFAULT 0 0 0 1 ECU_ADDRESS 0x204021F READ_WRITE /end MEASUREMENT
/begin MEASUREMENT IN_NodeMFL.MFL_BtnInfo.MFL_BtnInfo_Btn2.Task5 "" UBYTE COMP_DEFAULT 0 0 0 1 ECU_ADDRESS 0x2040220 READ_WRITE /end MEASUREMENT
/begin MEASUREMENT IN_NodeMFL.MFL_BtnInfo.MFL_BtnInfo_Btn3.Task5 "" UBYTE COMP_DEFAULT 0 0 0 1 ECU_ADDRESS 0x2040221 READ_WRITE /end MEASUREMENT
/begin MEASUREMENT IN_NodeMFL.MFL_BtnInfo.MFL_BtnInfo_Btn3LPress.Task5 "" UBYTE COMP_DEFAULT 0 0 0 1 ECU_ADDRESS 0x2040222 READ_WRITE /end MEASUREMENT
/begin MEASUREMENT IN_NodeMFL.MFL_BtnInfo.MFL_BtnInfo_Btn3SPress.Task5 "" UBYTE COMP_DEFAULT 0 0 0 1 ECU_ADDRESS 0x2040223 READ_WRITE /end MEASUREMENT
/begin MEASUREMENT IN_NodeMFL.MFL_BtnInfo.MFL_BtnInfo_Btn4.Task5 "" UBYTE COMP_DEFAULT 0 0 0 1 ECU_ADDRESS 0x2040224 READ_WRITE /end MEASUREMENT
/begin MEASUREMENT IN_NodeMFL.MFL_BtnInfo.MFL_BtnInfo_Btn4LPress.Task5 "" UBYTE COMP_DEFAULT 0 0 0 1 ECU_ADDRESS 0x2040225 READ_WRITE /end MEASUREMENT
/begin MEASUREMENT IN_NodeMFL.MFL_BtnInfo.MFL_BtnInfo_Btn4SPress.Task5 "" UBYTE COMP_DEFAULT 0 0 0 1 ECU_ADDRESS 0x2040226 READ_WRITE /end MEASUREMENT
/begin MEASUREMENT IN_NodeMFL.MFL_BtnInfo.MFL_BtnInfo_Btn5.Task5 "" UBYTE COMP_DEFAULT 0 0 0 1 ECU_ADDRESS 0x2040227 READ_WRITE /end MEASUREMENT
/begin MEASUREMENT IN_NodeMFL.MFL_BtnInfo.MFL_BtnInfo_Btn5LPress.Task5 "" UBYTE COMP_DEFAULT 0 0 0 1 ECU_ADDRESS 0x2040228 READ_WRITE /end MEASUREMENT
/begin MEASUREMENT IN_NodeMFL.MFL_BtnInfo.MFL_BtnInfo_Btn5SPress.Task5 "" UBYTE COMP_DEFAULT 0 0 0 1 ECU_ADDRESS 0x2040229 READ_WRITE /end MEASUREMENT
/begin MEASUREMENT IN_NodeMFL.MFL_BtnInfo.MFL_BtnInfo_Btn6.Task5 "" UBYTE COMP_DEFAULT 0 0 0 1 ECU_ADDRESS 0x204022A READ_WRITE /end MEASUREMENT
/begin MEASUREMENT IN_NodeMFL.MFL_BtnInfo.MFL_BtnInfo_Btn7.Task5 "" UBYTE COMP_DEFAULT 0 0 0 1 ECU_ADDRESS 0x204022B READ_WRITE /end MEASUREMENT
/begin MEASUREMENT IN_NodeMFL.MFL_BtnInfo.MFL_BtnInfo_Btn8.Task5 "" UBYTE COMP_DEFAULT 0 0 0 1 ECU_ADDRESS 0x204022C READ_WRITE /end MEASUREMENT
/begin MEASUREMENT IN_NodeMFL.MFL_BtnInfo.MFL_BtnInfo_Btn9.Task5 "" UBYTE COMP_DEFAULT 0 0 0 1 ECU_ADDRESS 0x204022D READ_WRITE /end MEASUREMENT
/begin MEASUREMENT IN_NodeMFL.MFL_BtnInfo.MFL_BtnInfo_ErrorLoc.Task5 "" UBYTE COMP_DEFAULT 0 0 0 15 ECU_ADDRESS 0x204022E READ_WRITE /end MEASUREMENT
/begin MEASUREMENT IN_NodeMFL.MFL_BtnInfo.MFL_BtnInfo_ErrorType.Task5 "" UBYTE COMP_DEFAULT 0 0 0 15 ECU_ADDRESS 0x204022F READ_WRITE /end MEASUREMENT
/begin MEASUREMENT IN_NodeMFL.MFL_BtnInfo.MFL_BtnInfo_MsgCounter.Task5 "" UBYTE COMP_DEFAULT 0 0 0 15 ECU_ADDRESS 0x2040230 READ_WRITE /end MEASUREMENT
/begin MEASUREMENT IN_NodeDNR.DNR_Position.DeviceState.Task5 "" UWORD COMP_DEFAULT 0 0 0 65535 ECU_ADDRESS 0x2040210 READ_WRITE /end MEASUREMENT
/begin MEASUREMENT IN_NodeDNR.DNR_Position.DNR_Position_D1.Task5 "" UBYTE COMP_DEFAULT 0 0 0 1 ECU_ADDRESS 0x2040212 READ_WRITE /end MEASUREMENT
/begin MEASUREMENT IN_NodeDNR.DNR_Position.DNR_Position_D4.Task5 "" UBYTE COMP_DEFAULT 0 0 0 1 ECU_ADDRESS 0x2040213 READ_WRITE /end MEASUREMENT
/begin MEASUREMENT IN_NodeDNR.DNR_Position.DNR_Position_D7.Task5 "" UBYTE COMP_DEFAULT 0 0 0 1 ECU_ADDRESS 0x2040214 READ_WRITE /end MEASUREMENT
/begin MEASUREMENT IN_NodeDNR.DNR_Position.DNR_Position_DM.Task5 "" UBYTE COMP_DEFAULT 0 0 0 1 ECU_ADDRESS 0x2040215 READ_WRITE /end MEASUREMENT
/begin MEASUREMENT IN_NodeDNR.DNR_Position.DNR_Position_MsgCounter.Task5 "" UBYTE COMP_DEFAULT 0 0 0 15 ECU_ADDRESS 0x2040216 READ_WRITE /end MEASUREMENT
/begin MEASUREMENT IN_NodeDNR.DNR_Position.DNR_Position_N.Task5 "" UBYTE COMP_DEFAULT 0 0 0 1 ECU_ADDRESS 0x2040217 READ_WRITE /end MEASUREMENT
/begin MEASUREMENT IN_NodeDNR.DNR_Position.DNR_Position_R1.Task5 "" UBYTE COMP_DEFAULT 0 0 0 1 ECU_ADDRESS 0x2040218 READ_WRITE /end MEASUREMENT
/begin MEASUREMENT IN_NodeDNR.DNR_Position.DNR_Position_RM.Task5 "" UBYTE COMP_DEFAULT 0 0 0 1 ECU_ADDRESS 0x2040219 READ_WRITE /end MEASUREMENT
/begin MEASUREMENT IN_NodeDNR.DNR_Position.DNR_Position_SwitchStatus.Task5 "" UBYTE COMP_DEFAULT 0 0 0 15 ECU_ADDRESS 0x204021A READ_WRITE /end MEASUREMENT
/begin MEASUREMENT OUT_Tester_1.BSG_STATUS.BatteryVoltage.Task5 "" UWORD COMP_DEFAULT 0 0 0 65535 ECU_ADDRESS 0x204C044 READ_WRITE /end MEASUREMENT
/begin MEASUREMENT OUT_Tester_1.BSG_STATUS.Button_KL15.Task5 "" UBYTE COMP_DEFAULT 0 0 0 255 ECU_ADDRESS 0x204C046 READ_WRITE /end MEASUREMENT
/begin MEASUREMENT OUT_Tester_1.BSG_STATUS.Voltage_Normal.Task5 "" UBYTE COMP_DEFAULT 0 0 0 255 ECU_ADDRESS 0x204C047 READ_WRITE /end MEASUREMENT
/begin MEASUREMENT OUT_Tester_1.BSG_STATUS.Voltage_OV1.Task5 "" UBYTE COMP_DEFAULT 0 0 0 255 ECU_ADDRESS 0x204C048 READ_WRITE /end MEASUREMENT
/begin MEASUREMENT OUT_Tester_1.BSG_STATUS.Voltage_OV2.Task5 "" UBYTE COMP_DEFAULT 0 0 0 255 ECU_ADDRESS 0x204C049 READ_WRITE /end MEASUREMENT
/begin MEASUREMENT OUT_Tester_1.BSG_STATUS.Voltage_UV1.Task5 "" UBYTE COMP_DEFAULT 0 0 0 255 ECU_ADDRESS 0x204C04A READ_WRITE /end MEASUREMENT
/begin MEASUREMENT OUT_Tester_1.BSG_STATUS.Voltage_UV2.Task5 "" UBYTE COMP_DEFAULT 0 0 0 255 ECU_ADDRESS 0x204C04B READ_WRITE /end MEASUREMENT
/begin MEASUREMENT IN_TSUD.ShaftSpeed.Task5 "" UWORD COMP_DEFAULT 0 0 0 65535 ECU_ADDRESS 0x2040232 READ_WRITE /end MEASUREMENT
/begin MEASUREMENT IN_TSUD.VehicleSpeed.Task5 "" UWORD COMP_DEFAULT 0 0 0 65535 ECU_ADDRESS 0x2040234 READ_WRITE /end MEASUREMENT
/begin MEASUREMENT OUT_TSUD.DeviceEnable.Task5 "" UBYTE IS_BOOLEAN_TRUE 0 0 0 1 ECU_ADDRESS 0x204C04E READ_WRITE /end MEASUREMENT
/begin MEASUREMENT OUT_TSUD.SetDiagWriteOdoResponse.Task5 "" UBYTE COMP_DEFAULT 0 0 0 255 ECU_ADDRESS 0x204C04F READ_WRITE /end MEASUREMENT
/begin MEASUREMENT DIAG_TSUD.ShaftSpeed_DIAG.Task5 "Diagnostic Input" UWORD COMP_DEFAULT 0 0 0 65535 ECU_ADDRESS 0x2040012 READ_WRITE /end MEASUREMENT
/begin MEASUREMENT DIAG_TSUD.VehicleSpeed_DIAG.Task5 "Diagnostic Input" UWORD COMP_DEFAULT 0 0 0 65535 ECU_ADDRESS 0x2040014 READ_WRITE /end MEASUREMENT
/begin MEASUREMENT IN_InertianSensor.Accelerometer.Ax.Task5 "" SWORD COMP_DEFAULT 0 0 -32768 32767 ECU_ADDRESS 0x2040236 READ_WRITE /end MEASUREMENT
/begin MEASUREMENT IN_InertianSensor.Accelerometer.Ay.Task5 "" SWORD COMP_DEFAULT 0 0 -32768 32767 ECU_ADDRESS 0x2040238 READ_WRITE /end MEASUREMENT
/begin MEASUREMENT IN_InertianSensor.Accelerometer.Az.Task5 "" SWORD COMP_DEFAULT 0 0 -32768 32767 ECU_ADDRESS 0x204023A READ_WRITE /end MEASUREMENT
/begin MEASUREMENT OUT_InertianSensor.Accelerometer.DeviceEnable.Task5 "" UBYTE IS_BOOLEAN_TRUE 0 0 0 1 ECU_ADDRESS 0x204C050 READ_WRITE /end MEASUREMENT
/begin MEASUREMENT IN_LinSlave.DeviceState.Task5 "" UWORD COMP_DEFAULT 0 0 0 65535 ECU_ADDRESS 0x204023C READ_WRITE /end MEASUREMENT
/begin MEASUREMENT OUT_LinSlave.SetFrameLss1B.Task5 "" UBYTE COMP_DEFAULT 0 0 0 255 ECU_ADDRESS 0x204C051 READ_WRITE MATRIX_DIM 4 /end MEASUREMENT
/begin MEASUREMENT OUT_LinSlave.SetFrameMlfB.Task5 "" UBYTE COMP_DEFAULT 0 0 0 255 ECU_ADDRESS 0x204C055 READ_WRITE MATRIX_DIM 4 /end MEASUREMENT
/begin MEASUREMENT OUT_LinSlave.WakeupRequest.Task5 "" UBYTE IS_BOOLEAN_TRUE 0 0 0 1 ECU_ADDRESS 0x204C059 READ_WRITE /end MEASUREMENT
/begin CHARACTERISTIC HBrakeTime "HBrakeTime" VALUE 0x8DC8 LC_A_UINT16 0 COMP_LINEAR.HBrakeTime 0 3276.75 /end CHARACTERISTIC
/begin CHARACTERISTIC HOpenLoadDetectTime "HOpenLoadDetectTime" VALUE 0x8DCA LC_A_UINT16 0 COMP_LINEAR.HOpenLoadDetectTime 0 3276.75 /end CHARACTERISTIC
/begin CHARACTERISTIC HMaxActivationTimeTime "HMaxActivationTimeTime:  " VALUE 0x8DCC LC_A_UINT16 0 COMP_LINEAR.HMaxActivationTimeTime 0 3276.75 /end CHARACTERISTIC
/begin CHARACTERISTIC HOpenLoadIntervalTime "HOpenLoadIntervalTime" VALUE 0x8DCE LC_A_UINT16 0 COMP_LINEAR.HOpenLoadIntervalTime 0 3276.75 /end CHARACTERISTIC
/begin CHARACTERISTIC ModelHoldMinTimeAfterPOR "ModelHoldMinTimeAfterPOR" VALUE 0x8DD0 LC_A_UINT16 0 COMP_LINEAR.ModelHoldMinTimeAfterPOR 0 6553.5 /end CHARACTERISTIC
/begin CHARACTERISTIC BlinkSourcePeriod "BlinkSourcePeriod" VALUE 0x8DD2 LC_A_UINT16 0 COMP_LINEAR.BlinkSourcePeriod 0 2621.4 /end CHARACTERISTIC
/begin CHARACTERISTIC TrailerDetectionTime "TrailerDetectionTime" VALUE 0x8DD4 LC_A_UINT8 0 COMP_LINEAR.TrailerDetectionTime 0 5.1 /end CHARACTERISTIC
/begin GROUP SYSTEM.P_CAN.GW_00000FF3 "GW_00000FF3"
 /begin ANNOTATION ANNOTATION_LABEL "Instance" ANNOTATION_ORIGIN "Group" /begin ANNOTATION_TEXT "0" /end ANNOTATION_TEXT /end ANNOTATION
 /begin ANNOTATION ANNOTATION_LABEL "TaskCycleTime" ANNOTATION_ORIGIN "Group" /begin ANNOTATION_TEXT "0" /end ANNOTATION_TEXT /end ANNOTATION
 /begin ANNOTATION ANNOTATION_LABEL "TimeResolution" ANNOTATION_ORIGIN "Group" /begin ANNOTATION_TEXT "0" /end ANNOTATION_TEXT /end ANNOTATION
 /begin REF_MEASUREMENT OUT_PCAN.GW_00000FF3.MessageEnable.Task2 /end REF_MEASUREMENT
/end GROUP
/begin GROUP SYSTEM.P_CAN "P-CAN"
 /begin ANNOTATION ANNOTATION_LABEL "Instance" ANNOTATION_ORIGIN "Group" /begin ANNOTATION_TEXT "0" /end ANNOTATION_TEXT /end ANNOTATION
 /begin ANNOTATION ANNOTATION_LABEL "TaskCycleTime" ANNOTATION_ORIGIN "Group" /begin ANNOTATION_TEXT "0" /end ANNOTATION_TEXT /end ANNOTATION
 /begin ANNOTATION ANNOTATION_LABEL "TimeResolution" ANNOTATION_ORIGIN "Group" /begin ANNOTATION_TEXT "0" /end ANNOTATION_TEXT /end ANNOTATION
 /begin SUB_GROUP SYSTEM.P_CAN.Out_PWM_Ctrl SYSTEM.P_CAN.Out_Ctrl SYSTEM.P_CAN.DateTime_SetTime_Ctrl SYSTEM.P_CAN.In_Ana_Ctrl SYSTEM.P_CAN.Out_20_TD_Sts SYSTEM.P_CAN.Out_15_TD_Sts SYSTEM.P_CAN.Out_14_TD_Sts SYSTEM.P_CAN.Out_13_TD_Sts SYSTEM.P_CAN.Out_12_TD_Sts SYSTEM.P_CAN.Out_08_TD_Sts SYSTEM.P_CAN.Out_07_TD_Sts SYSTEM.P_CAN.Out_06_TD_Sts SYSTEM.P_CAN.Out_04_TD_Sts SYSTEM.P_CAN.Out_01_TD_Sts SYSTEM.P_CAN.DateTime_SetTime_Sts SYSTEM.P_CAN.DateTime_TicksCount_Sts SYSTEM.P_CAN.DateTime_SystemTime_Sts SYSTEM.P_CAN.DateTime_LocalTime_Sts SYSTEM.P_CAN.IN_ANA_11_SEL2_Sts SYSTEM.P_CAN.IN_ANA_10_SEL2_Sts SYSTEM.P_CAN.IN_ANA_09_SEL2_Sts SYSTEM.P_CAN.IN_ANA_08_SEL2_Sts SYSTEM.P_CAN.In_Ana_15_Sts SYSTEM.P_CAN.In_Ana_14_Sts SYSTEM.P_CAN.In_Ana_13_Sts SYSTEM.P_CAN.In_Ana_12_Sts SYSTEM.P_CAN.IN_ANA_11_SEL1_Sts SYSTEM.P_CAN.IN_ANA_10_SEL1_Sts SYSTEM.P_CAN.IN_ANA_09_SEL1_Sts SYSTEM.P_CAN.IN_ANA_08_SEL1_Sts SYSTEM.P_CAN.In_Ana_07_Sts SYSTEM.P_CAN.In_Ana_06_Sts SYSTEM.P_CAN.In_Ana_05_Sts SYSTEM.P_CAN.In_Ana_04_Sts SYSTEM.P_CAN.In_Ana_03_Sts SYSTEM.P_CAN.In_Ana_02_Sts SYSTEM.P_CAN.In_Ana_01_Sts SYSTEM.P_CAN.TSU_Sts SYSTEM.P_CAN.PWR_G7_Sts SYSTEM.P_CAN.PWR_G5_Sts SYSTEM.P_CAN.PWR_G4_Sts SYSTEM.P_CAN.PWR_G3_Sts SYSTEM.P_CAN.PWR_G2_Sts SYSTEM.P_CAN.PWR_G1_Sts SYSTEM.P_CAN.PWR_Sts SYSTEM.P_CAN.In_Dig_50_Sts SYSTEM.P_CAN.In_Dig_49_Sts SYSTEM.P_CAN.In_Dig_48_Sts SYSTEM.P_CAN.In_Dig_46_Sts SYSTEM.P_CAN.In_Dig_45_Sts SYSTEM.P_CAN.In_Dig_44_Sts SYSTEM.P_CAN.In_Dig_43_Sts SYSTEM.P_CAN.In_Dig_42_Sts SYSTEM.P_CAN.In_Dig_41_Sts SYSTEM.P_CAN.In_Dig_40_Sts SYSTEM.P_CAN.In_Dig_39_Sts SYSTEM.P_CAN.In_Dig_38_Sts SYSTEM.P_CAN.In_Dig_37_Sts SYSTEM.P_CAN.In_Dig_36_Sts SYSTEM.P_CAN.In_Dig_35_Sts SYSTEM.P_CAN.In_Dig_34_Sts SYSTEM.P_CAN.In_Dig_33_Sts SYSTEM.P_CAN.In_Dig_32_Sts SYSTEM.P_CAN.In_Dig_31_Sts SYSTEM.P_CAN.In_Dig_30_Sts SYSTEM.P_CAN.In_Dig_29_Sts SYSTEM.P_CAN.In_Dig_28_Sts SYSTEM.P_CAN.In_Dig_27_Sts SYSTEM.P_CAN.In_Dig_26_Sts SYSTEM.P_CAN.In_Dig_25_Sts SYSTEM.P_CAN.In_Dig_24_Sts SYSTEM.P_CAN.In_Dig_23_Sts SYSTEM.P_CAN.In_Dig_22_Sts SYSTEM.P_CAN.In_Dig_21_Sts SYSTEM.P_CAN.In_Dig_20_Sts SYSTEM.P_CAN.In_Dig_19_Sts SYSTEM.P_CAN.In_Dig_18_Sts SYSTEM.P_CAN.In_Dig_17_Sts SYSTEM.P_CAN.In_Dig_16_Sts SYSTEM.P_CAN.In_Dig_15_Sts SYSTEM.P_CAN.In_Dig_14_Sts SYSTEM.P_CAN.In_Dig_13_Sts SYSTEM.P_CAN.In_Dig_12_Sts SYSTEM.P_CAN.In_Dig_11_Sts SYSTEM.P_CAN.In_Dig_10_Sts SYSTEM.P_CAN.In_Dig_09_Sts SYSTEM.P_CAN.In_Dig_08_Sts SYSTEM.P_CAN.In_Dig_07_Sts SYSTEM.P_CAN.In_Dig_06_Sts SYSTEM.P_CAN.In_Dig_05_Sts SYSTEM.P_CAN.In_Dig_04_Sts SYSTEM.P_CAN.In_Dig_03_Sts SYSTEM.P_CAN.In_Dig_02_Sts SYSTEM.P_CAN.In_Dig_01_Sts SYSTEM.P_CAN.Out_Supply_ANA_03_Sts SYSTEM.P_CAN.Out_Supply_ANA_02_Sts SYSTEM.P_CAN.Out_Supply_ANA_01_Sts SYSTEM.P_CAN.Lin_Sts SYSTEM.P_CAN.ACCELEROMETER SYSTEM.P_CAN.Out_27_Sts SYSTEM.P_CAN.Out_26_Sts SYSTEM.P_CAN.Out_25_Sts SYSTEM.P_CAN.Out_24_Sts SYSTEM.P_CAN.Out_23_Sts SYSTEM.P_CAN.Out_22_Sts SYSTEM.P_CAN.Out_21_Sts SYSTEM.P_CAN.Out_20_Sts SYSTEM.P_CAN.Out_19_Sts SYSTEM.P_CAN.Out_18_Sts SYSTEM.P_CAN.Out_17_Sts SYSTEM.P_CAN.Out_16_Sts SYSTEM.P_CAN.Out_15_Sts SYSTEM.P_CAN.Out_14_Sts SYSTEM.P_CAN.Out_13_Sts SYSTEM.P_CAN.Out_12_Sts SYSTEM.P_CAN.Out_11_Sts SYSTEM.P_CAN.Out_10_Sts SYSTEM.P_CAN.Out_09_Sts SYSTEM.P_CAN.Out_08_Sts SYSTEM.P_CAN.Out_07_Sts SYSTEM.P_CAN.Out_06_Sts SYSTEM.P_CAN.Out_05_Sts SYSTEM.P_CAN.Out_04_Sts SYSTEM.P_CAN.Out_03_Sts SYSTEM.P_CAN.Out_02_Sts SYSTEM.P_CAN.Out_01_Sts SYSTEM.P_CAN.Out_21_TD_Sts SYSTEM.P_CAN.DM1_10 SYSTEM.P_CAN.DM1_Tx SYSTEM.P_CAN.GW_00000FF3 /end SUB_GROUP
 /begin REF_MEASUREMENT OUT_PCAN.MessageForwardingEnable.Task2 /end REF_MEASUREMENT
/end GROUP
/begin GROUP SYSTEM.I_CAN.Ctrl50_ScrDA2 "Ctrl50_ScrDA2"
 /begin ANNOTATION ANNOTATION_LABEL "Instance" ANNOTATION_ORIGIN "Group" /begin ANNOTATION_TEXT "1" /end ANNOTATION_TEXT /end ANNOTATION
 /begin ANNOTATION ANNOTATION_LABEL "TaskCycleTime" ANNOTATION_ORIGIN "Group" /begin ANNOTATION_TEXT "0" /end ANNOTATION_TEXT /end ANNOTATION
 /begin ANNOTATION ANNOTATION_LABEL "TimeResolution" ANNOTATION_ORIGIN "Group" /begin ANNOTATION_TEXT "0" /end ANNOTATION_TEXT /end ANNOTATION
 /begin REF_MEASUREMENT OUT_ICAN.BSG_TX_18DA1721.Ctrl50_ScrDA2.MessageEnable.Task2 /end REF_MEASUREMENT
/end GROUP
/begin GROUP SYSTEM.I_CAN.Ctrl50_ScrDA1 "Ctrl50_ScrDA1"
 /begin ANNOTATION ANNOTATION_LABEL "Instance" ANNOTATION_ORIGIN "Group" /begin ANNOTATION_TEXT "2" /end ANNOTATION_TEXT /end ANNOTATION
 /begin ANNOTATION ANNOTATION_LABEL "TaskCycleTime" ANNOTATION_ORIGIN "Group" /begin ANNOTATION_TEXT "0" /end ANNOTATION_TEXT /end ANNOTATION
 /begin ANNOTATION ANNOTATION_LABEL "TimeResolution" ANNOTATION_ORIGIN "Group" /begin ANNOTATION_TEXT "0" /end ANNOTATION_TEXT /end ANNOTATION
 /begin REF_MEASUREMENT OUT_ICAN.BSG_TX_18DA1721.Ctrl50_ScrDA1.MessageEnable.Task2 /end REF_MEASUREMENT
/end GROUP
/begin GROUP SYSTEM.I_CAN.Ctrl50_FcnDA2 "Ctrl50_FcnDA2"
 /begin ANNOTATION ANNOTATION_LABEL "Instance" ANNOTATION_ORIGIN "Group" /begin ANNOTATION_TEXT "3" /end ANNOTATION_TEXT /end ANNOTATION
 /begin ANNOTATION ANNOTATION_LABEL "TaskCycleTime" ANNOTATION_ORIGIN "Group" /begin ANNOTATION_TEXT "0" /end ANNOTATION_TEXT /end ANNOTATION
 /begin ANNOTATION ANNOTATION_LABEL "TimeResolution" ANNOTATION_ORIGIN "Group" /begin ANNOTATION_TEXT "0" /end ANNOTATION_TEXT /end ANNOTATION
 /begin REF_MEASUREMENT OUT_ICAN.BSG_TX_18DA1721.Ctrl50_FcnDA2.MessageEnable.Task2 /end REF_MEASUREMENT
/end GROUP
/begin GROUP SYSTEM.I_CAN.Ctrl50_FcnDA1 "Ctrl50_FcnDA1"
 /begin ANNOTATION ANNOTATION_LABEL "Instance" ANNOTATION_ORIGIN "Group" /begin ANNOTATION_TEXT "4" /end ANNOTATION_TEXT /end ANNOTATION
 /begin ANNOTATION ANNOTATION_LABEL "TaskCycleTime" ANNOTATION_ORIGIN "Group" /begin ANNOTATION_TEXT "0" /end ANNOTATION_TEXT /end ANNOTATION
 /begin ANNOTATION ANNOTATION_LABEL "TimeResolution" ANNOTATION_ORIGIN "Group" /begin ANNOTATION_TEXT "0" /end ANNOTATION_TEXT /end ANNOTATION
 /begin REF_MEASUREMENT OUT_ICAN.BSG_TX_18DA1721.Ctrl50_FcnDA1.MessageEnable.Task2 /end REF_MEASUREMENT
/end GROUP
/begin GROUP SYSTEM.I_CAN.Ctrl50_SubView "Ctrl50_SubView"
 /begin ANNOTATION ANNOTATION_LABEL "Instance" ANNOTATION_ORIGIN "Group" /begin ANNOTATION_TEXT "5" /end ANNOTATION_TEXT /end ANNOTATION
 /begin ANNOTATION ANNOTATION_LABEL "TaskCycleTime" ANNOTATION_ORIGIN "Group" /begin ANNOTATION_TEXT "0" /end ANNOTATION_TEXT /end ANNOTATION
 /begin ANNOTATION ANNOTATION_LABEL "TimeResolution" ANNOTATION_ORIGIN "Group" /begin ANNOTATION_TEXT "0" /end ANNOTATION_TEXT /end ANNOTATION
 /begin REF_MEASUREMENT OUT_ICAN.BSG_TX_18DA1721.Ctrl50_SubView.MessageEnable.Task2 /end REF_MEASUREMENT
/end GROUP
/begin GROUP SYSTEM.I_CAN.ICHMI1CTRL "ICHMI1CTRL"
 /begin ANNOTATION ANNOTATION_LABEL "Instance" ANNOTATION_ORIGIN "Group" /begin ANNOTATION_TEXT "6" /end ANNOTATION_TEXT /end ANNOTATION
 /begin ANNOTATION ANNOTATION_LABEL "TaskCycleTime" ANNOTATION_ORIGIN "Group" /begin ANNOTATION_TEXT "0" /end ANNOTATION_TEXT /end ANNOTATION
 /begin ANNOTATION ANNOTATION_LABEL "TimeResolution" ANNOTATION_ORIGIN "Group" /begin ANNOTATION_TEXT "0" /end ANNOTATION_TEXT /end ANNOTATION
 /begin REF_MEASUREMENT OUT_ICAN.BSG_TX_18DA1721.ICHMI1CTRL.MessageEnable.Task2 /end REF_MEASUREMENT
/end GROUP
/begin GROUP SYSTEM.I_CAN.ICOM1CTRL "ICOM1CTRL"
 /begin ANNOTATION ANNOTATION_LABEL "Instance" ANNOTATION_ORIGIN "Group" /begin ANNOTATION_TEXT "0" /end ANNOTATION_TEXT /end ANNOTATION
 /begin ANNOTATION ANNOTATION_LABEL "TaskCycleTime" ANNOTATION_ORIGIN "Group" /begin ANNOTATION_TEXT "0" /end ANNOTATION_TEXT /end ANNOTATION
 /begin ANNOTATION ANNOTATION_LABEL "TimeResolution" ANNOTATION_ORIGIN "Group" /begin ANNOTATION_TEXT "0" /end ANNOTATION_TEXT /end ANNOTATION
 /begin REF_MEASUREMENT OUT_ICAN.BSG_TX_18DA1721.ICOM1CTRL.ICOMCtrl.Task2 OUT_ICAN.BSG_TX_18DA1721.ICOM1CTRL.MessageEnable.Task2 /end REF_MEASUREMENT
/end GROUP
/begin GROUP SYSTEM.I_CAN.GW_00000FF4 "GW_00000FF4"
 /begin ANNOTATION ANNOTATION_LABEL "Instance" ANNOTATION_ORIGIN "Group" /begin ANNOTATION_TEXT "1" /end ANNOTATION_TEXT /end ANNOTATION
 /begin ANNOTATION ANNOTATION_LABEL "TaskCycleTime" ANNOTATION_ORIGIN "Group" /begin ANNOTATION_TEXT "0" /end ANNOTATION_TEXT /end ANNOTATION
 /begin ANNOTATION ANNOTATION_LABEL "TimeResolution" ANNOTATION_ORIGIN "Group" /begin ANNOTATION_TEXT "0" /end ANNOTATION_TEXT /end ANNOTATION
 /begin REF_MEASUREMENT OUT_ICAN.GW_00000FF4.MessageEnable.Task2 /end REF_MEASUREMENT
/end GROUP
/begin GROUP SYSTEM.I_CAN.GW_18DAF017 "GW_18DAF017"
 /begin ANNOTATION ANNOTATION_LABEL "Instance" ANNOTATION_ORIGIN "Group" /begin ANNOTATION_TEXT "2" /end ANNOTATION_TEXT /end ANNOTATION
 /begin ANNOTATION ANNOTATION_LABEL "TaskCycleTime" ANNOTATION_ORIGIN "Group" /begin ANNOTATION_TEXT "0" /end ANNOTATION_TEXT /end ANNOTATION
 /begin ANNOTATION ANNOTATION_LABEL "TimeResolution" ANNOTATION_ORIGIN "Group" /begin ANNOTATION_TEXT "0" /end ANNOTATION_TEXT /end ANNOTATION
 /begin REF_MEASUREMENT OUT_ICAN.GW_18DAF017.MessageEnable.Task2 /end REF_MEASUREMENT
/end GROUP
/begin GROUP SYSTEM.I_CAN.GW_18DAF117 "GW_18DAF117"
 /begin ANNOTATION ANNOTATION_LABEL "Instance" ANNOTATION_ORIGIN "Group" /begin ANNOTATION_TEXT "3" /end ANNOTATION_TEXT /end ANNOTATION
 /begin ANNOTATION ANNOTATION_LABEL "TaskCycleTime" ANNOTATION_ORIGIN "Group" /begin ANNOTATION_TEXT "0" /end ANNOTATION_TEXT /end ANNOTATION
 /begin ANNOTATION ANNOTATION_LABEL "TimeResolution" ANNOTATION_ORIGIN "Group" /begin ANNOTATION_TEXT "0" /end ANNOTATION_TEXT /end ANNOTATION
 /begin REF_MEASUREMENT OUT_ICAN.GW_18DAF117.MessageEnable.Task2 /end REF_MEASUREMENT
/end GROUP
/begin GROUP SYSTEM.I_CAN.GW_00000600 "GW_00000600"
 /begin ANNOTATION ANNOTATION_LABEL "Instance" ANNOTATION_ORIGIN "Group" /begin ANNOTATION_TEXT "0" /end ANNOTATION_TEXT /end ANNOTATION
 /begin ANNOTATION ANNOTATION_LABEL "TaskCycleTime" ANNOTATION_ORIGIN "Group" /begin ANNOTATION_TEXT "0" /end ANNOTATION_TEXT /end ANNOTATION
 /begin ANNOTATION ANNOTATION_LABEL "TimeResolution" ANNOTATION_ORIGIN "Group" /begin ANNOTATION_TEXT "0" /end ANNOTATION_TEXT /end ANNOTATION
 /begin REF_MEASUREMENT OUT_ICAN.GW_00000600.MessageEnable.Task2 /end REF_MEASUREMENT
/end GROUP
/begin GROUP SYSTEM.I_CAN "I-CAN"
 /begin ANNOTATION ANNOTATION_LABEL "Instance" ANNOTATION_ORIGIN "Group" /begin ANNOTATION_TEXT "0" /end ANNOTATION_TEXT /end ANNOTATION
 /begin ANNOTATION ANNOTATION_LABEL "TaskCycleTime" ANNOTATION_ORIGIN "Group" /begin ANNOTATION_TEXT "0" /end ANNOTATION_TEXT /end ANNOTATION
 /begin ANNOTATION ANNOTATION_LABEL "TimeResolution" ANNOTATION_ORIGIN "Group" /begin ANNOTATION_TEXT "0" /end ANNOTATION_TEXT /end ANNOTATION
 /begin SUB_GROUP SYSTEM.I_CAN.Ctrl50_ScrDA2 SYSTEM.I_CAN.Ctrl50_ScrDA1 SYSTEM.I_CAN.Ctrl50_FcnDA2 SYSTEM.I_CAN.Ctrl50_FcnDA1 SYSTEM.I_CAN.Ctrl50_SubView SYSTEM.I_CAN.ICHMI1CTRL SYSTEM.I_CAN.ICOM1CTRL SYSTEM.I_CAN.GW_00000FF4 SYSTEM.I_CAN.GW_18DAF017 SYSTEM.I_CAN.GW_18DAF117 SYSTEM.I_CAN.GW_00000600 /end SUB_GROUP
 /begin REF_MEASUREMENT OUT_ICAN.MessageForwardingEnable.Task2 /end REF_MEASUREMENT
/end GROUP
/begin GROUP SYSTEM.FMS_CAN.Out_HB_Ctrl "Out_HB_Ctrl"
 /begin ANNOTATION ANNOTATION_LABEL "Instance" ANNOTATION_ORIGIN "Group" /begin ANNOTATION_TEXT "1" /end ANNOTATION_TEXT /end ANNOTATION
 /begin ANNOTATION ANNOTATION_LABEL "TaskCycleTime" ANNOTATION_ORIGIN "Group" /begin ANNOTATION_TEXT "0" /end ANNOTATION_TEXT /end ANNOTATION
 /begin ANNOTATION ANNOTATION_LABEL "TimeResolution" ANNOTATION_ORIGIN "Group" /begin ANNOTATION_TEXT "0" /end ANNOTATION_TEXT /end ANNOTATION
 /begin REF_MEASUREMENT IN_FMSCAN.Rx_Ctrl.Out_HB_Ctrl.MessageState.Task4 IN_FMSCAN.Rx_Ctrl.Out_HB_Ctrl.Out_01_HB_Ctrl.Task4 IN_FMSCAN.Rx_Ctrl.Out_HB_Ctrl.Out_02_HB_Ctrl.Task4 IN_FMSCAN.Rx_Ctrl.Out_HB_Ctrl.Out_05_HB_Ctrl.Task4 IN_FMSCAN.Rx_Ctrl.Out_HB_Ctrl.Out_06_HB_Ctrl.Task4 IN_FMSCAN.Rx_Ctrl.Out_HB_Ctrl.Out_07_HB_Ctrl.Task4 IN_FMSCAN.Rx_Ctrl.Out_HB_Ctrl.Out_08_HB_Ctrl.Task4 IN_FMSCAN.Rx_Ctrl.Out_HB_Ctrl.Out_09_HB_Ctrl.Task4 IN_FMSCAN.Rx_Ctrl.Out_HB_Ctrl.Out_10_HB_Ctrl.Task4 OUT_FMSCAN.Rx_Ctrl.Out_HB_Ctrl.MessageEnable.Task4 /end REF_MEASUREMENT
/end GROUP
/begin GROUP SYSTEM.FMS_CAN.Out_Ctrl "Out_Ctrl"
 /begin ANNOTATION ANNOTATION_LABEL "Instance" ANNOTATION_ORIGIN "Group" /begin ANNOTATION_TEXT "2" /end ANNOTATION_TEXT /end ANNOTATION
 /begin ANNOTATION ANNOTATION_LABEL "TaskCycleTime" ANNOTATION_ORIGIN "Group" /begin ANNOTATION_TEXT "0" /end ANNOTATION_TEXT /end ANNOTATION
 /begin ANNOTATION ANNOTATION_LABEL "TimeResolution" ANNOTATION_ORIGIN "Group" /begin ANNOTATION_TEXT "0" /end ANNOTATION_TEXT /end ANNOTATION
 /begin REF_MEASUREMENT IN_FMSCAN.Rx_Ctrl.Out_Ctrl.MessageState.Task4 IN_FMSCAN.Rx_Ctrl.Out_Ctrl.Out_03_Ctrl.Task4 IN_FMSCAN.Rx_Ctrl.Out_Ctrl.Out_04_Ctrl.Task4 IN_FMSCAN.Rx_Ctrl.Out_Ctrl.Out_11_Ctrl.Task4 IN_FMSCAN.Rx_Ctrl.Out_Ctrl.Out_12_Ctrl.Task4 IN_FMSCAN.Rx_Ctrl.Out_Ctrl.Out_13_Ctrl.Task4 IN_FMSCAN.Rx_Ctrl.Out_Ctrl.Out_14_Ctrl.Task4 IN_FMSCAN.Rx_Ctrl.Out_Ctrl.Out_15_Ctrl.Task4 IN_FMSCAN.Rx_Ctrl.Out_Ctrl.Out_16_Ctrl.Task4 IN_FMSCAN.Rx_Ctrl.Out_Ctrl.Out_17_Ctrl.Task4 IN_FMSCAN.Rx_Ctrl.Out_Ctrl.Out_18_Ctrl.Task4 IN_FMSCAN.Rx_Ctrl.Out_Ctrl.Out_19_Ctrl.Task4 IN_FMSCAN.Rx_Ctrl.Out_Ctrl.Out_20_Ctrl.Task4 IN_FMSCAN.Rx_Ctrl.Out_Ctrl.Out_21_Ctrl.Task4 IN_FMSCAN.Rx_Ctrl.Out_Ctrl.Out_22_Ctrl.Task4 IN_FMSCAN.Rx_Ctrl.Out_Ctrl.Out_23_Ctrl.Task4 IN_FMSCAN.Rx_Ctrl.Out_Ctrl.Out_24_Ctrl.Task4 IN_FMSCAN.Rx_Ctrl.Out_Ctrl.Out_25_Ctrl.Task4 IN_FMSCAN.Rx_Ctrl.Out_Ctrl.Out_26_Ctrl.Task4 IN_FMSCAN.Rx_Ctrl.Out_Ctrl.Out_27_Ctrl.Task4 IN_FMSCAN.Rx_Ctrl.Out_Ctrl.Out_28_Ctrl.Task4 IN_FMSCAN.Rx_Ctrl.Out_Ctrl.Out_OLD_01_Ctrl.Task4 IN_FMSCAN.Rx_Ctrl.Out_Ctrl.Out_OLD_02_Ctrl.Task4 IN_FMSCAN.Rx_Ctrl.Out_Ctrl.Out_OLD_03_Ctrl.Task4 IN_FMSCAN.Rx_Ctrl.Out_Ctrl.Out_OLD_04_Ctrl.Task4 IN_FMSCAN.Rx_Ctrl.Out_Ctrl.Out_Supply_ANA_01_Ctrl.Task4 IN_FMSCAN.Rx_Ctrl.Out_Ctrl.WorkingMode.Task4 OUT_FMSCAN.Rx_Ctrl.Out_Ctrl.MessageEnable.Task4 /end REF_MEASUREMENT
/end GROUP
/begin GROUP SYSTEM.FMS_CAN.Out_Mirror_HB_Ctrl "Out_Mirror_HB_Ctrl"
 /begin ANNOTATION ANNOTATION_LABEL "Instance" ANNOTATION_ORIGIN "Group" /begin ANNOTATION_TEXT "0" /end ANNOTATION_TEXT /end ANNOTATION
 /begin ANNOTATION ANNOTATION_LABEL "TaskCycleTime" ANNOTATION_ORIGIN "Group" /begin ANNOTATION_TEXT "0" /end ANNOTATION_TEXT /end ANNOTATION
 /begin ANNOTATION ANNOTATION_LABEL "TimeResolution" ANNOTATION_ORIGIN "Group" /begin ANNOTATION_TEXT "0" /end ANNOTATION_TEXT /end ANNOTATION
 /begin REF_MEASUREMENT IN_FMSCAN.Rx_Ctrl.Out_Mirror_HB_Ctrl.MessageState.Task4 IN_FMSCAN.Rx_Ctrl.Out_Mirror_HB_Ctrl.Out_29_HB_Ctrl.Task4 IN_FMSCAN.Rx_Ctrl.Out_Mirror_HB_Ctrl.Out_30_HB_Ctrl.Task4 IN_FMSCAN.Rx_Ctrl.Out_Mirror_HB_Ctrl.Out_31_HB_Ctrl.Task4 IN_FMSCAN.Rx_Ctrl.Out_Mirror_HB_Ctrl.Out_32_HB_Ctrl.Task4 IN_FMSCAN.Rx_Ctrl.Out_Mirror_HB_Ctrl.Out_33_HB_Ctrl.Task4 IN_FMSCAN.Rx_Ctrl.Out_Mirror_HB_Ctrl.Out_34_HB_Ctrl.Task4 OUT_FMSCAN.Rx_Ctrl.Out_Mirror_HB_Ctrl.MessageEnable.Task4 /end REF_MEASUREMENT
/end GROUP
/begin GROUP SYSTEM.FMS_CAN.Out_12_TD_Sts "Out_12_TD_Sts"
 /begin ANNOTATION ANNOTATION_LABEL "Instance" ANNOTATION_ORIGIN "Group" /begin ANNOTATION_TEXT "1" /end ANNOTATION_TEXT /end ANNOTATION
 /begin ANNOTATION ANNOTATION_LABEL "TaskCycleTime" ANNOTATION_ORIGIN "Group" /begin ANNOTATION_TEXT "0" /end ANNOTATION_TEXT /end ANNOTATION
 /begin ANNOTATION ANNOTATION_LABEL "TimeResolution" ANNOTATION_ORIGIN "Group" /begin ANNOTATION_TEXT "0" /end ANNOTATION_TEXT /end ANNOTATION
 /begin REF_MEASUREMENT OUT_FMSCAN.Tx_Out.Out_12_TD_Sts.Out_SENSE_PULSE.Task4 OUT_FMSCAN.Tx_Out.Out_12_TD_Sts.Out_SENSE_PULSE_DIAG.Task4 OUT_FMSCAN.Tx_Out.Out_12_TD_Sts.MessageEnable.Task4 /end REF_MEASUREMENT
/end GROUP
/begin GROUP SYSTEM.FMS_CAN.In_Ana_12_Sts "In_Ana_12_Sts"
 /begin ANNOTATION ANNOTATION_LABEL "Instance" ANNOTATION_ORIGIN "Group" /begin ANNOTATION_TEXT "2" /end ANNOTATION_TEXT /end ANNOTATION
 /begin ANNOTATION ANNOTATION_LABEL "TaskCycleTime" ANNOTATION_ORIGIN "Group" /begin ANNOTATION_TEXT "0" /end ANNOTATION_TEXT /end ANNOTATION
 /begin ANNOTATION ANNOTATION_LABEL "TimeResolution" ANNOTATION_ORIGIN "Group" /begin ANNOTATION_TEXT "0" /end ANNOTATION_TEXT /end ANNOTATION
 /begin REF_MEASUREMENT OUT_FMSCAN.Tx_Ana.In_Ana_12_Sts.IN_ANA_Val.Task4 OUT_FMSCAN.Tx_Ana.In_Ana_12_Sts.IN_ANA_DIAG.Task4 OUT_FMSCAN.Tx_Ana.In_Ana_12_Sts.MessageEnable.Task4 /end REF_MEASUREMENT
/end GROUP
/begin GROUP SYSTEM.FMS_CAN.In_Ana_11_Sts "In_Ana_11_Sts"
 /begin ANNOTATION ANNOTATION_LABEL "Instance" ANNOTATION_ORIGIN "Group" /begin ANNOTATION_TEXT "3" /end ANNOTATION_TEXT /end ANNOTATION
 /begin ANNOTATION ANNOTATION_LABEL "TaskCycleTime" ANNOTATION_ORIGIN "Group" /begin ANNOTATION_TEXT "0" /end ANNOTATION_TEXT /end ANNOTATION
 /begin ANNOTATION ANNOTATION_LABEL "TimeResolution" ANNOTATION_ORIGIN "Group" /begin ANNOTATION_TEXT "0" /end ANNOTATION_TEXT /end ANNOTATION
 /begin REF_MEASUREMENT OUT_FMSCAN.Tx_Ana.In_Ana_11_Sts.IN_ANA_Val.Task4 OUT_FMSCAN.Tx_Ana.In_Ana_11_Sts.IN_ANA_DIAG.Task4 OUT_FMSCAN.Tx_Ana.In_Ana_11_Sts.MessageEnable.Task4 /end REF_MEASUREMENT
/end GROUP
/begin GROUP SYSTEM.FMS_CAN.In_Ana_09_Sts "In_Ana_09_Sts"
 /begin ANNOTATION ANNOTATION_LABEL "Instance" ANNOTATION_ORIGIN "Group" /begin ANNOTATION_TEXT "5" /end ANNOTATION_TEXT /end ANNOTATION
 /begin ANNOTATION ANNOTATION_LABEL "TaskCycleTime" ANNOTATION_ORIGIN "Group" /begin ANNOTATION_TEXT "0" /end ANNOTATION_TEXT /end ANNOTATION
 /begin ANNOTATION ANNOTATION_LABEL "TimeResolution" ANNOTATION_ORIGIN "Group" /begin ANNOTATION_TEXT "0" /end ANNOTATION_TEXT /end ANNOTATION
 /begin REF_MEASUREMENT OUT_FMSCAN.Tx_Ana.In_Ana_09_Sts.IN_ANA_Val.Task4 OUT_FMSCAN.Tx_Ana.In_Ana_09_Sts.IN_ANA_DIAG.Task4 OUT_FMSCAN.Tx_Ana.In_Ana_09_Sts.MessageEnable.Task4 /end REF_MEASUREMENT
/end GROUP
/begin GROUP SYSTEM.FMS_CAN.In_Ana_08_Sts "In_Ana_08_Sts"
 /begin ANNOTATION ANNOTATION_LABEL "Instance" ANNOTATION_ORIGIN "Group" /begin ANNOTATION_TEXT "6" /end ANNOTATION_TEXT /end ANNOTATION
 /begin ANNOTATION ANNOTATION_LABEL "TaskCycleTime" ANNOTATION_ORIGIN "Group" /begin ANNOTATION_TEXT "0" /end ANNOTATION_TEXT /end ANNOTATION
 /begin ANNOTATION ANNOTATION_LABEL "TimeResolution" ANNOTATION_ORIGIN "Group" /begin ANNOTATION_TEXT "0" /end ANNOTATION_TEXT /end ANNOTATION
 /begin REF_MEASUREMENT OUT_FMSCAN.Tx_Ana.In_Ana_08_Sts.IN_ANA_Val.Task4 OUT_FMSCAN.Tx_Ana.In_Ana_08_Sts.IN_ANA_DIAG.Task4 OUT_FMSCAN.Tx_Ana.In_Ana_08_Sts.MessageEnable.Task4 /end REF_MEASUREMENT
/end GROUP
/begin GROUP SYSTEM.FMS_CAN.In_Ana_07_Sts "In_Ana_07_Sts"
 /begin ANNOTATION ANNOTATION_LABEL "Instance" ANNOTATION_ORIGIN "Group" /begin ANNOTATION_TEXT "7" /end ANNOTATION_TEXT /end ANNOTATION
 /begin ANNOTATION ANNOTATION_LABEL "TaskCycleTime" ANNOTATION_ORIGIN "Group" /begin ANNOTATION_TEXT "0" /end ANNOTATION_TEXT /end ANNOTATION
 /begin ANNOTATION ANNOTATION_LABEL "TimeResolution" ANNOTATION_ORIGIN "Group" /begin ANNOTATION_TEXT "0" /end ANNOTATION_TEXT /end ANNOTATION
 /begin REF_MEASUREMENT OUT_FMSCAN.Tx_Ana.In_Ana_07_Sts.IN_ANA_Val.Task4 OUT_FMSCAN.Tx_Ana.In_Ana_07_Sts.IN_ANA_DIAG.Task4 OUT_FMSCAN.Tx_Ana.In_Ana_07_Sts.MessageEnable.Task4 /end REF_MEASUREMENT
/end GROUP
/begin GROUP SYSTEM.FMS_CAN.In_Ana_06_Sts "In_Ana_06_Sts"
 /begin ANNOTATION ANNOTATION_LABEL "Instance" ANNOTATION_ORIGIN "Group" /begin ANNOTATION_TEXT "8" /end ANNOTATION_TEXT /end ANNOTATION
 /begin ANNOTATION ANNOTATION_LABEL "TaskCycleTime" ANNOTATION_ORIGIN "Group" /begin ANNOTATION_TEXT "0" /end ANNOTATION_TEXT /end ANNOTATION
 /begin ANNOTATION ANNOTATION_LABEL "TimeResolution" ANNOTATION_ORIGIN "Group" /begin ANNOTATION_TEXT "0" /end ANNOTATION_TEXT /end ANNOTATION
 /begin REF_MEASUREMENT OUT_FMSCAN.Tx_Ana.In_Ana_06_Sts.IN_ANA_Val.Task4 OUT_FMSCAN.Tx_Ana.In_Ana_06_Sts.IN_ANA_DIAG.Task4 OUT_FMSCAN.Tx_Ana.In_Ana_06_Sts.MessageEnable.Task4 /end REF_MEASUREMENT
/end GROUP
/begin GROUP SYSTEM.FMS_CAN.In_Ana_05_Sts "In_Ana_05_Sts"
 /begin ANNOTATION ANNOTATION_LABEL "Instance" ANNOTATION_ORIGIN "Group" /begin ANNOTATION_TEXT "9" /end ANNOTATION_TEXT /end ANNOTATION
 /begin ANNOTATION ANNOTATION_LABEL "TaskCycleTime" ANNOTATION_ORIGIN "Group" /begin ANNOTATION_TEXT "0" /end ANNOTATION_TEXT /end ANNOTATION
 /begin ANNOTATION ANNOTATION_LABEL "TimeResolution" ANNOTATION_ORIGIN "Group" /begin ANNOTATION_TEXT "0" /end ANNOTATION_TEXT /end ANNOTATION
 /begin REF_MEASUREMENT OUT_FMSCAN.Tx_Ana.In_Ana_05_Sts.IN_ANA_Val.Task4 OUT_FMSCAN.Tx_Ana.In_Ana_05_Sts.IN_ANA_DIAG.Task4 OUT_FMSCAN.Tx_Ana.In_Ana_05_Sts.MessageEnable.Task4 /end REF_MEASUREMENT
/end GROUP
/begin GROUP SYSTEM.FMS_CAN.In_Ana_04_Sts "In_Ana_04_Sts"
 /begin ANNOTATION ANNOTATION_LABEL "Instance" ANNOTATION_ORIGIN "Group" /begin ANNOTATION_TEXT "10" /end ANNOTATION_TEXT /end ANNOTATION
 /begin ANNOTATION ANNOTATION_LABEL "TaskCycleTime" ANNOTATION_ORIGIN "Group" /begin ANNOTATION_TEXT "0" /end ANNOTATION_TEXT /end ANNOTATION
 /begin ANNOTATION ANNOTATION_LABEL "TimeResolution" ANNOTATION_ORIGIN "Group" /begin ANNOTATION_TEXT "0" /end ANNOTATION_TEXT /end ANNOTATION
 /begin REF_MEASUREMENT OUT_FMSCAN.Tx_Ana.In_Ana_04_Sts.IN_ANA_Val.Task4 OUT_FMSCAN.Tx_Ana.In_Ana_04_Sts.IN_ANA_DIAG.Task4 OUT_FMSCAN.Tx_Ana.In_Ana_04_Sts.MessageEnable.Task4 /end REF_MEASUREMENT
/end GROUP
/begin GROUP SYSTEM.FMS_CAN.In_Ana_03_Sts "In_Ana_03_Sts"
 /begin ANNOTATION ANNOTATION_LABEL "Instance" ANNOTATION_ORIGIN "Group" /begin ANNOTATION_TEXT "11" /end ANNOTATION_TEXT /end ANNOTATION
 /begin ANNOTATION ANNOTATION_LABEL "TaskCycleTime" ANNOTATION_ORIGIN "Group" /begin ANNOTATION_TEXT "0" /end ANNOTATION_TEXT /end ANNOTATION
 /begin ANNOTATION ANNOTATION_LABEL "TimeResolution" ANNOTATION_ORIGIN "Group" /begin ANNOTATION_TEXT "0" /end ANNOTATION_TEXT /end ANNOTATION
 /begin REF_MEASUREMENT OUT_FMSCAN.Tx_Ana.In_Ana_03_Sts.IN_ANA_Val.Task4 OUT_FMSCAN.Tx_Ana.In_Ana_03_Sts.IN_ANA_DIAG.Task4 OUT_FMSCAN.Tx_Ana.In_Ana_03_Sts.MessageEnable.Task4 /end REF_MEASUREMENT
/end GROUP
/begin GROUP SYSTEM.FMS_CAN.In_Ana_02_Sts "In_Ana_02_Sts"
 /begin ANNOTATION ANNOTATION_LABEL "Instance" ANNOTATION_ORIGIN "Group" /begin ANNOTATION_TEXT "12" /end ANNOTATION_TEXT /end ANNOTATION
 /begin ANNOTATION ANNOTATION_LABEL "TaskCycleTime" ANNOTATION_ORIGIN "Group" /begin ANNOTATION_TEXT "0" /end ANNOTATION_TEXT /end ANNOTATION
 /begin ANNOTATION ANNOTATION_LABEL "TimeResolution" ANNOTATION_ORIGIN "Group" /begin ANNOTATION_TEXT "0" /end ANNOTATION_TEXT /end ANNOTATION
 /begin REF_MEASUREMENT OUT_FMSCAN.Tx_Ana.In_Ana_02_Sts.IN_ANA_Val.Task4 OUT_FMSCAN.Tx_Ana.In_Ana_02_Sts.IN_ANA_DIAG.Task4 OUT_FMSCAN.Tx_Ana.In_Ana_02_Sts.MessageEnable.Task4 /end REF_MEASUREMENT
/end GROUP
/begin GROUP SYSTEM.FMS_CAN.In_Ana_01_Sts "In_Ana_01_Sts"
 /begin ANNOTATION ANNOTATION_LABEL "Instance" ANNOTATION_ORIGIN "Group" /begin ANNOTATION_TEXT "13" /end ANNOTATION_TEXT /end ANNOTATION
 /begin ANNOTATION ANNOTATION_LABEL "TaskCycleTime" ANNOTATION_ORIGIN "Group" /begin ANNOTATION_TEXT "0" /end ANNOTATION_TEXT /end ANNOTATION
 /begin ANNOTATION ANNOTATION_LABEL "TimeResolution" ANNOTATION_ORIGIN "Group" /begin ANNOTATION_TEXT "0" /end ANNOTATION_TEXT /end ANNOTATION
 /begin REF_MEASUREMENT OUT_FMSCAN.Tx_Ana.In_Ana_01_Sts.IN_ANA_Val.Task4 OUT_FMSCAN.Tx_Ana.In_Ana_01_Sts.IN_ANA_DIAG.Task4 OUT_FMSCAN.Tx_Ana.In_Ana_01_Sts.MessageEnable.Task4 /end REF_MEASUREMENT
/end GROUP
/begin GROUP SYSTEM.FMS_CAN.In_Freq_01_Sts "In_Freq_01_Sts"
 /begin ANNOTATION ANNOTATION_LABEL "Instance" ANNOTATION_ORIGIN "Group" /begin ANNOTATION_TEXT "14" /end ANNOTATION_TEXT /end ANNOTATION
 /begin ANNOTATION ANNOTATION_LABEL "TaskCycleTime" ANNOTATION_ORIGIN "Group" /begin ANNOTATION_TEXT "0" /end ANNOTATION_TEXT /end ANNOTATION
 /begin ANNOTATION ANNOTATION_LABEL "TimeResolution" ANNOTATION_ORIGIN "Group" /begin ANNOTATION_TEXT "0" /end ANNOTATION_TEXT /end ANNOTATION
 /begin REF_MEASUREMENT OUT_FMSCAN.Tx_Freq.In_Freq_01_Sts.Value.Task4 OUT_FMSCAN.Tx_Freq.In_Freq_01_Sts.MessageEnable.Task4 /end REF_MEASUREMENT
/end GROUP
/begin GROUP SYSTEM.FMS_CAN.BSG_Expansion_Sts "BSG_Expansion_Sts"
 /begin ANNOTATION ANNOTATION_LABEL "Instance" ANNOTATION_ORIGIN "Group" /begin ANNOTATION_TEXT "15" /end ANNOTATION_TEXT /end ANNOTATION
 /begin ANNOTATION ANNOTATION_LABEL "TaskCycleTime" ANNOTATION_ORIGIN "Group" /begin ANNOTATION_TEXT "0" /end ANNOTATION_TEXT /end ANNOTATION
 /begin ANNOTATION ANNOTATION_LABEL "TimeResolution" ANNOTATION_ORIGIN "Group" /begin ANNOTATION_TEXT "0" /end ANNOTATION_TEXT /end ANNOTATION
 /begin REF_MEASUREMENT OUT_FMSCAN.Tx_Exp.BSG_Expansion_Sts.BatteryVoltage.Task4 OUT_FMSCAN.Tx_Exp.BSG_Expansion_Sts.MessageEnable.Task4 /end REF_MEASUREMENT
/end GROUP
/begin GROUP SYSTEM.FMS_CAN.PWR_G5_Sts "PWR_G5_Sts"
 /begin ANNOTATION ANNOTATION_LABEL "Instance" ANNOTATION_ORIGIN "Group" /begin ANNOTATION_TEXT "16" /end ANNOTATION_TEXT /end ANNOTATION
 /begin ANNOTATION ANNOTATION_LABEL "TaskCycleTime" ANNOTATION_ORIGIN "Group" /begin ANNOTATION_TEXT "0" /end ANNOTATION_TEXT /end ANNOTATION
 /begin ANNOTATION ANNOTATION_LABEL "TimeResolution" ANNOTATION_ORIGIN "Group" /begin ANNOTATION_TEXT "0" /end ANNOTATION_TEXT /end ANNOTATION
 /begin REF_MEASUREMENT OUT_FMSCAN.Tx_Pwr.PWR_G5_Sts.PWR_Gx_DIAG.Task4 OUT_FMSCAN.Tx_Pwr.PWR_G5_Sts.PWR_Gx_Val.Task4 OUT_FMSCAN.Tx_Pwr.PWR_G5_Sts.MessageEnable.Task4 /end REF_MEASUREMENT
/end GROUP
/begin GROUP SYSTEM.FMS_CAN.PWR_G4_Sts "PWR_G4_Sts"
 /begin ANNOTATION ANNOTATION_LABEL "Instance" ANNOTATION_ORIGIN "Group" /begin ANNOTATION_TEXT "17" /end ANNOTATION_TEXT /end ANNOTATION
 /begin ANNOTATION ANNOTATION_LABEL "TaskCycleTime" ANNOTATION_ORIGIN "Group" /begin ANNOTATION_TEXT "0" /end ANNOTATION_TEXT /end ANNOTATION
 /begin ANNOTATION ANNOTATION_LABEL "TimeResolution" ANNOTATION_ORIGIN "Group" /begin ANNOTATION_TEXT "0" /end ANNOTATION_TEXT /end ANNOTATION
 /begin REF_MEASUREMENT OUT_FMSCAN.Tx_Pwr.PWR_G4_Sts.PWR_Gx_DIAG.Task4 OUT_FMSCAN.Tx_Pwr.PWR_G4_Sts.PWR_Gx_Val.Task4 OUT_FMSCAN.Tx_Pwr.PWR_G4_Sts.MessageEnable.Task4 /end REF_MEASUREMENT
/end GROUP
/begin GROUP SYSTEM.FMS_CAN.PWR_G3_Sts "PWR_G3_Sts"
 /begin ANNOTATION ANNOTATION_LABEL "Instance" ANNOTATION_ORIGIN "Group" /begin ANNOTATION_TEXT "18" /end ANNOTATION_TEXT /end ANNOTATION
 /begin ANNOTATION ANNOTATION_LABEL "TaskCycleTime" ANNOTATION_ORIGIN "Group" /begin ANNOTATION_TEXT "0" /end ANNOTATION_TEXT /end ANNOTATION
 /begin ANNOTATION ANNOTATION_LABEL "TimeResolution" ANNOTATION_ORIGIN "Group" /begin ANNOTATION_TEXT "0" /end ANNOTATION_TEXT /end ANNOTATION
 /begin REF_MEASUREMENT OUT_FMSCAN.Tx_Pwr.PWR_G3_Sts.PWR_Gx_DIAG.Task4 OUT_FMSCAN.Tx_Pwr.PWR_G3_Sts.PWR_Gx_Val.Task4 OUT_FMSCAN.Tx_Pwr.PWR_G3_Sts.MessageEnable.Task4 /end REF_MEASUREMENT
/end GROUP
/begin GROUP SYSTEM.FMS_CAN.PWR_G2_Sts "PWR_G2_Sts"
 /begin ANNOTATION ANNOTATION_LABEL "Instance" ANNOTATION_ORIGIN "Group" /begin ANNOTATION_TEXT "19" /end ANNOTATION_TEXT /end ANNOTATION
 /begin ANNOTATION ANNOTATION_LABEL "TaskCycleTime" ANNOTATION_ORIGIN "Group" /begin ANNOTATION_TEXT "0" /end ANNOTATION_TEXT /end ANNOTATION
 /begin ANNOTATION ANNOTATION_LABEL "TimeResolution" ANNOTATION_ORIGIN "Group" /begin ANNOTATION_TEXT "0" /end ANNOTATION_TEXT /end ANNOTATION
 /begin REF_MEASUREMENT OUT_FMSCAN.Tx_Pwr.PWR_G2_Sts.PWR_Gx_DIAG.Task4 OUT_FMSCAN.Tx_Pwr.PWR_G2_Sts.PWR_Gx_Val.Task4 OUT_FMSCAN.Tx_Pwr.PWR_G2_Sts.MessageEnable.Task4 /end REF_MEASUREMENT
/end GROUP
/begin GROUP SYSTEM.FMS_CAN.PWR_G1_Sts "PWR_G1_Sts"
 /begin ANNOTATION ANNOTATION_LABEL "Instance" ANNOTATION_ORIGIN "Group" /begin ANNOTATION_TEXT "20" /end ANNOTATION_TEXT /end ANNOTATION
 /begin ANNOTATION ANNOTATION_LABEL "TaskCycleTime" ANNOTATION_ORIGIN "Group" /begin ANNOTATION_TEXT "0" /end ANNOTATION_TEXT /end ANNOTATION
 /begin ANNOTATION ANNOTATION_LABEL "TimeResolution" ANNOTATION_ORIGIN "Group" /begin ANNOTATION_TEXT "0" /end ANNOTATION_TEXT /end ANNOTATION
 /begin REF_MEASUREMENT OUT_FMSCAN.Tx_Pwr.PWR_G1_Sts.PWR_Gx_DIAG.Task4 OUT_FMSCAN.Tx_Pwr.PWR_G1_Sts.PWR_Gx_Val.Task4 OUT_FMSCAN.Tx_Pwr.PWR_G1_Sts.MessageEnable.Task4 /end REF_MEASUREMENT
/end GROUP
/begin GROUP SYSTEM.FMS_CAN.PWR_Sts "PWR_Sts"
 /begin ANNOTATION ANNOTATION_LABEL "Instance" ANNOTATION_ORIGIN "Group" /begin ANNOTATION_TEXT "21" /end ANNOTATION_TEXT /end ANNOTATION
 /begin ANNOTATION ANNOTATION_LABEL "TaskCycleTime" ANNOTATION_ORIGIN "Group" /begin ANNOTATION_TEXT "0" /end ANNOTATION_TEXT /end ANNOTATION
 /begin ANNOTATION ANNOTATION_LABEL "TimeResolution" ANNOTATION_ORIGIN "Group" /begin ANNOTATION_TEXT "0" /end ANNOTATION_TEXT /end ANNOTATION
 /begin REF_MEASUREMENT OUT_FMSCAN.Tx_Pwr.PWR_Sts.PWR_Val.Task4 OUT_FMSCAN.Tx_Pwr.PWR_Sts.PWR_DIAG.Task4 OUT_FMSCAN.Tx_Pwr.PWR_Sts.MessageEnable.Task4 /end REF_MEASUREMENT
/end GROUP
/begin GROUP SYSTEM.FMS_CAN.In_Dig_22_Sts "In_Dig_22_Sts"
 /begin ANNOTATION ANNOTATION_LABEL "Instance" ANNOTATION_ORIGIN "Group" /begin ANNOTATION_TEXT "22" /end ANNOTATION_TEXT /end ANNOTATION
 /begin ANNOTATION ANNOTATION_LABEL "TaskCycleTime" ANNOTATION_ORIGIN "Group" /begin ANNOTATION_TEXT "0" /end ANNOTATION_TEXT /end ANNOTATION
 /begin ANNOTATION ANNOTATION_LABEL "TimeResolution" ANNOTATION_ORIGIN "Group" /begin ANNOTATION_TEXT "0" /end ANNOTATION_TEXT /end ANNOTATION
 /begin REF_MEASUREMENT OUT_FMSCAN.Tx_Dig.In_Dig_22_Sts.IN_DIG_DIAG.Task4 OUT_FMSCAN.Tx_Dig.In_Dig_22_Sts.IN_DIG_Val.Task4 OUT_FMSCAN.Tx_Dig.In_Dig_22_Sts.MessageEnable.Task4 /end REF_MEASUREMENT
/end GROUP
/begin GROUP SYSTEM.FMS_CAN.In_Dig_21_Sts "In_Dig_21_Sts"
 /begin ANNOTATION ANNOTATION_LABEL "Instance" ANNOTATION_ORIGIN "Group" /begin ANNOTATION_TEXT "23" /end ANNOTATION_TEXT /end ANNOTATION
 /begin ANNOTATION ANNOTATION_LABEL "TaskCycleTime" ANNOTATION_ORIGIN "Group" /begin ANNOTATION_TEXT "0" /end ANNOTATION_TEXT /end ANNOTATION
 /begin ANNOTATION ANNOTATION_LABEL "TimeResolution" ANNOTATION_ORIGIN "Group" /begin ANNOTATION_TEXT "0" /end ANNOTATION_TEXT /end ANNOTATION
 /begin REF_MEASUREMENT OUT_FMSCAN.Tx_Dig.In_Dig_21_Sts.IN_DIG_DIAG.Task4 OUT_FMSCAN.Tx_Dig.In_Dig_21_Sts.IN_DIG_Val.Task4 OUT_FMSCAN.Tx_Dig.In_Dig_21_Sts.MessageEnable.Task4 /end REF_MEASUREMENT
/end GROUP
/begin GROUP SYSTEM.FMS_CAN.In_Dig_20_Sts "In_Dig_20_Sts"
 /begin ANNOTATION ANNOTATION_LABEL "Instance" ANNOTATION_ORIGIN "Group" /begin ANNOTATION_TEXT "24" /end ANNOTATION_TEXT /end ANNOTATION
 /begin ANNOTATION ANNOTATION_LABEL "TaskCycleTime" ANNOTATION_ORIGIN "Group" /begin ANNOTATION_TEXT "0" /end ANNOTATION_TEXT /end ANNOTATION
 /begin ANNOTATION ANNOTATION_LABEL "TimeResolution" ANNOTATION_ORIGIN "Group" /begin ANNOTATION_TEXT "0" /end ANNOTATION_TEXT /end ANNOTATION
 /begin REF_MEASUREMENT OUT_FMSCAN.Tx_Dig.In_Dig_20_Sts.IN_DIG_DIAG.Task4 OUT_FMSCAN.Tx_Dig.In_Dig_20_Sts.IN_DIG_Val.Task4 OUT_FMSCAN.Tx_Dig.In_Dig_20_Sts.MessageEnable.Task4 /end REF_MEASUREMENT
/end GROUP
/begin GROUP SYSTEM.FMS_CAN.In_Dig_19_Sts "In_Dig_19_Sts"
 /begin ANNOTATION ANNOTATION_LABEL "Instance" ANNOTATION_ORIGIN "Group" /begin ANNOTATION_TEXT "25" /end ANNOTATION_TEXT /end ANNOTATION
 /begin ANNOTATION ANNOTATION_LABEL "TaskCycleTime" ANNOTATION_ORIGIN "Group" /begin ANNOTATION_TEXT "0" /end ANNOTATION_TEXT /end ANNOTATION
 /begin ANNOTATION ANNOTATION_LABEL "TimeResolution" ANNOTATION_ORIGIN "Group" /begin ANNOTATION_TEXT "0" /end ANNOTATION_TEXT /end ANNOTATION
 /begin REF_MEASUREMENT OUT_FMSCAN.Tx_Dig.In_Dig_19_Sts.IN_DIG_DIAG.Task4 OUT_FMSCAN.Tx_Dig.In_Dig_19_Sts.IN_DIG_Val.Task4 OUT_FMSCAN.Tx_Dig.In_Dig_19_Sts.MessageEnable.Task4 /end REF_MEASUREMENT
/end GROUP
/begin GROUP SYSTEM.FMS_CAN.In_Dig_18_Sts "In_Dig_18_Sts"
 /begin ANNOTATION ANNOTATION_LABEL "Instance" ANNOTATION_ORIGIN "Group" /begin ANNOTATION_TEXT "26" /end ANNOTATION_TEXT /end ANNOTATION
 /begin ANNOTATION ANNOTATION_LABEL "TaskCycleTime" ANNOTATION_ORIGIN "Group" /begin ANNOTATION_TEXT "0" /end ANNOTATION_TEXT /end ANNOTATION
 /begin ANNOTATION ANNOTATION_LABEL "TimeResolution" ANNOTATION_ORIGIN "Group" /begin ANNOTATION_TEXT "0" /end ANNOTATION_TEXT /end ANNOTATION
 /begin REF_MEASUREMENT OUT_FMSCAN.Tx_Dig.In_Dig_18_Sts.IN_DIG_DIAG.Task4 OUT_FMSCAN.Tx_Dig.In_Dig_18_Sts.IN_DIG_Val.Task4 OUT_FMSCAN.Tx_Dig.In_Dig_18_Sts.MessageEnable.Task4 /end REF_MEASUREMENT
/end GROUP
/begin GROUP SYSTEM.FMS_CAN.In_Dig_17_Sts "In_Dig_17_Sts"
 /begin ANNOTATION ANNOTATION_LABEL "Instance" ANNOTATION_ORIGIN "Group" /begin ANNOTATION_TEXT "27" /end ANNOTATION_TEXT /end ANNOTATION
 /begin ANNOTATION ANNOTATION_LABEL "TaskCycleTime" ANNOTATION_ORIGIN "Group" /begin ANNOTATION_TEXT "0" /end ANNOTATION_TEXT /end ANNOTATION
 /begin ANNOTATION ANNOTATION_LABEL "TimeResolution" ANNOTATION_ORIGIN "Group" /begin ANNOTATION_TEXT "0" /end ANNOTATION_TEXT /end ANNOTATION
 /begin REF_MEASUREMENT OUT_FMSCAN.Tx_Dig.In_Dig_17_Sts.IN_DIG_DIAG.Task4 OUT_FMSCAN.Tx_Dig.In_Dig_17_Sts.IN_DIG_Val.Task4 OUT_FMSCAN.Tx_Dig.In_Dig_17_Sts.MessageEnable.Task4 /end REF_MEASUREMENT
/end GROUP
/begin GROUP SYSTEM.FMS_CAN.In_Dig_16_Sts "In_Dig_16_Sts"
 /begin ANNOTATION ANNOTATION_LABEL "Instance" ANNOTATION_ORIGIN "Group" /begin ANNOTATION_TEXT "28" /end ANNOTATION_TEXT /end ANNOTATION
 /begin ANNOTATION ANNOTATION_LABEL "TaskCycleTime" ANNOTATION_ORIGIN "Group" /begin ANNOTATION_TEXT "0" /end ANNOTATION_TEXT /end ANNOTATION
 /begin ANNOTATION ANNOTATION_LABEL "TimeResolution" ANNOTATION_ORIGIN "Group" /begin ANNOTATION_TEXT "0" /end ANNOTATION_TEXT /end ANNOTATION
 /begin REF_MEASUREMENT OUT_FMSCAN.Tx_Dig.In_Dig_16_Sts.IN_DIG_DIAG.Task4 OUT_FMSCAN.Tx_Dig.In_Dig_16_Sts.IN_DIG_Val.Task4 OUT_FMSCAN.Tx_Dig.In_Dig_16_Sts.MessageEnable.Task4 /end REF_MEASUREMENT
/end GROUP
/begin GROUP SYSTEM.FMS_CAN.In_Dig_15_Sts "In_Dig_15_Sts"
 /begin ANNOTATION ANNOTATION_LABEL "Instance" ANNOTATION_ORIGIN "Group" /begin ANNOTATION_TEXT "29" /end ANNOTATION_TEXT /end ANNOTATION
 /begin ANNOTATION ANNOTATION_LABEL "TaskCycleTime" ANNOTATION_ORIGIN "Group" /begin ANNOTATION_TEXT "0" /end ANNOTATION_TEXT /end ANNOTATION
 /begin ANNOTATION ANNOTATION_LABEL "TimeResolution" ANNOTATION_ORIGIN "Group" /begin ANNOTATION_TEXT "0" /end ANNOTATION_TEXT /end ANNOTATION
 /begin REF_MEASUREMENT OUT_FMSCAN.Tx_Dig.In_Dig_15_Sts.IN_DIG_DIAG.Task4 OUT_FMSCAN.Tx_Dig.In_Dig_15_Sts.IN_DIG_Val.Task4 OUT_FMSCAN.Tx_Dig.In_Dig_15_Sts.MessageEnable.Task4 /end REF_MEASUREMENT
/end GROUP
/begin GROUP SYSTEM.FMS_CAN.In_Dig_14_Sts "In_Dig_14_Sts"
 /begin ANNOTATION ANNOTATION_LABEL "Instance" ANNOTATION_ORIGIN "Group" /begin ANNOTATION_TEXT "30" /end ANNOTATION_TEXT /end ANNOTATION
 /begin ANNOTATION ANNOTATION_LABEL "TaskCycleTime" ANNOTATION_ORIGIN "Group" /begin ANNOTATION_TEXT "0" /end ANNOTATION_TEXT /end ANNOTATION
 /begin ANNOTATION ANNOTATION_LABEL "TimeResolution" ANNOTATION_ORIGIN "Group" /begin ANNOTATION_TEXT "0" /end ANNOTATION_TEXT /end ANNOTATION
 /begin REF_MEASUREMENT OUT_FMSCAN.Tx_Dig.In_Dig_14_Sts.IN_DIG_DIAG.Task4 OUT_FMSCAN.Tx_Dig.In_Dig_14_Sts.IN_DIG_Val.Task4 OUT_FMSCAN.Tx_Dig.In_Dig_14_Sts.MessageEnable.Task4 /end REF_MEASUREMENT
/end GROUP
/begin GROUP SYSTEM.FMS_CAN.In_Dig_13_Sts "In_Dig_13_Sts"
 /begin ANNOTATION ANNOTATION_LABEL "Instance" ANNOTATION_ORIGIN "Group" /begin ANNOTATION_TEXT "31" /end ANNOTATION_TEXT /end ANNOTATION
 /begin ANNOTATION ANNOTATION_LABEL "TaskCycleTime" ANNOTATION_ORIGIN "Group" /begin ANNOTATION_TEXT "0" /end ANNOTATION_TEXT /end ANNOTATION
 /begin ANNOTATION ANNOTATION_LABEL "TimeResolution" ANNOTATION_ORIGIN "Group" /begin ANNOTATION_TEXT "0" /end ANNOTATION_TEXT /end ANNOTATION
 /begin REF_MEASUREMENT OUT_FMSCAN.Tx_Dig.In_Dig_13_Sts.IN_DIG_DIAG.Task4 OUT_FMSCAN.Tx_Dig.In_Dig_13_Sts.IN_DIG_Val.Task4 OUT_FMSCAN.Tx_Dig.In_Dig_13_Sts.MessageEnable.Task4 /end REF_MEASUREMENT
/end GROUP
/begin GROUP SYSTEM.FMS_CAN.In_Dig_12_Sts "In_Dig_12_Sts"
 /begin ANNOTATION ANNOTATION_LABEL "Instance" ANNOTATION_ORIGIN "Group" /begin ANNOTATION_TEXT "32" /end ANNOTATION_TEXT /end ANNOTATION
 /begin ANNOTATION ANNOTATION_LABEL "TaskCycleTime" ANNOTATION_ORIGIN "Group" /begin ANNOTATION_TEXT "0" /end ANNOTATION_TEXT /end ANNOTATION
 /begin ANNOTATION ANNOTATION_LABEL "TimeResolution" ANNOTATION_ORIGIN "Group" /begin ANNOTATION_TEXT "0" /end ANNOTATION_TEXT /end ANNOTATION
 /begin REF_MEASUREMENT OUT_FMSCAN.Tx_Dig.In_Dig_12_Sts.IN_DIG_DIAG.Task4 OUT_FMSCAN.Tx_Dig.In_Dig_12_Sts.IN_DIG_Val.Task4 OUT_FMSCAN.Tx_Dig.In_Dig_12_Sts.MessageEnable.Task4 /end REF_MEASUREMENT
/end GROUP
/begin GROUP SYSTEM.FMS_CAN.In_Dig_11_Sts "In_Dig_11_Sts"
 /begin ANNOTATION ANNOTATION_LABEL "Instance" ANNOTATION_ORIGIN "Group" /begin ANNOTATION_TEXT "33" /end ANNOTATION_TEXT /end ANNOTATION
 /begin ANNOTATION ANNOTATION_LABEL "TaskCycleTime" ANNOTATION_ORIGIN "Group" /begin ANNOTATION_TEXT "0" /end ANNOTATION_TEXT /end ANNOTATION
 /begin ANNOTATION ANNOTATION_LABEL "TimeResolution" ANNOTATION_ORIGIN "Group" /begin ANNOTATION_TEXT "0" /end ANNOTATION_TEXT /end ANNOTATION
 /begin REF_MEASUREMENT OUT_FMSCAN.Tx_Dig.In_Dig_11_Sts.IN_DIG_DIAG.Task4 OUT_FMSCAN.Tx_Dig.In_Dig_11_Sts.IN_DIG_Val.Task4 OUT_FMSCAN.Tx_Dig.In_Dig_11_Sts.MessageEnable.Task4 /end REF_MEASUREMENT
/end GROUP
/begin GROUP SYSTEM.FMS_CAN.In_Dig_10_Sts "In_Dig_10_Sts"
 /begin ANNOTATION ANNOTATION_LABEL "Instance" ANNOTATION_ORIGIN "Group" /begin ANNOTATION_TEXT "34" /end ANNOTATION_TEXT /end ANNOTATION
 /begin ANNOTATION ANNOTATION_LABEL "TaskCycleTime" ANNOTATION_ORIGIN "Group" /begin ANNOTATION_TEXT "0" /end ANNOTATION_TEXT /end ANNOTATION
 /begin ANNOTATION ANNOTATION_LABEL "TimeResolution" ANNOTATION_ORIGIN "Group" /begin ANNOTATION_TEXT "0" /end ANNOTATION_TEXT /end ANNOTATION
 /begin REF_MEASUREMENT OUT_FMSCAN.Tx_Dig.In_Dig_10_Sts.IN_DIG_DIAG.Task4 OUT_FMSCAN.Tx_Dig.In_Dig_10_Sts.IN_DIG_Val.Task4 OUT_FMSCAN.Tx_Dig.In_Dig_10_Sts.MessageEnable.Task4 /end REF_MEASUREMENT
/end GROUP
/begin GROUP SYSTEM.FMS_CAN.In_Dig_09_Sts "In_Dig_09_Sts"
 /begin ANNOTATION ANNOTATION_LABEL "Instance" ANNOTATION_ORIGIN "Group" /begin ANNOTATION_TEXT "35" /end ANNOTATION_TEXT /end ANNOTATION
 /begin ANNOTATION ANNOTATION_LABEL "TaskCycleTime" ANNOTATION_ORIGIN "Group" /begin ANNOTATION_TEXT "0" /end ANNOTATION_TEXT /end ANNOTATION
 /begin ANNOTATION ANNOTATION_LABEL "TimeResolution" ANNOTATION_ORIGIN "Group" /begin ANNOTATION_TEXT "0" /end ANNOTATION_TEXT /end ANNOTATION
 /begin REF_MEASUREMENT OUT_FMSCAN.Tx_Dig.In_Dig_09_Sts.IN_DIG_DIAG.Task4 OUT_FMSCAN.Tx_Dig.In_Dig_09_Sts.IN_DIG_Val.Task4 OUT_FMSCAN.Tx_Dig.In_Dig_09_Sts.MessageEnable.Task4 /end REF_MEASUREMENT
/end GROUP
/begin GROUP SYSTEM.FMS_CAN.In_Dig_08_Sts "In_Dig_08_Sts"
 /begin ANNOTATION ANNOTATION_LABEL "Instance" ANNOTATION_ORIGIN "Group" /begin ANNOTATION_TEXT "36" /end ANNOTATION_TEXT /end ANNOTATION
 /begin ANNOTATION ANNOTATION_LABEL "TaskCycleTime" ANNOTATION_ORIGIN "Group" /begin ANNOTATION_TEXT "0" /end ANNOTATION_TEXT /end ANNOTATION
 /begin ANNOTATION ANNOTATION_LABEL "TimeResolution" ANNOTATION_ORIGIN "Group" /begin ANNOTATION_TEXT "0" /end ANNOTATION_TEXT /end ANNOTATION
 /begin REF_MEASUREMENT OUT_FMSCAN.Tx_Dig.In_Dig_08_Sts.IN_DIG_DIAG.Task4 OUT_FMSCAN.Tx_Dig.In_Dig_08_Sts.IN_DIG_Val.Task4 OUT_FMSCAN.Tx_Dig.In_Dig_08_Sts.MessageEnable.Task4 /end REF_MEASUREMENT
/end GROUP
/begin GROUP SYSTEM.FMS_CAN.In_Dig_07_Sts "In_Dig_07_Sts"
 /begin ANNOTATION ANNOTATION_LABEL "Instance" ANNOTATION_ORIGIN "Group" /begin ANNOTATION_TEXT "37" /end ANNOTATION_TEXT /end ANNOTATION
 /begin ANNOTATION ANNOTATION_LABEL "TaskCycleTime" ANNOTATION_ORIGIN "Group" /begin ANNOTATION_TEXT "0" /end ANNOTATION_TEXT /end ANNOTATION
 /begin ANNOTATION ANNOTATION_LABEL "TimeResolution" ANNOTATION_ORIGIN "Group" /begin ANNOTATION_TEXT "0" /end ANNOTATION_TEXT /end ANNOTATION
 /begin REF_MEASUREMENT OUT_FMSCAN.Tx_Dig.In_Dig_07_Sts.IN_DIG_DIAG.Task4 OUT_FMSCAN.Tx_Dig.In_Dig_07_Sts.IN_DIG_Val.Task4 OUT_FMSCAN.Tx_Dig.In_Dig_07_Sts.MessageEnable.Task4 /end REF_MEASUREMENT
/end GROUP
/begin GROUP SYSTEM.FMS_CAN.In_Dig_06_Sts "In_Dig_06_Sts"
 /begin ANNOTATION ANNOTATION_LABEL "Instance" ANNOTATION_ORIGIN "Group" /begin ANNOTATION_TEXT "38" /end ANNOTATION_TEXT /end ANNOTATION
 /begin ANNOTATION ANNOTATION_LABEL "TaskCycleTime" ANNOTATION_ORIGIN "Group" /begin ANNOTATION_TEXT "0" /end ANNOTATION_TEXT /end ANNOTATION
 /begin ANNOTATION ANNOTATION_LABEL "TimeResolution" ANNOTATION_ORIGIN "Group" /begin ANNOTATION_TEXT "0" /end ANNOTATION_TEXT /end ANNOTATION
 /begin REF_MEASUREMENT OUT_FMSCAN.Tx_Dig.In_Dig_06_Sts.IN_DIG_DIAG.Task4 OUT_FMSCAN.Tx_Dig.In_Dig_06_Sts.IN_DIG_Val.Task4 OUT_FMSCAN.Tx_Dig.In_Dig_06_Sts.MessageEnable.Task4 /end REF_MEASUREMENT
/end GROUP
/begin GROUP SYSTEM.FMS_CAN.In_Dig_05_Sts "In_Dig_05_Sts"
 /begin ANNOTATION ANNOTATION_LABEL "Instance" ANNOTATION_ORIGIN "Group" /begin ANNOTATION_TEXT "39" /end ANNOTATION_TEXT /end ANNOTATION
 /begin ANNOTATION ANNOTATION_LABEL "TaskCycleTime" ANNOTATION_ORIGIN "Group" /begin ANNOTATION_TEXT "0" /end ANNOTATION_TEXT /end ANNOTATION
 /begin ANNOTATION ANNOTATION_LABEL "TimeResolution" ANNOTATION_ORIGIN "Group" /begin ANNOTATION_TEXT "0" /end ANNOTATION_TEXT /end ANNOTATION
 /begin REF_MEASUREMENT OUT_FMSCAN.Tx_Dig.In_Dig_05_Sts.IN_DIG_DIAG.Task4 OUT_FMSCAN.Tx_Dig.In_Dig_05_Sts.IN_DIG_Val.Task4 OUT_FMSCAN.Tx_Dig.In_Dig_05_Sts.MessageEnable.Task4 /end REF_MEASUREMENT
/end GROUP
/begin GROUP SYSTEM.FMS_CAN.In_Dig_04_Sts "In_Dig_04_Sts"
 /begin ANNOTATION ANNOTATION_LABEL "Instance" ANNOTATION_ORIGIN "Group" /begin ANNOTATION_TEXT "40" /end ANNOTATION_TEXT /end ANNOTATION
 /begin ANNOTATION ANNOTATION_LABEL "TaskCycleTime" ANNOTATION_ORIGIN "Group" /begin ANNOTATION_TEXT "0" /end ANNOTATION_TEXT /end ANNOTATION
 /begin ANNOTATION ANNOTATION_LABEL "TimeResolution" ANNOTATION_ORIGIN "Group" /begin ANNOTATION_TEXT "0" /end ANNOTATION_TEXT /end ANNOTATION
 /begin REF_MEASUREMENT OUT_FMSCAN.Tx_Dig.In_Dig_04_Sts.IN_DIG_DIAG.Task4 OUT_FMSCAN.Tx_Dig.In_Dig_04_Sts.IN_DIG_Val.Task4 OUT_FMSCAN.Tx_Dig.In_Dig_04_Sts.MessageEnable.Task4 /end REF_MEASUREMENT
/end GROUP
/begin GROUP SYSTEM.FMS_CAN.In_Dig_03_Sts "In_Dig_03_Sts"
 /begin ANNOTATION ANNOTATION_LABEL "Instance" ANNOTATION_ORIGIN "Group" /begin ANNOTATION_TEXT "41" /end ANNOTATION_TEXT /end ANNOTATION
 /begin ANNOTATION ANNOTATION_LABEL "TaskCycleTime" ANNOTATION_ORIGIN "Group" /begin ANNOTATION_TEXT "0" /end ANNOTATION_TEXT /end ANNOTATION
 /begin ANNOTATION ANNOTATION_LABEL "TimeResolution" ANNOTATION_ORIGIN "Group" /begin ANNOTATION_TEXT "0" /end ANNOTATION_TEXT /end ANNOTATION
 /begin REF_MEASUREMENT OUT_FMSCAN.Tx_Dig.In_Dig_03_Sts.IN_DIG_DIAG.Task4 OUT_FMSCAN.Tx_Dig.In_Dig_03_Sts.IN_DIG_Val.Task4 OUT_FMSCAN.Tx_Dig.In_Dig_03_Sts.MessageEnable.Task4 /end REF_MEASUREMENT
/end GROUP
/begin GROUP SYSTEM.FMS_CAN.In_Dig_02_Sts "In_Dig_02_Sts"
 /begin ANNOTATION ANNOTATION_LABEL "Instance" ANNOTATION_ORIGIN "Group" /begin ANNOTATION_TEXT "42" /end ANNOTATION_TEXT /end ANNOTATION
 /begin ANNOTATION ANNOTATION_LABEL "TaskCycleTime" ANNOTATION_ORIGIN "Group" /begin ANNOTATION_TEXT "0" /end ANNOTATION_TEXT /end ANNOTATION
 /begin ANNOTATION ANNOTATION_LABEL "TimeResolution" ANNOTATION_ORIGIN "Group" /begin ANNOTATION_TEXT "0" /end ANNOTATION_TEXT /end ANNOTATION
 /begin REF_MEASUREMENT OUT_FMSCAN.Tx_Dig.In_Dig_02_Sts.IN_DIG_DIAG.Task4 OUT_FMSCAN.Tx_Dig.In_Dig_02_Sts.IN_DIG_Val.Task4 OUT_FMSCAN.Tx_Dig.In_Dig_02_Sts.MessageEnable.Task4 /end REF_MEASUREMENT
/end GROUP
/begin GROUP SYSTEM.FMS_CAN.In_Dig_01_Sts "In_Dig_01_Sts"
 /begin ANNOTATION ANNOTATION_LABEL "Instance" ANNOTATION_ORIGIN "Group" /begin ANNOTATION_TEXT "43" /end ANNOTATION_TEXT /end ANNOTATION
 /begin ANNOTATION ANNOTATION_LABEL "TaskCycleTime" ANNOTATION_ORIGIN "Group" /begin ANNOTATION_TEXT "0" /end ANNOTATION_TEXT /end ANNOTATION
 /begin ANNOTATION ANNOTATION_LABEL "TimeResolution" ANNOTATION_ORIGIN "Group" /begin ANNOTATION_TEXT "0" /end ANNOTATION_TEXT /end ANNOTATION
 /begin REF_MEASUREMENT OUT_FMSCAN.Tx_Dig.In_Dig_01_Sts.IN_DIG_DIAG.Task4 OUT_FMSCAN.Tx_Dig.In_Dig_01_Sts.IN_DIG_Val.Task4 OUT_FMSCAN.Tx_Dig.In_Dig_01_Sts.MessageEnable.Task4 /end REF_MEASUREMENT
/end GROUP
/begin GROUP SYSTEM.FMS_CAN.Out_Supply_ANA_01_Sts "Out_Supply_ANA_01_Sts"
 /begin ANNOTATION ANNOTATION_LABEL "Instance" ANNOTATION_ORIGIN "Group" /begin ANNOTATION_TEXT "44" /end ANNOTATION_TEXT /end ANNOTATION
 /begin ANNOTATION ANNOTATION_LABEL "TaskCycleTime" ANNOTATION_ORIGIN "Group" /begin ANNOTATION_TEXT "0" /end ANNOTATION_TEXT /end ANNOTATION
 /begin ANNOTATION ANNOTATION_LABEL "TimeResolution" ANNOTATION_ORIGIN "Group" /begin ANNOTATION_TEXT "0" /end ANNOTATION_TEXT /end ANNOTATION
 /begin REF_MEASUREMENT OUT_FMSCAN.Tx_Pwr.Out_Supply_ANA_01_Sts.Supply_ANA_DIAG.Task4 OUT_FMSCAN.Tx_Pwr.Out_Supply_ANA_01_Sts.Supply_ANA_Val.Task4 OUT_FMSCAN.Tx_Pwr.Out_Supply_ANA_01_Sts.MessageEnable.Task4 /end REF_MEASUREMENT
/end GROUP
/begin GROUP SYSTEM.FMS_CAN.Out_34_Sts "Out_34_Sts"
 /begin ANNOTATION ANNOTATION_LABEL "Instance" ANNOTATION_ORIGIN "Group" /begin ANNOTATION_TEXT "45" /end ANNOTATION_TEXT /end ANNOTATION
 /begin ANNOTATION ANNOTATION_LABEL "TaskCycleTime" ANNOTATION_ORIGIN "Group" /begin ANNOTATION_TEXT "0" /end ANNOTATION_TEXT /end ANNOTATION
 /begin ANNOTATION ANNOTATION_LABEL "TimeResolution" ANNOTATION_ORIGIN "Group" /begin ANNOTATION_TEXT "0" /end ANNOTATION_TEXT /end ANNOTATION
 /begin REF_MEASUREMENT OUT_FMSCAN.Tx_Out.Out_34_Sts.Out_DIAG.Task4 OUT_FMSCAN.Tx_Out.Out_34_Sts.MessageEnable.Task4 OUT_FMSCAN.Tx_Out.Out_34_Sts.Out_STATUS.Task4 /end REF_MEASUREMENT
/end GROUP
/begin GROUP SYSTEM.FMS_CAN.Out_33_Sts "Out_33_Sts"
 /begin ANNOTATION ANNOTATION_LABEL "Instance" ANNOTATION_ORIGIN "Group" /begin ANNOTATION_TEXT "46" /end ANNOTATION_TEXT /end ANNOTATION
 /begin ANNOTATION ANNOTATION_LABEL "TaskCycleTime" ANNOTATION_ORIGIN "Group" /begin ANNOTATION_TEXT "0" /end ANNOTATION_TEXT /end ANNOTATION
 /begin ANNOTATION ANNOTATION_LABEL "TimeResolution" ANNOTATION_ORIGIN "Group" /begin ANNOTATION_TEXT "0" /end ANNOTATION_TEXT /end ANNOTATION
 /begin REF_MEASUREMENT OUT_FMSCAN.Tx_Out.Out_33_Sts.Out_DIAG.Task4 OUT_FMSCAN.Tx_Out.Out_33_Sts.MessageEnable.Task4 OUT_FMSCAN.Tx_Out.Out_33_Sts.Out_STATUS.Task4 /end REF_MEASUREMENT
/end GROUP
/begin GROUP SYSTEM.FMS_CAN.Out_32_Sts "Out_32_Sts"
 /begin ANNOTATION ANNOTATION_LABEL "Instance" ANNOTATION_ORIGIN "Group" /begin ANNOTATION_TEXT "47" /end ANNOTATION_TEXT /end ANNOTATION
 /begin ANNOTATION ANNOTATION_LABEL "TaskCycleTime" ANNOTATION_ORIGIN "Group" /begin ANNOTATION_TEXT "0" /end ANNOTATION_TEXT /end ANNOTATION
 /begin ANNOTATION ANNOTATION_LABEL "TimeResolution" ANNOTATION_ORIGIN "Group" /begin ANNOTATION_TEXT "0" /end ANNOTATION_TEXT /end ANNOTATION
 /begin REF_MEASUREMENT OUT_FMSCAN.Tx_Out.Out_32_Sts.Out_DIAG.Task4 OUT_FMSCAN.Tx_Out.Out_32_Sts.MessageEnable.Task4 OUT_FMSCAN.Tx_Out.Out_32_Sts.Out_STATUS.Task4 /end REF_MEASUREMENT
/end GROUP
/begin GROUP SYSTEM.FMS_CAN.Out_31_Sts "Out_31_Sts"
 /begin ANNOTATION ANNOTATION_LABEL "Instance" ANNOTATION_ORIGIN "Group" /begin ANNOTATION_TEXT "48" /end ANNOTATION_TEXT /end ANNOTATION
 /begin ANNOTATION ANNOTATION_LABEL "TaskCycleTime" ANNOTATION_ORIGIN "Group" /begin ANNOTATION_TEXT "0" /end ANNOTATION_TEXT /end ANNOTATION
 /begin ANNOTATION ANNOTATION_LABEL "TimeResolution" ANNOTATION_ORIGIN "Group" /begin ANNOTATION_TEXT "0" /end ANNOTATION_TEXT /end ANNOTATION
 /begin REF_MEASUREMENT OUT_FMSCAN.Tx_Out.Out_31_Sts.Out_DIAG.Task4 OUT_FMSCAN.Tx_Out.Out_31_Sts.MessageEnable.Task4 OUT_FMSCAN.Tx_Out.Out_31_Sts.Out_STATUS.Task4 /end REF_MEASUREMENT
/end GROUP
/begin GROUP SYSTEM.FMS_CAN.Out_30_Sts "Out_30_Sts"
 /begin ANNOTATION ANNOTATION_LABEL "Instance" ANNOTATION_ORIGIN "Group" /begin ANNOTATION_TEXT "49" /end ANNOTATION_TEXT /end ANNOTATION
 /begin ANNOTATION ANNOTATION_LABEL "TaskCycleTime" ANNOTATION_ORIGIN "Group" /begin ANNOTATION_TEXT "0" /end ANNOTATION_TEXT /end ANNOTATION
 /begin ANNOTATION ANNOTATION_LABEL "TimeResolution" ANNOTATION_ORIGIN "Group" /begin ANNOTATION_TEXT "0" /end ANNOTATION_TEXT /end ANNOTATION
 /begin REF_MEASUREMENT OUT_FMSCAN.Tx_Out.Out_30_Sts.Out_DIAG.Task4 OUT_FMSCAN.Tx_Out.Out_30_Sts.MessageEnable.Task4 OUT_FMSCAN.Tx_Out.Out_30_Sts.Out_STATUS.Task4 /end REF_MEASUREMENT
/end GROUP
/begin GROUP SYSTEM.FMS_CAN.Out_29_Sts "Out_29_Sts"
 /begin ANNOTATION ANNOTATION_LABEL "Instance" ANNOTATION_ORIGIN "Group" /begin ANNOTATION_TEXT "50" /end ANNOTATION_TEXT /end ANNOTATION
 /begin ANNOTATION ANNOTATION_LABEL "TaskCycleTime" ANNOTATION_ORIGIN "Group" /begin ANNOTATION_TEXT "0" /end ANNOTATION_TEXT /end ANNOTATION
 /begin ANNOTATION ANNOTATION_LABEL "TimeResolution" ANNOTATION_ORIGIN "Group" /begin ANNOTATION_TEXT "0" /end ANNOTATION_TEXT /end ANNOTATION
 /begin REF_MEASUREMENT OUT_FMSCAN.Tx_Out.Out_29_Sts.Out_DIAG.Task4 OUT_FMSCAN.Tx_Out.Out_29_Sts.MessageEnable.Task4 OUT_FMSCAN.Tx_Out.Out_29_Sts.Out_STATUS.Task4 /end REF_MEASUREMENT
/end GROUP
/begin GROUP SYSTEM.FMS_CAN.Out_28_Sts "Out_28_Sts"
 /begin ANNOTATION ANNOTATION_LABEL "Instance" ANNOTATION_ORIGIN "Group" /begin ANNOTATION_TEXT "51" /end ANNOTATION_TEXT /end ANNOTATION
 /begin ANNOTATION ANNOTATION_LABEL "TaskCycleTime" ANNOTATION_ORIGIN "Group" /begin ANNOTATION_TEXT "0" /end ANNOTATION_TEXT /end ANNOTATION
 /begin ANNOTATION ANNOTATION_LABEL "TimeResolution" ANNOTATION_ORIGIN "Group" /begin ANNOTATION_TEXT "0" /end ANNOTATION_TEXT /end ANNOTATION
 /begin REF_MEASUREMENT OUT_FMSCAN.Tx_Out.Out_28_Sts.Out_DIAG.Task4 OUT_FMSCAN.Tx_Out.Out_28_Sts.Out_SENSE.Task4 OUT_FMSCAN.Tx_Out.Out_28_Sts.MessageEnable.Task4 OUT_FMSCAN.Tx_Out.Out_28_Sts.Out_STATUS.Task4 /end REF_MEASUREMENT
/end GROUP
/begin GROUP SYSTEM.FMS_CAN.Out_27_Sts "Out_27_Sts"
 /begin ANNOTATION ANNOTATION_LABEL "Instance" ANNOTATION_ORIGIN "Group" /begin ANNOTATION_TEXT "52" /end ANNOTATION_TEXT /end ANNOTATION
 /begin ANNOTATION ANNOTATION_LABEL "TaskCycleTime" ANNOTATION_ORIGIN "Group" /begin ANNOTATION_TEXT "0" /end ANNOTATION_TEXT /end ANNOTATION
 /begin ANNOTATION ANNOTATION_LABEL "TimeResolution" ANNOTATION_ORIGIN "Group" /begin ANNOTATION_TEXT "0" /end ANNOTATION_TEXT /end ANNOTATION
 /begin REF_MEASUREMENT OUT_FMSCAN.Tx_Out.Out_27_Sts.Out_DIAG.Task4 OUT_FMSCAN.Tx_Out.Out_27_Sts.Out_SENSE.Task4 OUT_FMSCAN.Tx_Out.Out_27_Sts.MessageEnable.Task4 OUT_FMSCAN.Tx_Out.Out_27_Sts.Out_STATUS.Task4 /end REF_MEASUREMENT
/end GROUP
/begin GROUP SYSTEM.FMS_CAN.Out_26_Sts "Out_26_Sts"
 /begin ANNOTATION ANNOTATION_LABEL "Instance" ANNOTATION_ORIGIN "Group" /begin ANNOTATION_TEXT "53" /end ANNOTATION_TEXT /end ANNOTATION
 /begin ANNOTATION ANNOTATION_LABEL "TaskCycleTime" ANNOTATION_ORIGIN "Group" /begin ANNOTATION_TEXT "0" /end ANNOTATION_TEXT /end ANNOTATION
 /begin ANNOTATION ANNOTATION_LABEL "TimeResolution" ANNOTATION_ORIGIN "Group" /begin ANNOTATION_TEXT "0" /end ANNOTATION_TEXT /end ANNOTATION
 /begin REF_MEASUREMENT OUT_FMSCAN.Tx_Out.Out_26_Sts.Out_DIAG.Task4 OUT_FMSCAN.Tx_Out.Out_26_Sts.Out_SENSE.Task4 OUT_FMSCAN.Tx_Out.Out_26_Sts.MessageEnable.Task4 OUT_FMSCAN.Tx_Out.Out_26_Sts.Out_STATUS.Task4 /end REF_MEASUREMENT
/end GROUP
/begin GROUP SYSTEM.FMS_CAN.Out_25_Sts "Out_25_Sts"
 /begin ANNOTATION ANNOTATION_LABEL "Instance" ANNOTATION_ORIGIN "Group" /begin ANNOTATION_TEXT "54" /end ANNOTATION_TEXT /end ANNOTATION
 /begin ANNOTATION ANNOTATION_LABEL "TaskCycleTime" ANNOTATION_ORIGIN "Group" /begin ANNOTATION_TEXT "0" /end ANNOTATION_TEXT /end ANNOTATION
 /begin ANNOTATION ANNOTATION_LABEL "TimeResolution" ANNOTATION_ORIGIN "Group" /begin ANNOTATION_TEXT "0" /end ANNOTATION_TEXT /end ANNOTATION
 /begin REF_MEASUREMENT OUT_FMSCAN.Tx_Out.Out_25_Sts.Out_DIAG.Task4 OUT_FMSCAN.Tx_Out.Out_25_Sts.Out_SENSE.Task4 OUT_FMSCAN.Tx_Out.Out_25_Sts.MessageEnable.Task4 OUT_FMSCAN.Tx_Out.Out_25_Sts.Out_STATUS.Task4 /end REF_MEASUREMENT
/end GROUP
/begin GROUP SYSTEM.FMS_CAN.Out_24_Sts "Out_24_Sts"
 /begin ANNOTATION ANNOTATION_LABEL "Instance" ANNOTATION_ORIGIN "Group" /begin ANNOTATION_TEXT "55" /end ANNOTATION_TEXT /end ANNOTATION
 /begin ANNOTATION ANNOTATION_LABEL "TaskCycleTime" ANNOTATION_ORIGIN "Group" /begin ANNOTATION_TEXT "0" /end ANNOTATION_TEXT /end ANNOTATION
 /begin ANNOTATION ANNOTATION_LABEL "TimeResolution" ANNOTATION_ORIGIN "Group" /begin ANNOTATION_TEXT "0" /end ANNOTATION_TEXT /end ANNOTATION
 /begin REF_MEASUREMENT OUT_FMSCAN.Tx_Out.Out_24_Sts.Out_DIAG.Task4 OUT_FMSCAN.Tx_Out.Out_24_Sts.Out_SENSE.Task4 OUT_FMSCAN.Tx_Out.Out_24_Sts.MessageEnable.Task4 OUT_FMSCAN.Tx_Out.Out_24_Sts.Out_STATUS.Task4 /end REF_MEASUREMENT
/end GROUP
/begin GROUP SYSTEM.FMS_CAN.Out_23_Sts "Out_23_Sts"
 /begin ANNOTATION ANNOTATION_LABEL "Instance" ANNOTATION_ORIGIN "Group" /begin ANNOTATION_TEXT "56" /end ANNOTATION_TEXT /end ANNOTATION
 /begin ANNOTATION ANNOTATION_LABEL "TaskCycleTime" ANNOTATION_ORIGIN "Group" /begin ANNOTATION_TEXT "0" /end ANNOTATION_TEXT /end ANNOTATION
 /begin ANNOTATION ANNOTATION_LABEL "TimeResolution" ANNOTATION_ORIGIN "Group" /begin ANNOTATION_TEXT "0" /end ANNOTATION_TEXT /end ANNOTATION
 /begin REF_MEASUREMENT OUT_FMSCAN.Tx_Out.Out_23_Sts.Out_DIAG.Task4 OUT_FMSCAN.Tx_Out.Out_23_Sts.Out_SENSE.Task4 OUT_FMSCAN.Tx_Out.Out_23_Sts.MessageEnable.Task4 OUT_FMSCAN.Tx_Out.Out_23_Sts.Out_STATUS.Task4 /end REF_MEASUREMENT
/end GROUP
/begin GROUP SYSTEM.FMS_CAN.Out_22_Sts "Out_22_Sts"
 /begin ANNOTATION ANNOTATION_LABEL "Instance" ANNOTATION_ORIGIN "Group" /begin ANNOTATION_TEXT "57" /end ANNOTATION_TEXT /end ANNOTATION
 /begin ANNOTATION ANNOTATION_LABEL "TaskCycleTime" ANNOTATION_ORIGIN "Group" /begin ANNOTATION_TEXT "0" /end ANNOTATION_TEXT /end ANNOTATION
 /begin ANNOTATION ANNOTATION_LABEL "TimeResolution" ANNOTATION_ORIGIN "Group" /begin ANNOTATION_TEXT "0" /end ANNOTATION_TEXT /end ANNOTATION
 /begin REF_MEASUREMENT OUT_FMSCAN.Tx_Out.Out_22_Sts.Out_DIAG.Task4 OUT_FMSCAN.Tx_Out.Out_22_Sts.Out_SENSE.Task4 OUT_FMSCAN.Tx_Out.Out_22_Sts.MessageEnable.Task4 OUT_FMSCAN.Tx_Out.Out_22_Sts.Out_STATUS.Task4 /end REF_MEASUREMENT
/end GROUP
/begin GROUP SYSTEM.FMS_CAN.Out_21_Sts "Out_21_Sts"
 /begin ANNOTATION ANNOTATION_LABEL "Instance" ANNOTATION_ORIGIN "Group" /begin ANNOTATION_TEXT "58" /end ANNOTATION_TEXT /end ANNOTATION
 /begin ANNOTATION ANNOTATION_LABEL "TaskCycleTime" ANNOTATION_ORIGIN "Group" /begin ANNOTATION_TEXT "0" /end ANNOTATION_TEXT /end ANNOTATION
 /begin ANNOTATION ANNOTATION_LABEL "TimeResolution" ANNOTATION_ORIGIN "Group" /begin ANNOTATION_TEXT "0" /end ANNOTATION_TEXT /end ANNOTATION
 /begin REF_MEASUREMENT OUT_FMSCAN.Tx_Out.Out_21_Sts.Out_DIAG.Task4 OUT_FMSCAN.Tx_Out.Out_21_Sts.Out_SENSE.Task4 OUT_FMSCAN.Tx_Out.Out_21_Sts.Out_TD_DIAG.Task4 OUT_FMSCAN.Tx_Out.Out_21_Sts.MessageEnable.Task4 OUT_FMSCAN.Tx_Out.Out_21_Sts.Out_STATUS.Task4 OUT_FMSCAN.Tx_Out.Out_21_Sts.Out_TD.Task4 /end REF_MEASUREMENT
/end GROUP
/begin GROUP SYSTEM.FMS_CAN.Out_20_Sts "Out_20_Sts"
 /begin ANNOTATION ANNOTATION_LABEL "Instance" ANNOTATION_ORIGIN "Group" /begin ANNOTATION_TEXT "59" /end ANNOTATION_TEXT /end ANNOTATION
 /begin ANNOTATION ANNOTATION_LABEL "TaskCycleTime" ANNOTATION_ORIGIN "Group" /begin ANNOTATION_TEXT "0" /end ANNOTATION_TEXT /end ANNOTATION
 /begin ANNOTATION ANNOTATION_LABEL "TimeResolution" ANNOTATION_ORIGIN "Group" /begin ANNOTATION_TEXT "0" /end ANNOTATION_TEXT /end ANNOTATION
 /begin REF_MEASUREMENT OUT_FMSCAN.Tx_Out.Out_20_Sts.Out_DIAG.Task4 OUT_FMSCAN.Tx_Out.Out_20_Sts.Out_SENSE.Task4 OUT_FMSCAN.Tx_Out.Out_20_Sts.MessageEnable.Task4 OUT_FMSCAN.Tx_Out.Out_20_Sts.Out_STATUS.Task4 /end REF_MEASUREMENT
/end GROUP
/begin GROUP SYSTEM.FMS_CAN.Out_19_Sts "Out_19_Sts"
 /begin ANNOTATION ANNOTATION_LABEL "Instance" ANNOTATION_ORIGIN "Group" /begin ANNOTATION_TEXT "60" /end ANNOTATION_TEXT /end ANNOTATION
 /begin ANNOTATION ANNOTATION_LABEL "TaskCycleTime" ANNOTATION_ORIGIN "Group" /begin ANNOTATION_TEXT "0" /end ANNOTATION_TEXT /end ANNOTATION
 /begin ANNOTATION ANNOTATION_LABEL "TimeResolution" ANNOTATION_ORIGIN "Group" /begin ANNOTATION_TEXT "0" /end ANNOTATION_TEXT /end ANNOTATION
 /begin REF_MEASUREMENT OUT_FMSCAN.Tx_Out.Out_19_Sts.Out_DIAG.Task4 OUT_FMSCAN.Tx_Out.Out_19_Sts.Out_SENSE.Task4 OUT_FMSCAN.Tx_Out.Out_19_Sts.MessageEnable.Task4 OUT_FMSCAN.Tx_Out.Out_19_Sts.Out_STATUS.Task4 /end REF_MEASUREMENT
/end GROUP
/begin GROUP SYSTEM.FMS_CAN.Out_18_Sts "Out_18_Sts"
 /begin ANNOTATION ANNOTATION_LABEL "Instance" ANNOTATION_ORIGIN "Group" /begin ANNOTATION_TEXT "61" /end ANNOTATION_TEXT /end ANNOTATION
 /begin ANNOTATION ANNOTATION_LABEL "TaskCycleTime" ANNOTATION_ORIGIN "Group" /begin ANNOTATION_TEXT "0" /end ANNOTATION_TEXT /end ANNOTATION
 /begin ANNOTATION ANNOTATION_LABEL "TimeResolution" ANNOTATION_ORIGIN "Group" /begin ANNOTATION_TEXT "0" /end ANNOTATION_TEXT /end ANNOTATION
 /begin REF_MEASUREMENT OUT_FMSCAN.Tx_Out.Out_18_Sts.Out_DIAG.Task4 OUT_FMSCAN.Tx_Out.Out_18_Sts.Out_SENSE.Task4 OUT_FMSCAN.Tx_Out.Out_18_Sts.MessageEnable.Task4 OUT_FMSCAN.Tx_Out.Out_18_Sts.Out_STATUS.Task4 /end REF_MEASUREMENT
/end GROUP
/begin GROUP SYSTEM.FMS_CAN.Out_17_Sts "Out_17_Sts"
 /begin ANNOTATION ANNOTATION_LABEL "Instance" ANNOTATION_ORIGIN "Group" /begin ANNOTATION_TEXT "62" /end ANNOTATION_TEXT /end ANNOTATION
 /begin ANNOTATION ANNOTATION_LABEL "TaskCycleTime" ANNOTATION_ORIGIN "Group" /begin ANNOTATION_TEXT "0" /end ANNOTATION_TEXT /end ANNOTATION
 /begin ANNOTATION ANNOTATION_LABEL "TimeResolution" ANNOTATION_ORIGIN "Group" /begin ANNOTATION_TEXT "0" /end ANNOTATION_TEXT /end ANNOTATION
 /begin REF_MEASUREMENT OUT_FMSCAN.Tx_Out.Out_17_Sts.Out_DIAG.Task4 OUT_FMSCAN.Tx_Out.Out_17_Sts.Out_SENSE.Task4 OUT_FMSCAN.Tx_Out.Out_17_Sts.MessageEnable.Task4 OUT_FMSCAN.Tx_Out.Out_17_Sts.Out_STATUS.Task4 /end REF_MEASUREMENT
/end GROUP
/begin GROUP SYSTEM.FMS_CAN.Out_16_Sts "Out_16_Sts"
 /begin ANNOTATION ANNOTATION_LABEL "Instance" ANNOTATION_ORIGIN "Group" /begin ANNOTATION_TEXT "63" /end ANNOTATION_TEXT /end ANNOTATION
 /begin ANNOTATION ANNOTATION_LABEL "TaskCycleTime" ANNOTATION_ORIGIN "Group" /begin ANNOTATION_TEXT "0" /end ANNOTATION_TEXT /end ANNOTATION
 /begin ANNOTATION ANNOTATION_LABEL "TimeResolution" ANNOTATION_ORIGIN "Group" /begin ANNOTATION_TEXT "0" /end ANNOTATION_TEXT /end ANNOTATION
 /begin REF_MEASUREMENT OUT_FMSCAN.Tx_Out.Out_16_Sts.Out_DIAG.Task4 OUT_FMSCAN.Tx_Out.Out_16_Sts.Out_SENSE.Task4 OUT_FMSCAN.Tx_Out.Out_16_Sts.MessageEnable.Task4 OUT_FMSCAN.Tx_Out.Out_16_Sts.Out_STATUS.Task4 /end REF_MEASUREMENT
/end GROUP
/begin GROUP SYSTEM.FMS_CAN.Out_15_Sts "Out_15_Sts"
 /begin ANNOTATION ANNOTATION_LABEL "Instance" ANNOTATION_ORIGIN "Group" /begin ANNOTATION_TEXT "64" /end ANNOTATION_TEXT /end ANNOTATION
 /begin ANNOTATION ANNOTATION_LABEL "TaskCycleTime" ANNOTATION_ORIGIN "Group" /begin ANNOTATION_TEXT "0" /end ANNOTATION_TEXT /end ANNOTATION
 /begin ANNOTATION ANNOTATION_LABEL "TimeResolution" ANNOTATION_ORIGIN "Group" /begin ANNOTATION_TEXT "0" /end ANNOTATION_TEXT /end ANNOTATION
 /begin REF_MEASUREMENT OUT_FMSCAN.Tx_Out.Out_15_Sts.Out_DIAG.Task4 OUT_FMSCAN.Tx_Out.Out_15_Sts.Out_SENSE.Task4 OUT_FMSCAN.Tx_Out.Out_15_Sts.MessageEnable.Task4 OUT_FMSCAN.Tx_Out.Out_15_Sts.Out_STATUS.Task4 /end REF_MEASUREMENT
/end GROUP
/begin GROUP SYSTEM.FMS_CAN.Out_14_Sts "Out_14_Sts"
 /begin ANNOTATION ANNOTATION_LABEL "Instance" ANNOTATION_ORIGIN "Group" /begin ANNOTATION_TEXT "65" /end ANNOTATION_TEXT /end ANNOTATION
 /begin ANNOTATION ANNOTATION_LABEL "TaskCycleTime" ANNOTATION_ORIGIN "Group" /begin ANNOTATION_TEXT "0" /end ANNOTATION_TEXT /end ANNOTATION
 /begin ANNOTATION ANNOTATION_LABEL "TimeResolution" ANNOTATION_ORIGIN "Group" /begin ANNOTATION_TEXT "0" /end ANNOTATION_TEXT /end ANNOTATION
 /begin REF_MEASUREMENT OUT_FMSCAN.Tx_Out.Out_14_Sts.Out_DIAG.Task4 OUT_FMSCAN.Tx_Out.Out_14_Sts.Out_SENSE.Task4 OUT_FMSCAN.Tx_Out.Out_14_Sts.MessageEnable.Task4 OUT_FMSCAN.Tx_Out.Out_14_Sts.Out_STATUS.Task4 /end REF_MEASUREMENT
/end GROUP
/begin GROUP SYSTEM.FMS_CAN.Out_13_Sts "Out_13_Sts"
 /begin ANNOTATION ANNOTATION_LABEL "Instance" ANNOTATION_ORIGIN "Group" /begin ANNOTATION_TEXT "66" /end ANNOTATION_TEXT /end ANNOTATION
 /begin ANNOTATION ANNOTATION_LABEL "TaskCycleTime" ANNOTATION_ORIGIN "Group" /begin ANNOTATION_TEXT "0" /end ANNOTATION_TEXT /end ANNOTATION
 /begin ANNOTATION ANNOTATION_LABEL "TimeResolution" ANNOTATION_ORIGIN "Group" /begin ANNOTATION_TEXT "0" /end ANNOTATION_TEXT /end ANNOTATION
 /begin REF_MEASUREMENT OUT_FMSCAN.Tx_Out.Out_13_Sts.Out_DIAG.Task4 OUT_FMSCAN.Tx_Out.Out_13_Sts.Out_SENSE.Task4 OUT_FMSCAN.Tx_Out.Out_13_Sts.MessageEnable.Task4 OUT_FMSCAN.Tx_Out.Out_13_Sts.Out_STATUS.Task4 /end REF_MEASUREMENT
/end GROUP
/begin GROUP SYSTEM.FMS_CAN.Out_12_Sts "Out_12_Sts"
 /begin ANNOTATION ANNOTATION_LABEL "Instance" ANNOTATION_ORIGIN "Group" /begin ANNOTATION_TEXT "67" /end ANNOTATION_TEXT /end ANNOTATION
 /begin ANNOTATION ANNOTATION_LABEL "TaskCycleTime" ANNOTATION_ORIGIN "Group" /begin ANNOTATION_TEXT "0" /end ANNOTATION_TEXT /end ANNOTATION
 /begin ANNOTATION ANNOTATION_LABEL "TimeResolution" ANNOTATION_ORIGIN "Group" /begin ANNOTATION_TEXT "0" /end ANNOTATION_TEXT /end ANNOTATION
 /begin REF_MEASUREMENT OUT_FMSCAN.Tx_Out.Out_12_Sts.Out_DIAG.Task4 OUT_FMSCAN.Tx_Out.Out_12_Sts.Out_SENSE.Task4 OUT_FMSCAN.Tx_Out.Out_12_Sts.Out_TD_DIAG.Task4 OUT_FMSCAN.Tx_Out.Out_12_Sts.MessageEnable.Task4 OUT_FMSCAN.Tx_Out.Out_12_Sts.Out_STATUS.Task4 OUT_FMSCAN.Tx_Out.Out_12_Sts.Out_TD.Task4 /end REF_MEASUREMENT
/end GROUP
/begin GROUP SYSTEM.FMS_CAN.Out_11_Sts "Out_11_Sts"
 /begin ANNOTATION ANNOTATION_LABEL "Instance" ANNOTATION_ORIGIN "Group" /begin ANNOTATION_TEXT "68" /end ANNOTATION_TEXT /end ANNOTATION
 /begin ANNOTATION ANNOTATION_LABEL "TaskCycleTime" ANNOTATION_ORIGIN "Group" /begin ANNOTATION_TEXT "0" /end ANNOTATION_TEXT /end ANNOTATION
 /begin ANNOTATION ANNOTATION_LABEL "TimeResolution" ANNOTATION_ORIGIN "Group" /begin ANNOTATION_TEXT "0" /end ANNOTATION_TEXT /end ANNOTATION
 /begin REF_MEASUREMENT OUT_FMSCAN.Tx_Out.Out_11_Sts.Out_DIAG.Task4 OUT_FMSCAN.Tx_Out.Out_11_Sts.Out_SENSE.Task4 OUT_FMSCAN.Tx_Out.Out_11_Sts.MessageEnable.Task4 OUT_FMSCAN.Tx_Out.Out_11_Sts.Out_STATUS.Task4 /end REF_MEASUREMENT
/end GROUP
/begin GROUP SYSTEM.FMS_CAN.Out_10_Sts "Out_10_Sts"
 /begin ANNOTATION ANNOTATION_LABEL "Instance" ANNOTATION_ORIGIN "Group" /begin ANNOTATION_TEXT "69" /end ANNOTATION_TEXT /end ANNOTATION
 /begin ANNOTATION ANNOTATION_LABEL "TaskCycleTime" ANNOTATION_ORIGIN "Group" /begin ANNOTATION_TEXT "0" /end ANNOTATION_TEXT /end ANNOTATION
 /begin ANNOTATION ANNOTATION_LABEL "TimeResolution" ANNOTATION_ORIGIN "Group" /begin ANNOTATION_TEXT "0" /end ANNOTATION_TEXT /end ANNOTATION
 /begin REF_MEASUREMENT OUT_FMSCAN.Tx_Out.Out_10_Sts.Out_DIAG.Task4 OUT_FMSCAN.Tx_Out.Out_10_Sts.Out_SENSE.Task4 OUT_FMSCAN.Tx_Out.Out_10_Sts.MessageEnable.Task4 OUT_FMSCAN.Tx_Out.Out_10_Sts.Out_STATUS.Task4 /end REF_MEASUREMENT
/end GROUP
/begin GROUP SYSTEM.FMS_CAN.Out_09_Sts "Out_09_Sts"
 /begin ANNOTATION ANNOTATION_LABEL "Instance" ANNOTATION_ORIGIN "Group" /begin ANNOTATION_TEXT "70" /end ANNOTATION_TEXT /end ANNOTATION
 /begin ANNOTATION ANNOTATION_LABEL "TaskCycleTime" ANNOTATION_ORIGIN "Group" /begin ANNOTATION_TEXT "0" /end ANNOTATION_TEXT /end ANNOTATION
 /begin ANNOTATION ANNOTATION_LABEL "TimeResolution" ANNOTATION_ORIGIN "Group" /begin ANNOTATION_TEXT "0" /end ANNOTATION_TEXT /end ANNOTATION
 /begin REF_MEASUREMENT OUT_FMSCAN.Tx_Out.Out_09_Sts.Out_DIAG.Task4 OUT_FMSCAN.Tx_Out.Out_09_Sts.Out_SENSE.Task4 OUT_FMSCAN.Tx_Out.Out_09_Sts.MessageEnable.Task4 OUT_FMSCAN.Tx_Out.Out_09_Sts.Out_STATUS.Task4 /end REF_MEASUREMENT
/end GROUP
/begin GROUP SYSTEM.FMS_CAN.Out_08_Sts "Out_08_Sts"
 /begin ANNOTATION ANNOTATION_LABEL "Instance" ANNOTATION_ORIGIN "Group" /begin ANNOTATION_TEXT "71" /end ANNOTATION_TEXT /end ANNOTATION
 /begin ANNOTATION ANNOTATION_LABEL "TaskCycleTime" ANNOTATION_ORIGIN "Group" /begin ANNOTATION_TEXT "0" /end ANNOTATION_TEXT /end ANNOTATION
 /begin ANNOTATION ANNOTATION_LABEL "TimeResolution" ANNOTATION_ORIGIN "Group" /begin ANNOTATION_TEXT "0" /end ANNOTATION_TEXT /end ANNOTATION
 /begin REF_MEASUREMENT OUT_FMSCAN.Tx_Out.Out_08_Sts.Out_DIAG.Task4 OUT_FMSCAN.Tx_Out.Out_08_Sts.Out_SENSE.Task4 OUT_FMSCAN.Tx_Out.Out_08_Sts.MessageEnable.Task4 OUT_FMSCAN.Tx_Out.Out_08_Sts.Out_STATUS.Task4 /end REF_MEASUREMENT
/end GROUP
/begin GROUP SYSTEM.FMS_CAN.Out_07_Sts "Out_07_Sts"
 /begin ANNOTATION ANNOTATION_LABEL "Instance" ANNOTATION_ORIGIN "Group" /begin ANNOTATION_TEXT "72" /end ANNOTATION_TEXT /end ANNOTATION
 /begin ANNOTATION ANNOTATION_LABEL "TaskCycleTime" ANNOTATION_ORIGIN "Group" /begin ANNOTATION_TEXT "0" /end ANNOTATION_TEXT /end ANNOTATION
 /begin ANNOTATION ANNOTATION_LABEL "TimeResolution" ANNOTATION_ORIGIN "Group" /begin ANNOTATION_TEXT "0" /end ANNOTATION_TEXT /end ANNOTATION
 /begin REF_MEASUREMENT OUT_FMSCAN.Tx_Out.Out_07_Sts.Out_DIAG.Task4 OUT_FMSCAN.Tx_Out.Out_07_Sts.Out_SENSE.Task4 OUT_FMSCAN.Tx_Out.Out_07_Sts.MessageEnable.Task4 OUT_FMSCAN.Tx_Out.Out_07_Sts.Out_STATUS.Task4 /end REF_MEASUREMENT
/end GROUP
/begin GROUP SYSTEM.FMS_CAN.Out_06_Sts "Out_06_Sts"
 /begin ANNOTATION ANNOTATION_LABEL "Instance" ANNOTATION_ORIGIN "Group" /begin ANNOTATION_TEXT "73" /end ANNOTATION_TEXT /end ANNOTATION
 /begin ANNOTATION ANNOTATION_LABEL "TaskCycleTime" ANNOTATION_ORIGIN "Group" /begin ANNOTATION_TEXT "0" /end ANNOTATION_TEXT /end ANNOTATION
 /begin ANNOTATION ANNOTATION_LABEL "TimeResolution" ANNOTATION_ORIGIN "Group" /begin ANNOTATION_TEXT "0" /end ANNOTATION_TEXT /end ANNOTATION
 /begin REF_MEASUREMENT OUT_FMSCAN.Tx_Out.Out_06_Sts.Out_DIAG.Task4 OUT_FMSCAN.Tx_Out.Out_06_Sts.Out_SENSE.Task4 OUT_FMSCAN.Tx_Out.Out_06_Sts.MessageEnable.Task4 OUT_FMSCAN.Tx_Out.Out_06_Sts.Out_STATUS.Task4 /end REF_MEASUREMENT
/end GROUP
/begin GROUP SYSTEM.FMS_CAN.Out_05_Sts "Out_05_Sts"
 /begin ANNOTATION ANNOTATION_LABEL "Instance" ANNOTATION_ORIGIN "Group" /begin ANNOTATION_TEXT "74" /end ANNOTATION_TEXT /end ANNOTATION
 /begin ANNOTATION ANNOTATION_LABEL "TaskCycleTime" ANNOTATION_ORIGIN "Group" /begin ANNOTATION_TEXT "0" /end ANNOTATION_TEXT /end ANNOTATION
 /begin ANNOTATION ANNOTATION_LABEL "TimeResolution" ANNOTATION_ORIGIN "Group" /begin ANNOTATION_TEXT "0" /end ANNOTATION_TEXT /end ANNOTATION
 /begin REF_MEASUREMENT OUT_FMSCAN.Tx_Out.Out_05_Sts.Out_DIAG.Task4 OUT_FMSCAN.Tx_Out.Out_05_Sts.Out_SENSE.Task4 OUT_FMSCAN.Tx_Out.Out_05_Sts.MessageEnable.Task4 OUT_FMSCAN.Tx_Out.Out_05_Sts.Out_STATUS.Task4 /end REF_MEASUREMENT
/end GROUP
/begin GROUP SYSTEM.FMS_CAN.Out_04_Sts "Out_04_Sts"
 /begin ANNOTATION ANNOTATION_LABEL "Instance" ANNOTATION_ORIGIN "Group" /begin ANNOTATION_TEXT "75" /end ANNOTATION_TEXT /end ANNOTATION
 /begin ANNOTATION ANNOTATION_LABEL "TaskCycleTime" ANNOTATION_ORIGIN "Group" /begin ANNOTATION_TEXT "0" /end ANNOTATION_TEXT /end ANNOTATION
 /begin ANNOTATION ANNOTATION_LABEL "TimeResolution" ANNOTATION_ORIGIN "Group" /begin ANNOTATION_TEXT "0" /end ANNOTATION_TEXT /end ANNOTATION
 /begin REF_MEASUREMENT OUT_FMSCAN.Tx_Out.Out_04_Sts.Out_DIAG.Task4 OUT_FMSCAN.Tx_Out.Out_04_Sts.Out_SENSE.Task4 OUT_FMSCAN.Tx_Out.Out_04_Sts.MessageEnable.Task4 OUT_FMSCAN.Tx_Out.Out_04_Sts.Out_STATUS.Task4 /end REF_MEASUREMENT
/end GROUP
/begin GROUP SYSTEM.FMS_CAN.Out_03_Sts "Out_03_Sts"
 /begin ANNOTATION ANNOTATION_LABEL "Instance" ANNOTATION_ORIGIN "Group" /begin ANNOTATION_TEXT "76" /end ANNOTATION_TEXT /end ANNOTATION
 /begin ANNOTATION ANNOTATION_LABEL "TaskCycleTime" ANNOTATION_ORIGIN "Group" /begin ANNOTATION_TEXT "0" /end ANNOTATION_TEXT /end ANNOTATION
 /begin ANNOTATION ANNOTATION_LABEL "TimeResolution" ANNOTATION_ORIGIN "Group" /begin ANNOTATION_TEXT "0" /end ANNOTATION_TEXT /end ANNOTATION
 /begin REF_MEASUREMENT OUT_FMSCAN.Tx_Out.Out_03_Sts.Out_DIAG.Task4 OUT_FMSCAN.Tx_Out.Out_03_Sts.Out_SENSE.Task4 OUT_FMSCAN.Tx_Out.Out_03_Sts.MessageEnable.Task4 OUT_FMSCAN.Tx_Out.Out_03_Sts.Out_STATUS.Task4 /end REF_MEASUREMENT
/end GROUP
/begin GROUP SYSTEM.FMS_CAN.Out_02_Sts "Out_02_Sts"
 /begin ANNOTATION ANNOTATION_LABEL "Instance" ANNOTATION_ORIGIN "Group" /begin ANNOTATION_TEXT "77" /end ANNOTATION_TEXT /end ANNOTATION
 /begin ANNOTATION ANNOTATION_LABEL "TaskCycleTime" ANNOTATION_ORIGIN "Group" /begin ANNOTATION_TEXT "0" /end ANNOTATION_TEXT /end ANNOTATION
 /begin ANNOTATION ANNOTATION_LABEL "TimeResolution" ANNOTATION_ORIGIN "Group" /begin ANNOTATION_TEXT "0" /end ANNOTATION_TEXT /end ANNOTATION
 /begin REF_MEASUREMENT OUT_FMSCAN.Tx_Out.Out_02_Sts.Out_DIAG.Task4 OUT_FMSCAN.Tx_Out.Out_02_Sts.Out_SENSE.Task4 OUT_FMSCAN.Tx_Out.Out_02_Sts.MessageEnable.Task4 OUT_FMSCAN.Tx_Out.Out_02_Sts.Out_STATUS.Task4 /end REF_MEASUREMENT
/end GROUP
/begin GROUP SYSTEM.FMS_CAN.Out_01_Sts "Out_01_Sts"
 /begin ANNOTATION ANNOTATION_LABEL "Instance" ANNOTATION_ORIGIN "Group" /begin ANNOTATION_TEXT "78" /end ANNOTATION_TEXT /end ANNOTATION
 /begin ANNOTATION ANNOTATION_LABEL "TaskCycleTime" ANNOTATION_ORIGIN "Group" /begin ANNOTATION_TEXT "0" /end ANNOTATION_TEXT /end ANNOTATION
 /begin ANNOTATION ANNOTATION_LABEL "TimeResolution" ANNOTATION_ORIGIN "Group" /begin ANNOTATION_TEXT "0" /end ANNOTATION_TEXT /end ANNOTATION
 /begin REF_MEASUREMENT OUT_FMSCAN.Tx_Out.Out_01_Sts.Out_DIAG.Task4 OUT_FMSCAN.Tx_Out.Out_01_Sts.Out_SENSE.Task4 OUT_FMSCAN.Tx_Out.Out_01_Sts.MessageEnable.Task4 OUT_FMSCAN.Tx_Out.Out_01_Sts.Out_STATUS.Task4 /end REF_MEASUREMENT
/end GROUP
/begin GROUP SYSTEM.FMS_CAN.Out_21_TD_Sts "Out_21_TD_Sts"
 /begin ANNOTATION ANNOTATION_LABEL "Instance" ANNOTATION_ORIGIN "Group" /begin ANNOTATION_TEXT "0" /end ANNOTATION_TEXT /end ANNOTATION
 /begin ANNOTATION ANNOTATION_LABEL "TaskCycleTime" ANNOTATION_ORIGIN "Group" /begin ANNOTATION_TEXT "0" /end ANNOTATION_TEXT /end ANNOTATION
 /begin ANNOTATION ANNOTATION_LABEL "TimeResolution" ANNOTATION_ORIGIN "Group" /begin ANNOTATION_TEXT "0" /end ANNOTATION_TEXT /end ANNOTATION
 /begin REF_MEASUREMENT OUT_FMSCAN.Tx_Out.Out_21_TD_Sts.Out_SENSE_PULSE.Task4 OUT_FMSCAN.Tx_Out.Out_21_TD_Sts.Out_SENSE_PULSE_DIAG.Task4 OUT_FMSCAN.Tx_Out.Out_21_TD_Sts.MessageEnable.Task4 /end REF_MEASUREMENT
/end GROUP
/begin GROUP SYSTEM.FMS_CAN.GW_00000FF5 "GW_00000FF5"
 /begin ANNOTATION ANNOTATION_LABEL "Instance" ANNOTATION_ORIGIN "Group" /begin ANNOTATION_TEXT "0" /end ANNOTATION_TEXT /end ANNOTATION
 /begin ANNOTATION ANNOTATION_LABEL "TaskCycleTime" ANNOTATION_ORIGIN "Group" /begin ANNOTATION_TEXT "0" /end ANNOTATION_TEXT /end ANNOTATION
 /begin ANNOTATION ANNOTATION_LABEL "TimeResolution" ANNOTATION_ORIGIN "Group" /begin ANNOTATION_TEXT "0" /end ANNOTATION_TEXT /end ANNOTATION
 /begin REF_MEASUREMENT OUT_FMSCAN.GW_00000FF5.MessageEnable.Task2 /end REF_MEASUREMENT
/end GROUP
/begin GROUP SYSTEM.FMS_CAN "FMS-CAN"
 /begin ANNOTATION ANNOTATION_LABEL "Instance" ANNOTATION_ORIGIN "Group" /begin ANNOTATION_TEXT "0" /end ANNOTATION_TEXT /end ANNOTATION
 /begin ANNOTATION ANNOTATION_LABEL "TaskCycleTime" ANNOTATION_ORIGIN "Group" /begin ANNOTATION_TEXT "0" /end ANNOTATION_TEXT /end ANNOTATION
 /begin ANNOTATION ANNOTATION_LABEL "TimeResolution" ANNOTATION_ORIGIN "Group" /begin ANNOTATION_TEXT "0" /end ANNOTATION_TEXT /end ANNOTATION
 /begin SUB_GROUP SYSTEM.FMS_CAN.Out_HB_Ctrl SYSTEM.FMS_CAN.Out_Ctrl SYSTEM.FMS_CAN.Out_Mirror_HB_Ctrl SYSTEM.FMS_CAN.Out_12_TD_Sts SYSTEM.FMS_CAN.In_Ana_12_Sts SYSTEM.FMS_CAN.In_Ana_11_Sts SYSTEM.FMS_CAN.In_Ana_09_Sts SYSTEM.FMS_CAN.In_Ana_08_Sts SYSTEM.FMS_CAN.In_Ana_07_Sts SYSTEM.FMS_CAN.In_Ana_06_Sts SYSTEM.FMS_CAN.In_Ana_05_Sts SYSTEM.FMS_CAN.In_Ana_04_Sts SYSTEM.FMS_CAN.In_Ana_03_Sts SYSTEM.FMS_CAN.In_Ana_02_Sts SYSTEM.FMS_CAN.In_Ana_01_Sts SYSTEM.FMS_CAN.In_Freq_01_Sts SYSTEM.FMS_CAN.BSG_Expansion_Sts SYSTEM.FMS_CAN.PWR_G5_Sts SYSTEM.FMS_CAN.PWR_G4_Sts SYSTEM.FMS_CAN.PWR_G3_Sts SYSTEM.FMS_CAN.PWR_G2_Sts SYSTEM.FMS_CAN.PWR_G1_Sts SYSTEM.FMS_CAN.PWR_Sts SYSTEM.FMS_CAN.In_Dig_22_Sts SYSTEM.FMS_CAN.In_Dig_21_Sts SYSTEM.FMS_CAN.In_Dig_20_Sts SYSTEM.FMS_CAN.In_Dig_19_Sts SYSTEM.FMS_CAN.In_Dig_18_Sts SYSTEM.FMS_CAN.In_Dig_17_Sts SYSTEM.FMS_CAN.In_Dig_16_Sts SYSTEM.FMS_CAN.In_Dig_15_Sts SYSTEM.FMS_CAN.In_Dig_14_Sts SYSTEM.FMS_CAN.In_Dig_13_Sts SYSTEM.FMS_CAN.In_Dig_12_Sts SYSTEM.FMS_CAN.In_Dig_11_Sts SYSTEM.FMS_CAN.In_Dig_10_Sts SYSTEM.FMS_CAN.In_Dig_09_Sts SYSTEM.FMS_CAN.In_Dig_08_Sts SYSTEM.FMS_CAN.In_Dig_07_Sts SYSTEM.FMS_CAN.In_Dig_06_Sts SYSTEM.FMS_CAN.In_Dig_05_Sts SYSTEM.FMS_CAN.In_Dig_04_Sts SYSTEM.FMS_CAN.In_Dig_03_Sts SYSTEM.FMS_CAN.In_Dig_02_Sts SYSTEM.FMS_CAN.In_Dig_01_Sts SYSTEM.FMS_CAN.Out_Supply_ANA_01_Sts SYSTEM.FMS_CAN.Out_34_Sts SYSTEM.FMS_CAN.Out_33_Sts SYSTEM.FMS_CAN.Out_32_Sts SYSTEM.FMS_CAN.Out_31_Sts SYSTEM.FMS_CAN.Out_30_Sts SYSTEM.FMS_CAN.Out_29_Sts SYSTEM.FMS_CAN.Out_28_Sts SYSTEM.FMS_CAN.Out_27_Sts SYSTEM.FMS_CAN.Out_26_Sts SYSTEM.FMS_CAN.Out_25_Sts SYSTEM.FMS_CAN.Out_24_Sts SYSTEM.FMS_CAN.Out_23_Sts SYSTEM.FMS_CAN.Out_22_Sts SYSTEM.FMS_CAN.Out_21_Sts SYSTEM.FMS_CAN.Out_20_Sts SYSTEM.FMS_CAN.Out_19_Sts SYSTEM.FMS_CAN.Out_18_Sts SYSTEM.FMS_CAN.Out_17_Sts SYSTEM.FMS_CAN.Out_16_Sts SYSTEM.FMS_CAN.Out_15_Sts SYSTEM.FMS_CAN.Out_14_Sts SYSTEM.FMS_CAN.Out_13_Sts SYSTEM.FMS_CAN.Out_12_Sts SYSTEM.FMS_CAN.Out_11_Sts SYSTEM.FMS_CAN.Out_10_Sts SYSTEM.FMS_CAN.Out_09_Sts SYSTEM.FMS_CAN.Out_08_Sts SYSTEM.FMS_CAN.Out_07_Sts SYSTEM.FMS_CAN.Out_06_Sts SYSTEM.FMS_CAN.Out_05_Sts SYSTEM.FMS_CAN.Out_04_Sts SYSTEM.FMS_CAN.Out_03_Sts SYSTEM.FMS_CAN.Out_02_Sts SYSTEM.FMS_CAN.Out_01_Sts SYSTEM.FMS_CAN.Out_21_TD_Sts SYSTEM.FMS_CAN.GW_00000FF5 /end SUB_GROUP
 /begin REF_MEASUREMENT OUT_FMSCAN.MessageForwardingEnable.Task2 /end REF_MEASUREMENT
/end GROUP
/begin GROUP SYSTEM.DR_CAN.GW_00000FF6 "GW_00000FF6"
 /begin ANNOTATION ANNOTATION_LABEL "Instance" ANNOTATION_ORIGIN "Group" /begin ANNOTATION_TEXT "0" /end ANNOTATION_TEXT /end ANNOTATION
 /begin ANNOTATION ANNOTATION_LABEL "TaskCycleTime" ANNOTATION_ORIGIN "Group" /begin ANNOTATION_TEXT "0" /end ANNOTATION_TEXT /end ANNOTATION
 /begin ANNOTATION ANNOTATION_LABEL "TimeResolution" ANNOTATION_ORIGIN "Group" /begin ANNOTATION_TEXT "0" /end ANNOTATION_TEXT /end ANNOTATION
 /begin REF_MEASUREMENT OUT_DRCAN.GW_00000FF6.MessageEnable.Task2 /end REF_MEASUREMENT
/end GROUP
/begin GROUP SYSTEM.DR_CAN "DR-CAN"
 /begin ANNOTATION ANNOTATION_LABEL "Instance" ANNOTATION_ORIGIN "Group" /begin ANNOTATION_TEXT "0" /end ANNOTATION_TEXT /end ANNOTATION
 /begin ANNOTATION ANNOTATION_LABEL "TaskCycleTime" ANNOTATION_ORIGIN "Group" /begin ANNOTATION_TEXT "0" /end ANNOTATION_TEXT /end ANNOTATION
 /begin ANNOTATION ANNOTATION_LABEL "TimeResolution" ANNOTATION_ORIGIN "Group" /begin ANNOTATION_TEXT "0" /end ANNOTATION_TEXT /end ANNOTATION
 /begin SUB_GROUP SYSTEM.DR_CAN.GW_00000FF6 /end SUB_GROUP
 /begin REF_MEASUREMENT OUT_DRCAN.MessageForwardingEnable.Task2 /end REF_MEASUREMENT
/end GROUP
/begin GROUP SYSTEM.H_CAN.GW_00000FF7 "GW_00000FF7"
 /begin ANNOTATION ANNOTATION_LABEL "Instance" ANNOTATION_ORIGIN "Group" /begin ANNOTATION_TEXT "0" /end ANNOTATION_TEXT /end ANNOTATION
 /begin ANNOTATION ANNOTATION_LABEL "TaskCycleTime" ANNOTATION_ORIGIN "Group" /begin ANNOTATION_TEXT "0" /end ANNOTATION_TEXT /end ANNOTATION
 /begin ANNOTATION ANNOTATION_LABEL "TimeResolution" ANNOTATION_ORIGIN "Group" /begin ANNOTATION_TEXT "0" /end ANNOTATION_TEXT /end ANNOTATION
 /begin REF_MEASUREMENT OUT_HCAN.GW_00000FF7.MessageEnable.Task2 /end REF_MEASUREMENT
/end GROUP
/begin GROUP SYSTEM.H_CAN "H-CAN"
 /begin ANNOTATION ANNOTATION_LABEL "Instance" ANNOTATION_ORIGIN "Group" /begin ANNOTATION_TEXT "0" /end ANNOTATION_TEXT /end ANNOTATION
 /begin ANNOTATION ANNOTATION_LABEL "TaskCycleTime" ANNOTATION_ORIGIN "Group" /begin ANNOTATION_TEXT "0" /end ANNOTATION_TEXT /end ANNOTATION
 /begin ANNOTATION ANNOTATION_LABEL "TimeResolution" ANNOTATION_ORIGIN "Group" /begin ANNOTATION_TEXT "0" /end ANNOTATION_TEXT /end ANNOTATION
 /begin SUB_GROUP SYSTEM.H_CAN.GW_00000FF7 /end SUB_GROUP
 /begin REF_MEASUREMENT OUT_HCAN.MessageForwardingEnable.Task2 /end REF_MEASUREMENT
/end GROUP
/begin GROUP SYSTEM.LIN_01.A_NodeDNR.A_NodeMFL__MFL_BtnInfo "A_NodeMFL__MFL_BtnInfo"
 /begin ANNOTATION ANNOTATION_LABEL "Instance" ANNOTATION_ORIGIN "Group" /begin ANNOTATION_TEXT "1" /end ANNOTATION_TEXT /end ANNOTATION
 /begin ANNOTATION ANNOTATION_LABEL "TaskCycleTime" ANNOTATION_ORIGIN "Group" /begin ANNOTATION_TEXT "0" /end ANNOTATION_TEXT /end ANNOTATION
 /begin ANNOTATION ANNOTATION_LABEL "TimeResolution" ANNOTATION_ORIGIN "Group" /begin ANNOTATION_TEXT "0" /end ANNOTATION_TEXT /end ANNOTATION
 /begin REF_MEASUREMENT IN_NodeMFL.MFL_BtnInfo.DeviceState.Task5 IN_NodeMFL.MFL_BtnInfo.MFL_BtnInfo_Btn1.Task5 IN_NodeMFL.MFL_BtnInfo.MFL_BtnInfo_Btn10.Task5 IN_NodeMFL.MFL_BtnInfo.MFL_BtnInfo_Btn2.Task5 IN_NodeMFL.MFL_BtnInfo.MFL_BtnInfo_Btn3.Task5 IN_NodeMFL.MFL_BtnInfo.MFL_BtnInfo_Btn3LPress.Task5 IN_NodeMFL.MFL_BtnInfo.MFL_BtnInfo_Btn3SPress.Task5 IN_NodeMFL.MFL_BtnInfo.MFL_BtnInfo_Btn4.Task5 IN_NodeMFL.MFL_BtnInfo.MFL_BtnInfo_Btn4LPress.Task5 IN_NodeMFL.MFL_BtnInfo.MFL_BtnInfo_Btn4SPress.Task5 IN_NodeMFL.MFL_BtnInfo.MFL_BtnInfo_Btn5.Task5 IN_NodeMFL.MFL_BtnInfo.MFL_BtnInfo_Btn5LPress.Task5 IN_NodeMFL.MFL_BtnInfo.MFL_BtnInfo_Btn5SPress.Task5 IN_NodeMFL.MFL_BtnInfo.MFL_BtnInfo_Btn6.Task5 IN_NodeMFL.MFL_BtnInfo.MFL_BtnInfo_Btn7.Task5 IN_NodeMFL.MFL_BtnInfo.MFL_BtnInfo_Btn8.Task5 IN_NodeMFL.MFL_BtnInfo.MFL_BtnInfo_Btn9.Task5 IN_NodeMFL.MFL_BtnInfo.MFL_BtnInfo_ErrorLoc.Task5 IN_NodeMFL.MFL_BtnInfo.MFL_BtnInfo_ErrorType.Task5 IN_NodeMFL.MFL_BtnInfo.MFL_BtnInfo_MsgCounter.Task5 /end REF_MEASUREMENT
/end GROUP
/begin GROUP SYSTEM.LIN_01.A_NodeDNR.A_NodeDNR__DNR_Position "A_NodeDNR__DNR_Position"
 /begin ANNOTATION ANNOTATION_LABEL "Instance" ANNOTATION_ORIGIN "Group" /begin ANNOTATION_TEXT "0" /end ANNOTATION_TEXT /end ANNOTATION
 /begin ANNOTATION ANNOTATION_LABEL "TaskCycleTime" ANNOTATION_ORIGIN "Group" /begin ANNOTATION_TEXT "0" /end ANNOTATION_TEXT /end ANNOTATION
 /begin ANNOTATION ANNOTATION_LABEL "TimeResolution" ANNOTATION_ORIGIN "Group" /begin ANNOTATION_TEXT "0" /end ANNOTATION_TEXT /end ANNOTATION
 /begin REF_MEASUREMENT IN_NodeDNR.DNR_Position.DeviceState.Task5 IN_NodeDNR.DNR_Position.DNR_Position_D1.Task5 IN_NodeDNR.DNR_Position.DNR_Position_D4.Task5 IN_NodeDNR.DNR_Position.DNR_Position_D7.Task5 IN_NodeDNR.DNR_Position.DNR_Position_DM.Task5 IN_NodeDNR.DNR_Position.DNR_Position_MsgCounter.Task5 IN_NodeDNR.DNR_Position.DNR_Position_N.Task5 IN_NodeDNR.DNR_Position.DNR_Position_R1.Task5 IN_NodeDNR.DNR_Position.DNR_Position_RM.Task5 IN_NodeDNR.DNR_Position.DNR_Position_SwitchStatus.Task5 /end REF_MEASUREMENT
/end GROUP
/begin GROUP SYSTEM.LIN_01.A_NodeDNR.A_Tester_1__BSG_STATUS "A_Tester_1__BSG_STATUS"
 /begin ANNOTATION ANNOTATION_LABEL "Instance" ANNOTATION_ORIGIN "Group" /begin ANNOTATION_TEXT "1" /end ANNOTATION_TEXT /end ANNOTATION
 /begin ANNOTATION ANNOTATION_LABEL "TaskCycleTime" ANNOTATION_ORIGIN "Group" /begin ANNOTATION_TEXT "0" /end ANNOTATION_TEXT /end ANNOTATION
 /begin ANNOTATION ANNOTATION_LABEL "TimeResolution" ANNOTATION_ORIGIN "Group" /begin ANNOTATION_TEXT "0" /end ANNOTATION_TEXT /end ANNOTATION
 /begin REF_MEASUREMENT OUT_Tester_1.BSG_STATUS.BatteryVoltage.Task5 OUT_Tester_1.BSG_STATUS.Button_KL15.Task5 OUT_Tester_1.BSG_STATUS.Voltage_Normal.Task5 OUT_Tester_1.BSG_STATUS.Voltage_OV1.Task5 OUT_Tester_1.BSG_STATUS.Voltage_OV2.Task5 OUT_Tester_1.BSG_STATUS.Voltage_UV1.Task5 OUT_Tester_1.BSG_STATUS.Voltage_UV2.Task5 /end REF_MEASUREMENT
/end GROUP
/begin GROUP SYSTEM.LIN_01.A_NodeDNR "A_NodeDNR"
 /begin ANNOTATION ANNOTATION_LABEL "Instance" ANNOTATION_ORIGIN "Group" /begin ANNOTATION_TEXT "0" /end ANNOTATION_TEXT /end ANNOTATION
 /begin ANNOTATION ANNOTATION_LABEL "TaskCycleTime" ANNOTATION_ORIGIN "Group" /begin ANNOTATION_TEXT "0" /end ANNOTATION_TEXT /end ANNOTATION
 /begin ANNOTATION ANNOTATION_LABEL "TimeResolution" ANNOTATION_ORIGIN "Group" /begin ANNOTATION_TEXT "0" /end ANNOTATION_TEXT /end ANNOTATION
 /begin SUB_GROUP SYSTEM.LIN_01.A_NodeDNR.A_NodeMFL__MFL_BtnInfo SYSTEM.LIN_01.A_NodeDNR.A_NodeDNR__DNR_Position SYSTEM.LIN_01.A_NodeDNR.A_Tester_1__BSG_STATUS /end SUB_GROUP
/end GROUP
/begin GROUP SYSTEM.LIN_01 "LIN_01"
 /begin ANNOTATION ANNOTATION_LABEL "Instance" ANNOTATION_ORIGIN "Group" /begin ANNOTATION_TEXT "0" /end ANNOTATION_TEXT /end ANNOTATION
 /begin ANNOTATION ANNOTATION_LABEL "TaskCycleTime" ANNOTATION_ORIGIN "Group" /begin ANNOTATION_TEXT "0" /end ANNOTATION_TEXT /end ANNOTATION
 /begin ANNOTATION ANNOTATION_LABEL "TimeResolution" ANNOTATION_ORIGIN "Group" /begin ANNOTATION_TEXT "0" /end ANNOTATION_TEXT /end ANNOTATION
 /begin SUB_GROUP SYSTEM.LIN_01.A_NodeDNR /end SUB_GROUP
 /begin REF_MEASUREMENT OUT_LIN_01.LinNetworkRequest1.Task5 OUT_LIN_01.ScheduleTable.Task5 /end REF_MEASUREMENT
/end GROUP
/begin GROUP SYSTEM.TSUD "TSUD"
 /begin ANNOTATION ANNOTATION_LABEL "Instance" ANNOTATION_ORIGIN "Group" /begin ANNOTATION_TEXT "0" /end ANNOTATION_TEXT /end ANNOTATION
 /begin ANNOTATION ANNOTATION_LABEL "TaskCycleTime" ANNOTATION_ORIGIN "Group" /begin ANNOTATION_TEXT "0" /end ANNOTATION_TEXT /end ANNOTATION
 /begin ANNOTATION ANNOTATION_LABEL "TimeResolution" ANNOTATION_ORIGIN "Group" /begin ANNOTATION_TEXT "0" /end ANNOTATION_TEXT /end ANNOTATION
 /begin REF_MEASUREMENT IN_TSUD.ShaftSpeed.Task5 IN_TSUD.VehicleSpeed.Task5 OUT_TSUD.DeviceEnable.Task5 OUT_TSUD.SetDiagWriteOdoResponse.Task5 DIAG_TSUD.ShaftSpeed_DIAG.Task5 DIAG_TSUD.VehicleSpeed_DIAG.Task5 /end REF_MEASUREMENT
/end GROUP
/begin GROUP SYSTEM.Inertian_Sensor.Accelerometer "Accelerometer"
 /begin ANNOTATION ANNOTATION_LABEL "Instance" ANNOTATION_ORIGIN "Group" /begin ANNOTATION_TEXT "0" /end ANNOTATION_TEXT /end ANNOTATION
 /begin ANNOTATION ANNOTATION_LABEL "TaskCycleTime" ANNOTATION_ORIGIN "Group" /begin ANNOTATION_TEXT "0" /end ANNOTATION_TEXT /end ANNOTATION
 /begin ANNOTATION ANNOTATION_LABEL "TimeResolution" ANNOTATION_ORIGIN "Group" /begin ANNOTATION_TEXT "0" /end ANNOTATION_TEXT /end ANNOTATION
 /begin REF_MEASUREMENT IN_InertianSensor.Accelerometer.Ax.Task5 IN_InertianSensor.Accelerometer.Ay.Task5 IN_InertianSensor.Accelerometer.Az.Task5 OUT_InertianSensor.Accelerometer.DeviceEnable.Task5 /end REF_MEASUREMENT
/end GROUP
/begin GROUP SYSTEM.Inertian_Sensor "Inertian Sensor"
 /begin ANNOTATION ANNOTATION_LABEL "Instance" ANNOTATION_ORIGIN "Group" /begin ANNOTATION_TEXT "0" /end ANNOTATION_TEXT /end ANNOTATION
 /begin ANNOTATION ANNOTATION_LABEL "TaskCycleTime" ANNOTATION_ORIGIN "Group" /begin ANNOTATION_TEXT "0" /end ANNOTATION_TEXT /end ANNOTATION
 /begin ANNOTATION ANNOTATION_LABEL "TimeResolution" ANNOTATION_ORIGIN "Group" /begin ANNOTATION_TEXT "0" /end ANNOTATION_TEXT /end ANNOTATION
 /begin SUB_GROUP SYSTEM.Inertian_Sensor.Accelerometer /end SUB_GROUP
/end GROUP
/begin GROUP SYSTEM.Lin_Slave "Lin Slave"
 /begin ANNOTATION ANNOTATION_LABEL "Instance" ANNOTATION_ORIGIN "Group" /begin ANNOTATION_TEXT "0" /end ANNOTATION_TEXT /end ANNOTATION
 /begin ANNOTATION ANNOTATION_LABEL "TaskCycleTime" ANNOTATION_ORIGIN "Group" /begin ANNOTATION_TEXT "0" /end ANNOTATION_TEXT /end ANNOTATION
 /begin ANNOTATION ANNOTATION_LABEL "TimeResolution" ANNOTATION_ORIGIN "Group" /begin ANNOTATION_TEXT "0" /end ANNOTATION_TEXT /end ANNOTATION
 /begin REF_MEASUREMENT IN_LinSlave.DeviceState.Task5 OUT_LinSlave.SetFrameLss1B.Task5 OUT_LinSlave.SetFrameMlfB.Task5 OUT_LinSlave.WakeupRequest.Task5 /end REF_MEASUREMENT
/end GROUP
/begin GROUP SYSTEM "SYSTEM"
 /begin ANNOTATION ANNOTATION_LABEL "Instance" ANNOTATION_ORIGIN "Group" /begin ANNOTATION_TEXT "0" /end ANNOTATION_TEXT /end ANNOTATION
 /begin ANNOTATION ANNOTATION_LABEL "TaskCycleTime" ANNOTATION_ORIGIN "Group" /begin ANNOTATION_TEXT "0" /end ANNOTATION_TEXT /end ANNOTATION
 /begin ANNOTATION ANNOTATION_LABEL "TimeResolution" ANNOTATION_ORIGIN "Group" /begin ANNOTATION_TEXT "0" /end ANNOTATION_TEXT /end ANNOTATION
 /begin SUB_GROUP SYSTEM.Date_and_Time SYSTEM.MCAN_Master SYSTEM.Model_Control SYSTEM.Analog_Inputs__PWR_ SYSTEM.Analog_Inputs SYSTEM.Analog_Supply SYSTEM.Analog_Inputs__Coolant_ SYSTEM.Analog_Inputs__OUT_FREQ_feedback_ SYSTEM.Digital_Inputs SYSTEM.Digital_Outputs__STATIC_ SYSTEM.Digital_Output__PWM_ SYSTEM.NVM SYSTEM.RAM_Device SYSTEM.DEM_Diagnostic_Event_Manager SYSTEM.D_CAN SYSTEM.A_CAN SYSTEM.P_CAN SYSTEM.I_CAN SYSTEM.FMS_CAN SYSTEM.DR_CAN SYSTEM.H_CAN SYSTEM.LIN_01 SYSTEM.TSUD SYSTEM.Inertian_Sensor SYSTEM.Lin_Slave /end SUB_GROUP
/end GROUP
/begin GROUP PROCESSIMAGE "PROCESSIMAGE" ROOT
 /begin ANNOTATION ANNOTATION_LABEL "Instance" ANNOTATION_ORIGIN "Group" /begin ANNOTATION_TEXT "0" /end ANNOTATION_TEXT /end ANNOTATION
 /begin ANNOTATION ANNOTATION_LABEL "TaskCycleTime" ANNOTATION_ORIGIN "Group" /begin ANNOTATION_TEXT "0" /end ANNOTATION_TEXT /end ANNOTATION
 /begin ANNOTATION ANNOTATION_LABEL "TimeResolution" ANNOTATION_ORIGIN "Group" /begin ANNOTATION_TEXT "0" /end ANNOTATION_TEXT /end ANNOTATION
 /begin SUB_GROUP SYSTEM /end SUB_GROUP
/end GROUP
/begin GROUP NVMPARAMETER.Parameter "Parameter"
 /begin ANNOTATION ANNOTATION_LABEL "Instance" ANNOTATION_ORIGIN "Group" /begin ANNOTATION_TEXT "0" /end ANNOTATION_TEXT /end ANNOTATION
 /begin ANNOTATION ANNOTATION_LABEL "TaskCycleTime" ANNOTATION_ORIGIN "Group" /begin ANNOTATION_TEXT "0" /end ANNOTATION_TEXT /end ANNOTATION
 /begin ANNOTATION ANNOTATION_LABEL "TimeResolution" ANNOTATION_ORIGIN "Group" /begin ANNOTATION_TEXT "0" /end ANNOTATION_TEXT /end ANNOTATION
 /begin REF_CHARACTERISTIC HBrakeTime HOpenLoadDetectTime HMaxActivationTimeTime HOpenLoadIntervalTime ModelHoldMinTimeAfterPOR BlinkSourcePeriod TrailerDetectionTime /end REF_CHARACTERISTIC
/end GROUP
/begin GROUP NVMPARAMETER "NVMPARAMETER" ROOT
 /begin ANNOTATION ANNOTATION_LABEL "Instance" ANNOTATION_ORIGIN "Group" /begin ANNOTATION_TEXT "0" /end ANNOTATION_TEXT /end ANNOTATION
 /begin ANNOTATION ANNOTATION_LABEL "TaskCycleTime" ANNOTATION_ORIGIN "Group" /begin ANNOTATION_TEXT "0" /end ANNOTATION_TEXT /end ANNOTATION
 /begin ANNOTATION ANNOTATION_LABEL "TimeResolution" ANNOTATION_ORIGIN "Group" /begin ANNOTATION_TEXT "0" /end ANNOTATION_TEXT /end ANNOTATION
 /begin SUB_GROUP NVMPARAMETER.Parameter /end SUB_GROUP
/end GROUP
/begin COMPU_METHOD COMP_DEFAULT "" RAT_FUNC "%11.5" "Increments" COEFFS 0 1 0 0 0 1 /end COMPU_METHOD
/begin COMPU_METHOD IS_BOOLEAN_TRUE "" RAT_FUNC "%11.5" "" COEFFS 0 1 0 0 0 1 /end COMPU_METHOD
/begin COMPU_METHOD COMP_LINEAR.HBrakeTime "" RAT_FUNC "%11.5" "" COEFFS 0 1 0 0 0 0.05 /end COMPU_METHOD
/begin COMPU_METHOD COMP_LINEAR.HOpenLoadDetectTime "" RAT_FUNC "%11.5" "" COEFFS 0 1 0 0 0 0.05 /end COMPU_METHOD
/begin COMPU_METHOD COMP_LINEAR.HMaxActivationTimeTime "" RAT_FUNC "%11.5" "" COEFFS 0 1 0 0 0 0.05 /end COMPU_METHOD
/begin COMPU_METHOD COMP_LINEAR.HOpenLoadIntervalTime "" RAT_FUNC "%11.5" "" COEFFS 0 1 0 0 0 0.05 /end COMPU_METHOD
/begin COMPU_METHOD COMP_LINEAR.ModelHoldMinTimeAfterPOR "" RAT_FUNC "%11.5" "" COEFFS 0 1 0 0 0 0.1 /end COMPU_METHOD
/begin COMPU_METHOD COMP_LINEAR.BlinkSourcePeriod "" RAT_FUNC "%11.5" "" COEFFS 0 1 0 0 0 0.04 /end COMPU_METHOD
/begin COMPU_METHOD COMP_LINEAR.TrailerDetectionTime "" RAT_FUNC "%11.5" "" COEFFS 0 1 0 0 0 0.02 /end COMPU_METHOD
/begin COMPU_VTAB MFL_BtnInfo_Btn_Encoding ". " TAB_VERB 2 0 "MFL_BtnInfo_Btn_Encoding__Inactive" 1 "MFL_BtnInfo_Btn_Encoding__Active" /end COMPU_VTAB
/begin COMPU_VTAB MFL_BtnInfo_ErrorLoc_Encoding ". " TAB_VERB 3 10 "MFL_BtnInfo_ErrorLoc_Encoding__MFL_right_and_left_out_of_order" 2 "MFL_BtnInfo_ErrorLoc_Encoding__MFL_right_out_of_order" 8 "MFL_BtnInfo_ErrorLoc_Encoding__MFL_left_out_of_order" /end COMPU_VTAB
/begin COMPU_VTAB MFL_BtnInfo_ErrorType_Encoding ". " TAB_VERB 1 15 "MFL_BtnInfo_ErrorType_Encoding__Not_Available" /end COMPU_VTAB
/begin RECORD_LAYOUT LC_A_UINT16 FNC_VALUES 1 UWORD ROW_DIR DIRECT /end RECORD_LAYOUT
/begin RECORD_LAYOUT LC_A_UINT8 FNC_VALUES 1 UBYTE ROW_DIR DIRECT /end RECORD_LAYOUT
/end MODULE
/end PROJECT
