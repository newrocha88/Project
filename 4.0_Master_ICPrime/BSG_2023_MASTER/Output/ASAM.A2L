ASAP2_VERSION 1 7
/begin PROJECT BSG_2023_MASTER "BSG_EVO_Master_MBDS_BSG_2023_MASTER"
/begin HEADER "D:\SDBox_MAN_Master_Expansion\Master_ICPrime\BSG_2023_MASTER" VERSION "8.27.01.01_1210" PROJECT_NO _245850671 /end HEADER
/begin MODULE BSG_2023_MASTER "D:\SDBox_MAN_Master_Expansion\Master_ICPrime\BSG_2023_MASTER"
/begin MOD_COMMON "" BYTE_ORDER MSB_LAST /end MOD_COMMON
/begin MEASUREMENT OUT_PCAN.Tx_Out.Out_06_TD_Sts.Out_SENSE_PULSE.Task3 "" UWORD COMP_DEFAULT 0 0 0 0 ECU_ADDRESS 0x204A064 READ_WRITE /end MEASUREMENT
/begin MEASUREMENT OUT_PCAN.Tx_Out.Out_06_TD_Sts.Out_SENSE_PULSE_DIAG.Task3 "" UWORD COMP_DEFAULT 0 0 0 0 ECU_ADDRESS 0x204A066 READ_WRITE /end MEASUREMENT
/begin MEASUREMENT OUT_PCAN.Tx_Out.Out_06_TD_Sts.MessageEnable.Task3 "3.3.2.2.1 MessageEnable" UBYTE IS_BOOLEAN_TRUE 0 0 0 1 ECU_ADDRESS 0x204A068 READ_WRITE /end MEASUREMENT
/begin MEASUREMENT OUT_PCAN.Tx_Out.Out_04_TD_Sts.Out_SENSE_PULSE.Task3 "" UWORD COMP_DEFAULT 0 0 0 0 ECU_ADDRESS 0x204A06A READ_WRITE /end MEASUREMENT
/begin MEASUREMENT OUT_PCAN.Tx_Out.Out_04_TD_Sts.Out_SENSE_PULSE_DIAG.Task3 "" UWORD COMP_DEFAULT 0 0 0 0 ECU_ADDRESS 0x204A06C READ_WRITE /end MEASUREMENT
/begin MEASUREMENT OUT_PCAN.Tx_Out.Out_04_TD_Sts.MessageEnable.Task3 "3.3.2.2.1 MessageEnable" UBYTE IS_BOOLEAN_TRUE 0 0 0 1 ECU_ADDRESS 0x204A06E READ_WRITE /end MEASUREMENT
/begin MEASUREMENT OUT_PCAN.Tx_Out.Out_01_TD_Sts.Out_SENSE_PULSE.Task3 "" UWORD COMP_DEFAULT 0 0 0 0 ECU_ADDRESS 0x204A070 READ_WRITE /end MEASUREMENT
/begin MEASUREMENT OUT_PCAN.Tx_Out.Out_01_TD_Sts.Out_SENSE_PULSE_DIAG.Task3 "" UWORD COMP_DEFAULT 0 0 0 0 ECU_ADDRESS 0x204A072 READ_WRITE /end MEASUREMENT
/begin MEASUREMENT OUT_PCAN.Tx_Out.Out_01_TD_Sts.MessageEnable.Task3 "3.3.2.2.1 MessageEnable" UBYTE IS_BOOLEAN_TRUE 0 0 0 1 ECU_ADDRESS 0x204A074 READ_WRITE /end MEASUREMENT
/begin MEASUREMENT OUT_PCAN.Tx_Date.DateTime_SetTime_Sts.DateTime_DIAG.Task5 "" UWORD COMP_DEFAULT 0 0 0 65535 ECU_ADDRESS 0x204C010 READ_WRITE /end MEASUREMENT
/begin MEASUREMENT OUT_PCAN.Tx_Date.DateTime_SetTime_Sts.MessageEnable.Task5 "3.3.2.2.1 MessageEnable" UBYTE IS_BOOLEAN_TRUE 0 0 0 1 ECU_ADDRESS 0x204C012 READ_WRITE /end MEASUREMENT
/begin MEASUREMENT OUT_PCAN.Tx_Date.DateTime_TicksCount_Sts.DateTime_TicksCount.Task5 "" ULONG COMP_DEFAULT 0 0 0 4294967295 ECU_ADDRESS 0x204C014 READ_WRITE /end MEASUREMENT
/begin MEASUREMENT OUT_PCAN.Tx_Date.DateTime_TicksCount_Sts.MessageEnable.Task5 "3.3.2.2.1 MessageEnable" UBYTE IS_BOOLEAN_TRUE 0 0 0 1 ECU_ADDRESS 0x204C018 READ_WRITE /end MEASUREMENT
/begin MEASUREMENT OUT_PCAN.Tx_Date.DateTime_SystemTime_Sts.DateTime_SystemTime.Task5 "" ULONG COMP_DEFAULT 0 0 0 4294967295 ECU_ADDRESS 0x204C01C READ_WRITE /end MEASUREMENT
/begin MEASUREMENT OUT_PCAN.Tx_Date.DateTime_SystemTime_Sts.DateTime_DIAG.Task5 "" UWORD COMP_DEFAULT 0 0 0 65535 ECU_ADDRESS 0x204C020 READ_WRITE /end MEASUREMENT
/begin MEASUREMENT OUT_PCAN.Tx_Date.DateTime_SystemTime_Sts.MessageEnable.Task5 "3.3.2.2.1 MessageEnable" UBYTE IS_BOOLEAN_TRUE 0 0 0 1 ECU_ADDRESS 0x204C022 READ_WRITE /end MEASUREMENT
/begin MEASUREMENT OUT_PCAN.Tx_Date.DateTime_LocalTime_Sts.DateTime_LocalTime.Task5 "" ULONG COMP_DEFAULT 0 0 0 4294967295 ECU_ADDRESS 0x204C024 READ_WRITE /end MEASUREMENT
/begin MEASUREMENT OUT_PCAN.Tx_Date.DateTime_LocalTime_Sts.DateTime_DIAG.Task5 "" UWORD COMP_DEFAULT 0 0 0 65535 ECU_ADDRESS 0x204C028 READ_WRITE /end MEASUREMENT
/begin MEASUREMENT OUT_PCAN.Tx_Date.DateTime_LocalTime_Sts.MessageEnable.Task5 "3.3.2.2.1 MessageEnable" UBYTE IS_BOOLEAN_TRUE 0 0 0 1 ECU_ADDRESS 0x204C02A READ_WRITE /end MEASUREMENT
/begin MEASUREMENT OUT_PCAN.Tx_Ana.IN_ANA_11_SEL2_Sts.IN_ANA_Val.Task3 "" ULONG COMP_DEFAULT 0 0 0 4294967295 ECU_ADDRESS 0x204A078 READ_WRITE /end MEASUREMENT
/begin MEASUREMENT OUT_PCAN.Tx_Ana.IN_ANA_11_SEL2_Sts.IN_ANA_DIAG.Task3 "" UWORD COMP_DEFAULT 0 0 0 65535 ECU_ADDRESS 0x204A07C READ_WRITE /end MEASUREMENT
/begin MEASUREMENT OUT_PCAN.Tx_Ana.IN_ANA_11_SEL2_Sts.MessageEnable.Task3 "3.3.2.2.1 MessageEnable" UBYTE IS_BOOLEAN_TRUE 0 0 0 1 ECU_ADDRESS 0x204A07E READ_WRITE /end MEASUREMENT
/begin MEASUREMENT OUT_PCAN.Tx_Ana.IN_ANA_10_SEL2_Sts.IN_ANA_Val.Task3 "" ULONG COMP_DEFAULT 0 0 0 4294967295 ECU_ADDRESS 0x204A080 READ_WRITE /end MEASUREMENT
/begin MEASUREMENT OUT_PCAN.Tx_Ana.IN_ANA_10_SEL2_Sts.IN_ANA_DIAG.Task3 "" UWORD COMP_DEFAULT 0 0 0 65535 ECU_ADDRESS 0x204A084 READ_WRITE /end MEASUREMENT
/begin MEASUREMENT OUT_PCAN.Tx_Ana.IN_ANA_10_SEL2_Sts.MessageEnable.Task3 "3.3.2.2.1 MessageEnable" UBYTE IS_BOOLEAN_TRUE 0 0 0 1 ECU_ADDRESS 0x204A086 READ_WRITE /end MEASUREMENT
/begin MEASUREMENT OUT_PCAN.Tx_Ana.IN_ANA_09_SEL2_Sts.IN_ANA_Val.Task3 "" ULONG COMP_DEFAULT 0 0 0 4294967295 ECU_ADDRESS 0x204A088 READ_WRITE /end MEASUREMENT
/begin MEASUREMENT OUT_PCAN.Tx_Ana.IN_ANA_09_SEL2_Sts.IN_ANA_DIAG.Task3 "" UWORD COMP_DEFAULT 0 0 0 65535 ECU_ADDRESS 0x204A08C READ_WRITE /end MEASUREMENT
/begin MEASUREMENT OUT_PCAN.Tx_Ana.IN_ANA_09_SEL2_Sts.MessageEnable.Task3 "3.3.2.2.1 MessageEnable" UBYTE IS_BOOLEAN_TRUE 0 0 0 1 ECU_ADDRESS 0x204A08E READ_WRITE /end MEASUREMENT
/begin MEASUREMENT OUT_PCAN.Tx_Ana.IN_ANA_08_SEL2_Sts.IN_ANA_Val.Task3 "" ULONG COMP_DEFAULT 0 0 0 4294967295 ECU_ADDRESS 0x204A090 READ_WRITE /end MEASUREMENT
/begin MEASUREMENT OUT_PCAN.Tx_Ana.IN_ANA_08_SEL2_Sts.IN_ANA_DIAG.Task3 "" UWORD COMP_DEFAULT 0 0 0 65535 ECU_ADDRESS 0x204A094 READ_WRITE /end MEASUREMENT
/begin MEASUREMENT OUT_PCAN.Tx_Ana.IN_ANA_08_SEL2_Sts.MessageEnable.Task3 "3.3.2.2.1 MessageEnable" UBYTE IS_BOOLEAN_TRUE 0 0 0 1 ECU_ADDRESS 0x204A096 READ_WRITE /end MEASUREMENT
/begin MEASUREMENT OUT_PCAN.Tx_Ana.In_Ana_15_Sts.IN_ANA_Val.Task3 "" ULONG COMP_DEFAULT 0 0 0 4294967295 ECU_ADDRESS 0x204A098 READ_WRITE /end MEASUREMENT
/begin MEASUREMENT OUT_PCAN.Tx_Ana.In_Ana_15_Sts.IN_ANA_DIAG.Task3 "" UWORD COMP_DEFAULT 0 0 0 65535 ECU_ADDRESS 0x204A09C READ_WRITE /end MEASUREMENT
/begin MEASUREMENT OUT_PCAN.Tx_Ana.In_Ana_15_Sts.MessageEnable.Task3 "3.3.2.2.1 MessageEnable" UBYTE IS_BOOLEAN_TRUE 0 0 0 1 ECU_ADDRESS 0x204A09E READ_WRITE /end MEASUREMENT
/begin MEASUREMENT OUT_PCAN.Tx_Ana.In_Ana_14_Sts.IN_ANA_Val.Task3 "" ULONG COMP_DEFAULT 0 0 0 4294967295 ECU_ADDRESS 0x204A0A0 READ_WRITE /end MEASUREMENT
/begin MEASUREMENT OUT_PCAN.Tx_Ana.In_Ana_14_Sts.IN_ANA_DIAG.Task3 "" UWORD COMP_DEFAULT 0 0 0 65535 ECU_ADDRESS 0x204A0A4 READ_WRITE /end MEASUREMENT
/begin MEASUREMENT OUT_PCAN.Tx_Ana.In_Ana_14_Sts.MessageEnable.Task3 "3.3.2.2.1 MessageEnable" UBYTE IS_BOOLEAN_TRUE 0 0 0 1 ECU_ADDRESS 0x204A0A6 READ_WRITE /end MEASUREMENT
/begin MEASUREMENT OUT_PCAN.Tx_Ana.In_Ana_13_Sts.IN_ANA_Val.Task3 "" ULONG COMP_DEFAULT 0 0 0 4294967295 ECU_ADDRESS 0x204A0A8 READ_WRITE /end MEASUREMENT
/begin MEASUREMENT OUT_PCAN.Tx_Ana.In_Ana_13_Sts.IN_ANA_DIAG.Task3 "" UWORD COMP_DEFAULT 0 0 0 65535 ECU_ADDRESS 0x204A0AC READ_WRITE /end MEASUREMENT
/begin MEASUREMENT OUT_PCAN.Tx_Ana.In_Ana_13_Sts.MessageEnable.Task3 "3.3.2.2.1 MessageEnable" UBYTE IS_BOOLEAN_TRUE 0 0 0 1 ECU_ADDRESS 0x204A0AE READ_WRITE /end MEASUREMENT
/begin MEASUREMENT OUT_PCAN.Tx_Ana.In_Ana_12_Sts.IN_ANA_Val.Task3 "" ULONG COMP_DEFAULT 0 0 0 4294967295 ECU_ADDRESS 0x204A0B0 READ_WRITE /end MEASUREMENT
/begin MEASUREMENT OUT_PCAN.Tx_Ana.In_Ana_12_Sts.IN_ANA_DIAG.Task3 "" UWORD COMP_DEFAULT 0 0 0 65535 ECU_ADDRESS 0x204A0B4 READ_WRITE /end MEASUREMENT
/begin MEASUREMENT OUT_PCAN.Tx_Ana.In_Ana_12_Sts.MessageEnable.Task3 "3.3.2.2.1 MessageEnable" UBYTE IS_BOOLEAN_TRUE 0 0 0 1 ECU_ADDRESS 0x204A0B6 READ_WRITE /end MEASUREMENT
/begin MEASUREMENT OUT_PCAN.Tx_Ana.IN_ANA_11_SEL1_Sts.IN_ANA_Val.Task3 "" ULONG COMP_DEFAULT 0 0 0 4294967295 ECU_ADDRESS 0x204A0B8 READ_WRITE /end MEASUREMENT
/begin MEASUREMENT OUT_PCAN.Tx_Ana.IN_ANA_11_SEL1_Sts.IN_ANA_DIAG.Task3 "" UWORD COMP_DEFAULT 0 0 0 65535 ECU_ADDRESS 0x204A0BC READ_WRITE /end MEASUREMENT
/begin MEASUREMENT OUT_PCAN.Tx_Ana.IN_ANA_11_SEL1_Sts.MessageEnable.Task3 "3.3.2.2.1 MessageEnable" UBYTE IS_BOOLEAN_TRUE 0 0 0 1 ECU_ADDRESS 0x204A0BE READ_WRITE /end MEASUREMENT
/begin MEASUREMENT OUT_PCAN.Tx_Ana.IN_ANA_10_SEL1_Sts.IN_ANA_Val.Task3 "" ULONG COMP_DEFAULT 0 0 0 4294967295 ECU_ADDRESS 0x204A0C0 READ_WRITE /end MEASUREMENT
/begin MEASUREMENT OUT_PCAN.Tx_Ana.IN_ANA_10_SEL1_Sts.IN_ANA_DIAG.Task3 "" UWORD COMP_DEFAULT 0 0 0 65535 ECU_ADDRESS 0x204A0C4 READ_WRITE /end MEASUREMENT
/begin MEASUREMENT OUT_PCAN.Tx_Ana.IN_ANA_10_SEL1_Sts.MessageEnable.Task3 "3.3.2.2.1 MessageEnable" UBYTE IS_BOOLEAN_TRUE 0 0 0 1 ECU_ADDRESS 0x204A0C6 READ_WRITE /end MEASUREMENT
/begin MEASUREMENT OUT_PCAN.Tx_Ana.IN_ANA_09_SEL1_Sts.IN_ANA_Val.Task3 "" ULONG COMP_DEFAULT 0 0 0 4294967295 ECU_ADDRESS 0x204A0C8 READ_WRITE /end MEASUREMENT
/begin MEASUREMENT OUT_PCAN.Tx_Ana.IN_ANA_09_SEL1_Sts.IN_ANA_DIAG.Task3 "" UWORD COMP_DEFAULT 0 0 0 65535 ECU_ADDRESS 0x204A0CC READ_WRITE /end MEASUREMENT
/begin MEASUREMENT OUT_PCAN.Tx_Ana.IN_ANA_09_SEL1_Sts.MessageEnable.Task3 "3.3.2.2.1 MessageEnable" UBYTE IS_BOOLEAN_TRUE 0 0 0 1 ECU_ADDRESS 0x204A0CE READ_WRITE /end MEASUREMENT
/begin MEASUREMENT OUT_PCAN.Tx_Ana.IN_ANA_08_SEL1_Sts.IN_ANA_Val.Task3 "" ULONG COMP_DEFAULT 0 0 0 4294967295 ECU_ADDRESS 0x204A0D0 READ_WRITE /end MEASUREMENT
/begin MEASUREMENT OUT_PCAN.Tx_Ana.IN_ANA_08_SEL1_Sts.IN_ANA_DIAG.Task3 "" UWORD COMP_DEFAULT 0 0 0 65535 ECU_ADDRESS 0x204A0D4 READ_WRITE /end MEASUREMENT
/begin MEASUREMENT OUT_PCAN.Tx_Ana.IN_ANA_08_SEL1_Sts.MessageEnable.Task3 "3.3.2.2.1 MessageEnable" UBYTE IS_BOOLEAN_TRUE 0 0 0 1 ECU_ADDRESS 0x204A0D6 READ_WRITE /end MEASUREMENT
/begin MEASUREMENT OUT_PCAN.Tx_Ana.In_Ana_07_Sts.IN_ANA_Val.Task3 "" ULONG COMP_DEFAULT 0 0 0 4294967295 ECU_ADDRESS 0x204A0D8 READ_WRITE /end MEASUREMENT
/begin MEASUREMENT OUT_PCAN.Tx_Ana.In_Ana_07_Sts.IN_ANA_DIAG.Task3 "" UWORD COMP_DEFAULT 0 0 0 65535 ECU_ADDRESS 0x204A0DC READ_WRITE /end MEASUREMENT
/begin MEASUREMENT OUT_PCAN.Tx_Ana.In_Ana_07_Sts.MessageEnable.Task3 "3.3.2.2.1 MessageEnable" UBYTE IS_BOOLEAN_TRUE 0 0 0 1 ECU_ADDRESS 0x204A0DE READ_WRITE /end MEASUREMENT
/begin MEASUREMENT OUT_PCAN.Tx_Ana.In_Ana_06_Sts.IN_ANA_Val.Task3 "" ULONG COMP_DEFAULT 0 0 0 4294967295 ECU_ADDRESS 0x204A0E0 READ_WRITE /end MEASUREMENT
/begin MEASUREMENT OUT_PCAN.Tx_Ana.In_Ana_06_Sts.IN_ANA_DIAG.Task3 "" UWORD COMP_DEFAULT 0 0 0 65535 ECU_ADDRESS 0x204A0E4 READ_WRITE /end MEASUREMENT
/begin MEASUREMENT OUT_PCAN.Tx_Ana.In_Ana_06_Sts.MessageEnable.Task3 "3.3.2.2.1 MessageEnable" UBYTE IS_BOOLEAN_TRUE 0 0 0 1 ECU_ADDRESS 0x204A0E6 READ_WRITE /end MEASUREMENT
/begin MEASUREMENT OUT_PCAN.Tx_Ana.In_Ana_05_Sts.IN_ANA_Val.Task3 "" ULONG COMP_DEFAULT 0 0 0 4294967295 ECU_ADDRESS 0x204A0E8 READ_WRITE /end MEASUREMENT
/begin MEASUREMENT OUT_PCAN.Tx_Ana.In_Ana_05_Sts.IN_ANA_DIAG.Task3 "" UWORD COMP_DEFAULT 0 0 0 65535 ECU_ADDRESS 0x204A0EC READ_WRITE /end MEASUREMENT
/begin MEASUREMENT OUT_PCAN.Tx_Ana.In_Ana_05_Sts.MessageEnable.Task3 "3.3.2.2.1 MessageEnable" UBYTE IS_BOOLEAN_TRUE 0 0 0 1 ECU_ADDRESS 0x204A0EE READ_WRITE /end MEASUREMENT
/begin MEASUREMENT OUT_PCAN.Tx_Ana.In_Ana_04_Sts.IN_ANA_Val.Task3 "" ULONG COMP_DEFAULT 0 0 0 4294967295 ECU_ADDRESS 0x204A0F0 READ_WRITE /end MEASUREMENT
/begin MEASUREMENT OUT_PCAN.Tx_Ana.In_Ana_04_Sts.IN_ANA_DIAG.Task3 "" UWORD COMP_DEFAULT 0 0 0 65535 ECU_ADDRESS 0x204A0F4 READ_WRITE /end MEASUREMENT
/begin MEASUREMENT OUT_PCAN.Tx_Ana.In_Ana_04_Sts.MessageEnable.Task3 "3.3.2.2.1 MessageEnable" UBYTE IS_BOOLEAN_TRUE 0 0 0 1 ECU_ADDRESS 0x204A0F6 READ_WRITE /end MEASUREMENT
/begin MEASUREMENT OUT_PCAN.Tx_Ana.In_Ana_03_Sts.IN_ANA_Val.Task3 "" ULONG COMP_DEFAULT 0 0 0 4294967295 ECU_ADDRESS 0x204A0F8 READ_WRITE /end MEASUREMENT
/begin MEASUREMENT OUT_PCAN.Tx_Ana.In_Ana_03_Sts.IN_ANA_DIAG.Task3 "" UWORD COMP_DEFAULT 0 0 0 65535 ECU_ADDRESS 0x204A0FC READ_WRITE /end MEASUREMENT
/begin MEASUREMENT OUT_PCAN.Tx_Ana.In_Ana_03_Sts.MessageEnable.Task3 "3.3.2.2.1 MessageEnable" UBYTE IS_BOOLEAN_TRUE 0 0 0 1 ECU_ADDRESS 0x204A0FE READ_WRITE /end MEASUREMENT
/begin MEASUREMENT OUT_PCAN.Tx_Ana.In_Ana_02_Sts.IN_ANA_Val.Task3 "" ULONG COMP_DEFAULT 0 0 0 4294967295 ECU_ADDRESS 0x204A100 READ_WRITE /end MEASUREMENT
/begin MEASUREMENT OUT_PCAN.Tx_Ana.In_Ana_02_Sts.IN_ANA_DIAG.Task3 "" UWORD COMP_DEFAULT 0 0 0 65535 ECU_ADDRESS 0x204A104 READ_WRITE /end MEASUREMENT
/begin MEASUREMENT OUT_PCAN.Tx_Ana.In_Ana_02_Sts.MessageEnable.Task3 "3.3.2.2.1 MessageEnable" UBYTE IS_BOOLEAN_TRUE 0 0 0 1 ECU_ADDRESS 0x204A106 READ_WRITE /end MEASUREMENT
/begin MEASUREMENT OUT_PCAN.Tx_Ana.In_Ana_01_Sts.IN_ANA_Val.Task3 "" ULONG COMP_DEFAULT 0 0 0 4294967295 ECU_ADDRESS 0x204A108 READ_WRITE /end MEASUREMENT
/begin MEASUREMENT OUT_PCAN.Tx_Ana.In_Ana_01_Sts.IN_ANA_DIAG.Task3 "" UWORD COMP_DEFAULT 0 0 0 65535 ECU_ADDRESS 0x204A10C READ_WRITE /end MEASUREMENT
/begin MEASUREMENT OUT_PCAN.Tx_Ana.In_Ana_01_Sts.MessageEnable.Task3 "3.3.2.2.1 MessageEnable" UBYTE IS_BOOLEAN_TRUE 0 0 0 1 ECU_ADDRESS 0x204A10E READ_WRITE /end MEASUREMENT
/begin MEASUREMENT OUT_PCAN.Tx_Tsu.TSU_Sts.Speed_Shaft.Task5 "" UWORD COMP_DEFAULT 0 0 0 65535 ECU_ADDRESS 0x204C02C READ_WRITE /end MEASUREMENT
/begin MEASUREMENT OUT_PCAN.Tx_Tsu.TSU_Sts.Speed_Shaft_DIAG.Task5 "" UWORD COMP_DEFAULT 0 0 0 65535 ECU_ADDRESS 0x204C02E READ_WRITE /end MEASUREMENT
/begin MEASUREMENT OUT_PCAN.Tx_Tsu.TSU_Sts.Speed_Vehicle.Task5 "" UWORD COMP_DEFAULT 0 0 0 65535 ECU_ADDRESS 0x204C030 READ_WRITE /end MEASUREMENT
/begin MEASUREMENT OUT_PCAN.Tx_Tsu.TSU_Sts.Speed_Vehicle_DIAG.Task5 "" UWORD COMP_DEFAULT 0 0 0 65535 ECU_ADDRESS 0x204C032 READ_WRITE /end MEASUREMENT
/begin MEASUREMENT OUT_PCAN.Tx_Tsu.TSU_Sts.MessageEnable.Task5 "3.3.2.2.1 MessageEnable" UBYTE IS_BOOLEAN_TRUE 0 0 0 1 ECU_ADDRESS 0x204C034 READ_WRITE /end MEASUREMENT
/begin MEASUREMENT OUT_PCAN.Tx_Pwr.PWR_G7_Sts.PWR_Gx_DIAG.Task3 "" UWORD COMP_DEFAULT 0 0 0 65535 ECU_ADDRESS 0x204A110 READ_WRITE /end MEASUREMENT
/begin MEASUREMENT OUT_PCAN.Tx_Pwr.PWR_G7_Sts.PWR_Gx_Val.Task3 "" UWORD COMP_DEFAULT 0 0 0 65535 ECU_ADDRESS 0x204A112 READ_WRITE /end MEASUREMENT
/begin MEASUREMENT OUT_PCAN.Tx_Pwr.PWR_G7_Sts.MessageEnable.Task3 "3.3.2.2.1 MessageEnable" UBYTE IS_BOOLEAN_TRUE 0 0 0 1 ECU_ADDRESS 0x204A114 READ_WRITE /end MEASUREMENT
/begin MEASUREMENT OUT_PCAN.Tx_Pwr.PWR_G5_Sts.PWR_Gx_DIAG.Task3 "" UWORD COMP_DEFAULT 0 0 0 65535 ECU_ADDRESS 0x204A116 READ_WRITE /end MEASUREMENT
/begin MEASUREMENT OUT_PCAN.Tx_Pwr.PWR_G5_Sts.PWR_Gx_Val.Task3 "" UWORD COMP_DEFAULT 0 0 0 65535 ECU_ADDRESS 0x204A118 READ_WRITE /end MEASUREMENT
/begin MEASUREMENT OUT_PCAN.Tx_Pwr.PWR_G5_Sts.MessageEnable.Task3 "3.3.2.2.1 MessageEnable" UBYTE IS_BOOLEAN_TRUE 0 0 0 1 ECU_ADDRESS 0x204A11A READ_WRITE /end MEASUREMENT
/begin MEASUREMENT OUT_PCAN.Tx_Pwr.PWR_G4_Sts.PWR_Gx_DIAG.Task3 "" UWORD COMP_DEFAULT 0 0 0 65535 ECU_ADDRESS 0x204A11C READ_WRITE /end MEASUREMENT
/begin MEASUREMENT OUT_PCAN.Tx_Pwr.PWR_G4_Sts.PWR_Gx_Val.Task3 "" UWORD COMP_DEFAULT 0 0 0 65535 ECU_ADDRESS 0x204A11E READ_WRITE /end MEASUREMENT
/begin MEASUREMENT OUT_PCAN.Tx_Pwr.PWR_G4_Sts.MessageEnable.Task3 "3.3.2.2.1 MessageEnable" UBYTE IS_BOOLEAN_TRUE 0 0 0 1 ECU_ADDRESS 0x204A120 READ_WRITE /end MEASUREMENT
/begin MEASUREMENT OUT_PCAN.Tx_Pwr.PWR_G3_Sts.PWR_Gx_DIAG.Task3 "" UWORD COMP_DEFAULT 0 0 0 65535 ECU_ADDRESS 0x204A122 READ_WRITE /end MEASUREMENT
/begin MEASUREMENT OUT_PCAN.Tx_Pwr.PWR_G3_Sts.PWR_Gx_Val.Task3 "" UWORD COMP_DEFAULT 0 0 0 65535 ECU_ADDRESS 0x204A124 READ_WRITE /end MEASUREMENT
/begin MEASUREMENT OUT_PCAN.Tx_Pwr.PWR_G3_Sts.MessageEnable.Task3 "3.3.2.2.1 MessageEnable" UBYTE IS_BOOLEAN_TRUE 0 0 0 1 ECU_ADDRESS 0x204A126 READ_WRITE /end MEASUREMENT
/begin MEASUREMENT OUT_PCAN.Tx_Pwr.PWR_G2_Sts.PWR_Gx_DIAG.Task3 "" UWORD COMP_DEFAULT 0 0 0 65535 ECU_ADDRESS 0x204A128 READ_WRITE /end MEASUREMENT
/begin MEASUREMENT OUT_PCAN.Tx_Pwr.PWR_G2_Sts.PWR_Gx_Val.Task3 "" UWORD COMP_DEFAULT 0 0 0 65535 ECU_ADDRESS 0x204A12A READ_WRITE /end MEASUREMENT
/begin MEASUREMENT OUT_PCAN.Tx_Pwr.PWR_G2_Sts.MessageEnable.Task3 "3.3.2.2.1 MessageEnable" UBYTE IS_BOOLEAN_TRUE 0 0 0 1 ECU_ADDRESS 0x204A12C READ_WRITE /end MEASUREMENT
/begin MEASUREMENT OUT_PCAN.Tx_Pwr.PWR_G1_Sts.PWR_Gx_DIAG.Task3 "" UWORD COMP_DEFAULT 0 0 0 65535 ECU_ADDRESS 0x204A12E READ_WRITE /end MEASUREMENT
/begin MEASUREMENT OUT_PCAN.Tx_Pwr.PWR_G1_Sts.PWR_Gx_Val.Task3 "" UWORD COMP_DEFAULT 0 0 0 65535 ECU_ADDRESS 0x204A130 READ_WRITE /end MEASUREMENT
/begin MEASUREMENT OUT_PCAN.Tx_Pwr.PWR_G1_Sts.MessageEnable.Task3 "3.3.2.2.1 MessageEnable" UBYTE IS_BOOLEAN_TRUE 0 0 0 1 ECU_ADDRESS 0x204A132 READ_WRITE /end MEASUREMENT
/begin MEASUREMENT OUT_PCAN.Tx_Pwr.PWR_Sts.PWR_Val.Task3 "" ULONG COMP_DEFAULT 0 0 0 4294967295 ECU_ADDRESS 0x204A134 READ_WRITE /end MEASUREMENT
/begin MEASUREMENT OUT_PCAN.Tx_Pwr.PWR_Sts.PWR_DIAG.Task3 "" UWORD COMP_DEFAULT 0 0 0 65535 ECU_ADDRESS 0x204A138 READ_WRITE /end MEASUREMENT
/begin MEASUREMENT OUT_PCAN.Tx_Pwr.PWR_Sts.MessageEnable.Task3 "3.3.2.2.1 MessageEnable" UBYTE IS_BOOLEAN_TRUE 0 0 0 1 ECU_ADDRESS 0x204A13A READ_WRITE /end MEASUREMENT
/begin MEASUREMENT OUT_PCAN.Tx_Dig.In_Dig_50_Sts.IN_DIG_DIAG.Task3 "" UWORD COMP_DEFAULT 0 0 0 65535 ECU_ADDRESS 0x204A13C READ_WRITE /end MEASUREMENT
/begin MEASUREMENT OUT_PCAN.Tx_Dig.In_Dig_50_Sts.IN_DIG_Val.Task3 "" UBYTE IS_BOOLEAN_TRUE 0 0 0 1 ECU_ADDRESS 0x204A13E READ_WRITE /end MEASUREMENT
/begin MEASUREMENT OUT_PCAN.Tx_Dig.In_Dig_50_Sts.MessageEnable.Task3 "3.3.2.2.1 MessageEnable" UBYTE IS_BOOLEAN_TRUE 0 0 0 1 ECU_ADDRESS 0x204A13F READ_WRITE /end MEASUREMENT
/begin MEASUREMENT OUT_PCAN.Tx_Dig.In_Dig_49_Sts.IN_DIG_DIAG.Task3 "" UWORD COMP_DEFAULT 0 0 0 65535 ECU_ADDRESS 0x204A140 READ_WRITE /end MEASUREMENT
/begin MEASUREMENT OUT_PCAN.Tx_Dig.In_Dig_49_Sts.IN_DIG_Val.Task3 "" UBYTE IS_BOOLEAN_TRUE 0 0 0 1 ECU_ADDRESS 0x204A142 READ_WRITE /end MEASUREMENT
/begin MEASUREMENT OUT_PCAN.Tx_Dig.In_Dig_49_Sts.MessageEnable.Task3 "3.3.2.2.1 MessageEnable" UBYTE IS_BOOLEAN_TRUE 0 0 0 1 ECU_ADDRESS 0x204A143 READ_WRITE /end MEASUREMENT
/begin MEASUREMENT OUT_PCAN.Tx_Dig.In_Dig_48_Sts.IN_DIG_DIAG.Task3 "" UWORD COMP_DEFAULT 0 0 0 65535 ECU_ADDRESS 0x204A144 READ_WRITE /end MEASUREMENT
/begin MEASUREMENT OUT_PCAN.Tx_Dig.In_Dig_48_Sts.IN_DIG_Val.Task3 "" UBYTE IS_BOOLEAN_TRUE 0 0 0 1 ECU_ADDRESS 0x204A146 READ_WRITE /end MEASUREMENT
/begin MEASUREMENT OUT_PCAN.Tx_Dig.In_Dig_48_Sts.MessageEnable.Task3 "3.3.2.2.1 MessageEnable" UBYTE IS_BOOLEAN_TRUE 0 0 0 1 ECU_ADDRESS 0x204A147 READ_WRITE /end MEASUREMENT
/begin MEASUREMENT OUT_PCAN.Tx_Dig.In_Dig_46_Sts.IN_DIG_DIAG.Task3 "" UWORD COMP_DEFAULT 0 0 0 65535 ECU_ADDRESS 0x204A148 READ_WRITE /end MEASUREMENT
/begin MEASUREMENT OUT_PCAN.Tx_Dig.In_Dig_46_Sts.IN_DIG_Val.Task3 "" UBYTE IS_BOOLEAN_TRUE 0 0 0 1 ECU_ADDRESS 0x204A14A READ_WRITE /end MEASUREMENT
/begin MEASUREMENT OUT_PCAN.Tx_Dig.In_Dig_46_Sts.MessageEnable.Task3 "3.3.2.2.1 MessageEnable" UBYTE IS_BOOLEAN_TRUE 0 0 0 1 ECU_ADDRESS 0x204A14B READ_WRITE /end MEASUREMENT
/begin MEASUREMENT OUT_PCAN.Tx_Dig.In_Dig_45_Sts.IN_DIG_DIAG.Task3 "" UWORD COMP_DEFAULT 0 0 0 65535 ECU_ADDRESS 0x204A14C READ_WRITE /end MEASUREMENT
/begin MEASUREMENT OUT_PCAN.Tx_Dig.In_Dig_45_Sts.IN_DIG_Val.Task3 "" UBYTE IS_BOOLEAN_TRUE 0 0 0 1 ECU_ADDRESS 0x204A14E READ_WRITE /end MEASUREMENT
/begin MEASUREMENT OUT_PCAN.Tx_Dig.In_Dig_45_Sts.MessageEnable.Task3 "3.3.2.2.1 MessageEnable" UBYTE IS_BOOLEAN_TRUE 0 0 0 1 ECU_ADDRESS 0x204A14F READ_WRITE /end MEASUREMENT
/begin MEASUREMENT OUT_PCAN.Tx_Dig.In_Dig_44_Sts.IN_DIG_DIAG.Task3 "" UWORD COMP_DEFAULT 0 0 0 65535 ECU_ADDRESS 0x204A150 READ_WRITE /end MEASUREMENT
/begin MEASUREMENT OUT_PCAN.Tx_Dig.In_Dig_44_Sts.IN_DIG_Val.Task3 "" UBYTE IS_BOOLEAN_TRUE 0 0 0 1 ECU_ADDRESS 0x204A152 READ_WRITE /end MEASUREMENT
/begin MEASUREMENT OUT_PCAN.Tx_Dig.In_Dig_44_Sts.MessageEnable.Task3 "3.3.2.2.1 MessageEnable" UBYTE IS_BOOLEAN_TRUE 0 0 0 1 ECU_ADDRESS 0x204A153 READ_WRITE /end MEASUREMENT
/begin MEASUREMENT OUT_PCAN.Tx_Dig.In_Dig_43_Sts.IN_DIG_DIAG.Task3 "" UWORD COMP_DEFAULT 0 0 0 65535 ECU_ADDRESS 0x204A154 READ_WRITE /end MEASUREMENT
/begin MEASUREMENT OUT_PCAN.Tx_Dig.In_Dig_43_Sts.IN_DIG_Val.Task3 "" UBYTE IS_BOOLEAN_TRUE 0 0 0 1 ECU_ADDRESS 0x204A156 READ_WRITE /end MEASUREMENT
/begin MEASUREMENT OUT_PCAN.Tx_Dig.In_Dig_43_Sts.MessageEnable.Task3 "3.3.2.2.1 MessageEnable" UBYTE IS_BOOLEAN_TRUE 0 0 0 1 ECU_ADDRESS 0x204A157 READ_WRITE /end MEASUREMENT
/begin MEASUREMENT OUT_PCAN.Tx_Dig.In_Dig_42_Sts.IN_DIG_DIAG.Task3 "" UWORD COMP_DEFAULT 0 0 0 65535 ECU_ADDRESS 0x204A158 READ_WRITE /end MEASUREMENT
/begin MEASUREMENT OUT_PCAN.Tx_Dig.In_Dig_42_Sts.IN_DIG_Val.Task3 "" UBYTE IS_BOOLEAN_TRUE 0 0 0 1 ECU_ADDRESS 0x204A15A READ_WRITE /end MEASUREMENT
/begin MEASUREMENT OUT_PCAN.Tx_Dig.In_Dig_42_Sts.MessageEnable.Task3 "3.3.2.2.1 MessageEnable" UBYTE IS_BOOLEAN_TRUE 0 0 0 1 ECU_ADDRESS 0x204A15B READ_WRITE /end MEASUREMENT
/begin MEASUREMENT OUT_PCAN.Tx_Dig.In_Dig_41_Sts.IN_DIG_DIAG.Task3 "" UWORD COMP_DEFAULT 0 0 0 65535 ECU_ADDRESS 0x204A15C READ_WRITE /end MEASUREMENT
/begin MEASUREMENT OUT_PCAN.Tx_Dig.In_Dig_41_Sts.IN_DIG_Val.Task3 "" UBYTE IS_BOOLEAN_TRUE 0 0 0 1 ECU_ADDRESS 0x204A15E READ_WRITE /end MEASUREMENT
/begin MEASUREMENT OUT_PCAN.Tx_Dig.In_Dig_41_Sts.MessageEnable.Task3 "3.3.2.2.1 MessageEnable" UBYTE IS_BOOLEAN_TRUE 0 0 0 1 ECU_ADDRESS 0x204A15F READ_WRITE /end MEASUREMENT
/begin MEASUREMENT OUT_PCAN.Tx_Dig.In_Dig_40_Sts.IN_DIG_DIAG.Task3 "" UWORD COMP_DEFAULT 0 0 0 65535 ECU_ADDRESS 0x204A160 READ_WRITE /end MEASUREMENT
/begin MEASUREMENT OUT_PCAN.Tx_Dig.In_Dig_40_Sts.IN_DIG_Val.Task3 "" UBYTE IS_BOOLEAN_TRUE 0 0 0 1 ECU_ADDRESS 0x204A162 READ_WRITE /end MEASUREMENT
/begin MEASUREMENT OUT_PCAN.Tx_Dig.In_Dig_40_Sts.MessageEnable.Task3 "3.3.2.2.1 MessageEnable" UBYTE IS_BOOLEAN_TRUE 0 0 0 1 ECU_ADDRESS 0x204A163 READ_WRITE /end MEASUREMENT
/begin MEASUREMENT OUT_PCAN.Tx_Dig.In_Dig_39_Sts.IN_DIG_DIAG.Task3 "" UWORD COMP_DEFAULT 0 0 0 65535 ECU_ADDRESS 0x204A164 READ_WRITE /end MEASUREMENT
/begin MEASUREMENT OUT_PCAN.Tx_Dig.In_Dig_39_Sts.IN_DIG_Val.Task3 "" UBYTE IS_BOOLEAN_TRUE 0 0 0 1 ECU_ADDRESS 0x204A166 READ_WRITE /end MEASUREMENT
/begin MEASUREMENT OUT_PCAN.Tx_Dig.In_Dig_39_Sts.MessageEnable.Task3 "3.3.2.2.1 MessageEnable" UBYTE IS_BOOLEAN_TRUE 0 0 0 1 ECU_ADDRESS 0x204A167 READ_WRITE /end MEASUREMENT
/begin MEASUREMENT OUT_PCAN.Tx_Dig.In_Dig_38_Sts.IN_DIG_DIAG.Task3 "" UWORD COMP_DEFAULT 0 0 0 65535 ECU_ADDRESS 0x204A168 READ_WRITE /end MEASUREMENT
/begin MEASUREMENT OUT_PCAN.Tx_Dig.In_Dig_38_Sts.IN_DIG_Val.Task3 "" UBYTE IS_BOOLEAN_TRUE 0 0 0 1 ECU_ADDRESS 0x204A16A READ_WRITE /end MEASUREMENT
/begin MEASUREMENT OUT_PCAN.Tx_Dig.In_Dig_38_Sts.MessageEnable.Task3 "3.3.2.2.1 MessageEnable" UBYTE IS_BOOLEAN_TRUE 0 0 0 1 ECU_ADDRESS 0x204A16B READ_WRITE /end MEASUREMENT
/begin MEASUREMENT OUT_PCAN.Tx_Dig.In_Dig_37_Sts.IN_DIG_DIAG.Task3 "" UWORD COMP_DEFAULT 0 0 0 65535 ECU_ADDRESS 0x204A16C READ_WRITE /end MEASUREMENT
/begin MEASUREMENT OUT_PCAN.Tx_Dig.In_Dig_37_Sts.IN_DIG_Val.Task3 "" UBYTE IS_BOOLEAN_TRUE 0 0 0 1 ECU_ADDRESS 0x204A16E READ_WRITE /end MEASUREMENT
/begin MEASUREMENT OUT_PCAN.Tx_Dig.In_Dig_37_Sts.MessageEnable.Task3 "3.3.2.2.1 MessageEnable" UBYTE IS_BOOLEAN_TRUE 0 0 0 1 ECU_ADDRESS 0x204A16F READ_WRITE /end MEASUREMENT
/begin MEASUREMENT OUT_PCAN.Tx_Dig.In_Dig_36_Sts.IN_DIG_DIAG.Task3 "" UWORD COMP_DEFAULT 0 0 0 65535 ECU_ADDRESS 0x204A170 READ_WRITE /end MEASUREMENT
/begin MEASUREMENT OUT_PCAN.Tx_Dig.In_Dig_36_Sts.IN_DIG_Val.Task3 "" UBYTE IS_BOOLEAN_TRUE 0 0 0 1 ECU_ADDRESS 0x204A172 READ_WRITE /end MEASUREMENT
/begin MEASUREMENT OUT_PCAN.Tx_Dig.In_Dig_36_Sts.MessageEnable.Task3 "3.3.2.2.1 MessageEnable" UBYTE IS_BOOLEAN_TRUE 0 0 0 1 ECU_ADDRESS 0x204A173 READ_WRITE /end MEASUREMENT
/begin MEASUREMENT OUT_PCAN.Tx_Dig.In_Dig_35_Sts.IN_DIG_DIAG.Task3 "" UWORD COMP_DEFAULT 0 0 0 65535 ECU_ADDRESS 0x204A174 READ_WRITE /end MEASUREMENT
/begin MEASUREMENT OUT_PCAN.Tx_Dig.In_Dig_35_Sts.IN_DIG_Val.Task3 "" UBYTE IS_BOOLEAN_TRUE 0 0 0 1 ECU_ADDRESS 0x204A176 READ_WRITE /end MEASUREMENT
/begin MEASUREMENT OUT_PCAN.Tx_Dig.In_Dig_35_Sts.MessageEnable.Task3 "3.3.2.2.1 MessageEnable" UBYTE IS_BOOLEAN_TRUE 0 0 0 1 ECU_ADDRESS 0x204A177 READ_WRITE /end MEASUREMENT
/begin MEASUREMENT OUT_PCAN.Tx_Dig.In_Dig_34_Sts.IN_DIG_DIAG.Task3 "" UWORD COMP_DEFAULT 0 0 0 65535 ECU_ADDRESS 0x204A178 READ_WRITE /end MEASUREMENT
/begin MEASUREMENT OUT_PCAN.Tx_Dig.In_Dig_34_Sts.IN_DIG_Val.Task3 "" UBYTE IS_BOOLEAN_TRUE 0 0 0 1 ECU_ADDRESS 0x204A17A READ_WRITE /end MEASUREMENT
/begin MEASUREMENT OUT_PCAN.Tx_Dig.In_Dig_34_Sts.MessageEnable.Task3 "3.3.2.2.1 MessageEnable" UBYTE IS_BOOLEAN_TRUE 0 0 0 1 ECU_ADDRESS 0x204A17B READ_WRITE /end MEASUREMENT
/begin MEASUREMENT OUT_PCAN.Tx_Dig.In_Dig_33_Sts.IN_DIG_DIAG.Task3 "" UWORD COMP_DEFAULT 0 0 0 65535 ECU_ADDRESS 0x204A17C READ_WRITE /end MEASUREMENT
/begin MEASUREMENT OUT_PCAN.Tx_Dig.In_Dig_33_Sts.IN_DIG_Val.Task3 "" UBYTE IS_BOOLEAN_TRUE 0 0 0 1 ECU_ADDRESS 0x204A17E READ_WRITE /end MEASUREMENT
/begin MEASUREMENT OUT_PCAN.Tx_Dig.In_Dig_33_Sts.MessageEnable.Task3 "3.3.2.2.1 MessageEnable" UBYTE IS_BOOLEAN_TRUE 0 0 0 1 ECU_ADDRESS 0x204A17F READ_WRITE /end MEASUREMENT
/begin MEASUREMENT OUT_PCAN.Tx_Dig.In_Dig_32_Sts.IN_DIG_DIAG.Task3 "" UWORD COMP_DEFAULT 0 0 0 65535 ECU_ADDRESS 0x204A180 READ_WRITE /end MEASUREMENT
/begin MEASUREMENT OUT_PCAN.Tx_Dig.In_Dig_32_Sts.IN_DIG_Val.Task3 "" UBYTE IS_BOOLEAN_TRUE 0 0 0 1 ECU_ADDRESS 0x204A182 READ_WRITE /end MEASUREMENT
/begin MEASUREMENT OUT_PCAN.Tx_Dig.In_Dig_32_Sts.MessageEnable.Task3 "3.3.2.2.1 MessageEnable" UBYTE IS_BOOLEAN_TRUE 0 0 0 1 ECU_ADDRESS 0x204A183 READ_WRITE /end MEASUREMENT
/begin MEASUREMENT OUT_PCAN.Tx_Dig.In_Dig_31_Sts.IN_DIG_DIAG.Task3 "" UWORD COMP_DEFAULT 0 0 0 65535 ECU_ADDRESS 0x204A184 READ_WRITE /end MEASUREMENT
/begin MEASUREMENT OUT_PCAN.Tx_Dig.In_Dig_31_Sts.IN_DIG_Val.Task3 "" UBYTE IS_BOOLEAN_TRUE 0 0 0 1 ECU_ADDRESS 0x204A186 READ_WRITE /end MEASUREMENT
/begin MEASUREMENT OUT_PCAN.Tx_Dig.In_Dig_31_Sts.MessageEnable.Task3 "3.3.2.2.1 MessageEnable" UBYTE IS_BOOLEAN_TRUE 0 0 0 1 ECU_ADDRESS 0x204A187 READ_WRITE /end MEASUREMENT
/begin MEASUREMENT OUT_PCAN.Tx_Dig.In_Dig_30_Sts.IN_DIG_DIAG.Task3 "" UWORD COMP_DEFAULT 0 0 0 65535 ECU_ADDRESS 0x204A188 READ_WRITE /end MEASUREMENT
/begin MEASUREMENT OUT_PCAN.Tx_Dig.In_Dig_30_Sts.IN_DIG_Val.Task3 "" UBYTE IS_BOOLEAN_TRUE 0 0 0 1 ECU_ADDRESS 0x204A18A READ_WRITE /end MEASUREMENT
/begin MEASUREMENT OUT_PCAN.Tx_Dig.In_Dig_30_Sts.MessageEnable.Task3 "3.3.2.2.1 MessageEnable" UBYTE IS_BOOLEAN_TRUE 0 0 0 1 ECU_ADDRESS 0x204A18B READ_WRITE /end MEASUREMENT
/begin MEASUREMENT OUT_PCAN.Tx_Dig.In_Dig_29_Sts.IN_DIG_DIAG.Task3 "" UWORD COMP_DEFAULT 0 0 0 65535 ECU_ADDRESS 0x204A18C READ_WRITE /end MEASUREMENT
/begin MEASUREMENT OUT_PCAN.Tx_Dig.In_Dig_29_Sts.IN_DIG_Val.Task3 "" UBYTE IS_BOOLEAN_TRUE 0 0 0 1 ECU_ADDRESS 0x204A18E READ_WRITE /end MEASUREMENT
/begin MEASUREMENT OUT_PCAN.Tx_Dig.In_Dig_29_Sts.MessageEnable.Task3 "3.3.2.2.1 MessageEnable" UBYTE IS_BOOLEAN_TRUE 0 0 0 1 ECU_ADDRESS 0x204A18F READ_WRITE /end MEASUREMENT
/begin MEASUREMENT OUT_PCAN.Tx_Dig.In_Dig_28_Sts.IN_DIG_DIAG.Task3 "" UWORD COMP_DEFAULT 0 0 0 65535 ECU_ADDRESS 0x204A190 READ_WRITE /end MEASUREMENT
/begin MEASUREMENT OUT_PCAN.Tx_Dig.In_Dig_28_Sts.IN_DIG_Val.Task3 "" UBYTE IS_BOOLEAN_TRUE 0 0 0 1 ECU_ADDRESS 0x204A192 READ_WRITE /end MEASUREMENT
/begin MEASUREMENT OUT_PCAN.Tx_Dig.In_Dig_28_Sts.MessageEnable.Task3 "3.3.2.2.1 MessageEnable" UBYTE IS_BOOLEAN_TRUE 0 0 0 1 ECU_ADDRESS 0x204A193 READ_WRITE /end MEASUREMENT
/begin MEASUREMENT OUT_PCAN.Tx_Dig.In_Dig_27_Sts.IN_DIG_DIAG.Task3 "" UWORD COMP_DEFAULT 0 0 0 65535 ECU_ADDRESS 0x204A194 READ_WRITE /end MEASUREMENT
/begin MEASUREMENT OUT_PCAN.Tx_Dig.In_Dig_27_Sts.IN_DIG_Val.Task3 "" UBYTE IS_BOOLEAN_TRUE 0 0 0 1 ECU_ADDRESS 0x204A196 READ_WRITE /end MEASUREMENT
/begin MEASUREMENT OUT_PCAN.Tx_Dig.In_Dig_27_Sts.MessageEnable.Task3 "3.3.2.2.1 MessageEnable" UBYTE IS_BOOLEAN_TRUE 0 0 0 1 ECU_ADDRESS 0x204A197 READ_WRITE /end MEASUREMENT
/begin MEASUREMENT OUT_PCAN.Tx_Dig.In_Dig_26_Sts.IN_DIG_DIAG.Task3 "" UWORD COMP_DEFAULT 0 0 0 65535 ECU_ADDRESS 0x204A198 READ_WRITE /end MEASUREMENT
/begin MEASUREMENT OUT_PCAN.Tx_Dig.In_Dig_26_Sts.IN_DIG_Val.Task3 "" UBYTE IS_BOOLEAN_TRUE 0 0 0 1 ECU_ADDRESS 0x204A19A READ_WRITE /end MEASUREMENT
/begin MEASUREMENT OUT_PCAN.Tx_Dig.In_Dig_26_Sts.MessageEnable.Task3 "3.3.2.2.1 MessageEnable" UBYTE IS_BOOLEAN_TRUE 0 0 0 1 ECU_ADDRESS 0x204A19B READ_WRITE /end MEASUREMENT
/begin MEASUREMENT OUT_PCAN.Tx_Dig.In_Dig_25_Sts.IN_DIG_DIAG.Task3 "" UWORD COMP_DEFAULT 0 0 0 65535 ECU_ADDRESS 0x204A19C READ_WRITE /end MEASUREMENT
/begin MEASUREMENT OUT_PCAN.Tx_Dig.In_Dig_25_Sts.IN_DIG_Val.Task3 "" UBYTE IS_BOOLEAN_TRUE 0 0 0 1 ECU_ADDRESS 0x204A19E READ_WRITE /end MEASUREMENT
/begin MEASUREMENT OUT_PCAN.Tx_Dig.In_Dig_25_Sts.MessageEnable.Task3 "3.3.2.2.1 MessageEnable" UBYTE IS_BOOLEAN_TRUE 0 0 0 1 ECU_ADDRESS 0x204A19F READ_WRITE /end MEASUREMENT
/begin MEASUREMENT OUT_PCAN.Tx_Dig.In_Dig_24_Sts.IN_DIG_DIAG.Task3 "" UWORD COMP_DEFAULT 0 0 0 65535 ECU_ADDRESS 0x204A1A0 READ_WRITE /end MEASUREMENT
/begin MEASUREMENT OUT_PCAN.Tx_Dig.In_Dig_24_Sts.IN_DIG_Val.Task3 "" UBYTE IS_BOOLEAN_TRUE 0 0 0 1 ECU_ADDRESS 0x204A1A2 READ_WRITE /end MEASUREMENT
/begin MEASUREMENT OUT_PCAN.Tx_Dig.In_Dig_24_Sts.MessageEnable.Task3 "3.3.2.2.1 MessageEnable" UBYTE IS_BOOLEAN_TRUE 0 0 0 1 ECU_ADDRESS 0x204A1A3 READ_WRITE /end MEASUREMENT
/begin MEASUREMENT OUT_PCAN.Tx_Dig.In_Dig_23_Sts.IN_DIG_DIAG.Task3 "" UWORD COMP_DEFAULT 0 0 0 65535 ECU_ADDRESS 0x204A1A4 READ_WRITE /end MEASUREMENT
/begin MEASUREMENT OUT_PCAN.Tx_Dig.In_Dig_23_Sts.IN_DIG_Val.Task3 "" UBYTE IS_BOOLEAN_TRUE 0 0 0 1 ECU_ADDRESS 0x204A1A6 READ_WRITE /end MEASUREMENT
/begin MEASUREMENT OUT_PCAN.Tx_Dig.In_Dig_23_Sts.MessageEnable.Task3 "3.3.2.2.1 MessageEnable" UBYTE IS_BOOLEAN_TRUE 0 0 0 1 ECU_ADDRESS 0x204A1A7 READ_WRITE /end MEASUREMENT
/begin MEASUREMENT OUT_PCAN.Tx_Dig.In_Dig_22_Sts.IN_DIG_DIAG.Task3 "" UWORD COMP_DEFAULT 0 0 0 65535 ECU_ADDRESS 0x204A1A8 READ_WRITE /end MEASUREMENT
/begin MEASUREMENT OUT_PCAN.Tx_Dig.In_Dig_22_Sts.IN_DIG_Val.Task3 "" UBYTE IS_BOOLEAN_TRUE 0 0 0 1 ECU_ADDRESS 0x204A1AA READ_WRITE /end MEASUREMENT
/begin MEASUREMENT OUT_PCAN.Tx_Dig.In_Dig_22_Sts.MessageEnable.Task3 "3.3.2.2.1 MessageEnable" UBYTE IS_BOOLEAN_TRUE 0 0 0 1 ECU_ADDRESS 0x204A1AB READ_WRITE /end MEASUREMENT
/begin MEASUREMENT OUT_PCAN.Tx_Dig.In_Dig_21_Sts.IN_DIG_DIAG.Task3 "" UWORD COMP_DEFAULT 0 0 0 65535 ECU_ADDRESS 0x204A1AC READ_WRITE /end MEASUREMENT
/begin MEASUREMENT OUT_PCAN.Tx_Dig.In_Dig_21_Sts.IN_DIG_Val.Task3 "" UBYTE IS_BOOLEAN_TRUE 0 0 0 1 ECU_ADDRESS 0x204A1AE READ_WRITE /end MEASUREMENT
/begin MEASUREMENT OUT_PCAN.Tx_Dig.In_Dig_21_Sts.MessageEnable.Task3 "3.3.2.2.1 MessageEnable" UBYTE IS_BOOLEAN_TRUE 0 0 0 1 ECU_ADDRESS 0x204A1AF READ_WRITE /end MEASUREMENT
/begin MEASUREMENT OUT_PCAN.Tx_Dig.In_Dig_20_Sts.IN_DIG_DIAG.Task3 "" UWORD COMP_DEFAULT 0 0 0 65535 ECU_ADDRESS 0x204A1B0 READ_WRITE /end MEASUREMENT
/begin MEASUREMENT OUT_PCAN.Tx_Dig.In_Dig_20_Sts.IN_DIG_Val.Task3 "" UBYTE IS_BOOLEAN_TRUE 0 0 0 1 ECU_ADDRESS 0x204A1B2 READ_WRITE /end MEASUREMENT
/begin MEASUREMENT OUT_PCAN.Tx_Dig.In_Dig_20_Sts.MessageEnable.Task3 "3.3.2.2.1 MessageEnable" UBYTE IS_BOOLEAN_TRUE 0 0 0 1 ECU_ADDRESS 0x204A1B3 READ_WRITE /end MEASUREMENT
/begin MEASUREMENT OUT_PCAN.Tx_Dig.In_Dig_19_Sts.IN_DIG_DIAG.Task3 "" UWORD COMP_DEFAULT 0 0 0 65535 ECU_ADDRESS 0x204A1B4 READ_WRITE /end MEASUREMENT
/begin MEASUREMENT OUT_PCAN.Tx_Dig.In_Dig_19_Sts.IN_DIG_Val.Task3 "" UBYTE IS_BOOLEAN_TRUE 0 0 0 1 ECU_ADDRESS 0x204A1B6 READ_WRITE /end MEASUREMENT
/begin MEASUREMENT OUT_PCAN.Tx_Dig.In_Dig_19_Sts.MessageEnable.Task3 "3.3.2.2.1 MessageEnable" UBYTE IS_BOOLEAN_TRUE 0 0 0 1 ECU_ADDRESS 0x204A1B7 READ_WRITE /end MEASUREMENT
/begin MEASUREMENT OUT_PCAN.Tx_Dig.In_Dig_18_Sts.IN_DIG_DIAG.Task3 "" UWORD COMP_DEFAULT 0 0 0 65535 ECU_ADDRESS 0x204A1B8 READ_WRITE /end MEASUREMENT
/begin MEASUREMENT OUT_PCAN.Tx_Dig.In_Dig_18_Sts.IN_DIG_Val.Task3 "" UBYTE IS_BOOLEAN_TRUE 0 0 0 1 ECU_ADDRESS 0x204A1BA READ_WRITE /end MEASUREMENT
/begin MEASUREMENT OUT_PCAN.Tx_Dig.In_Dig_18_Sts.MessageEnable.Task3 "3.3.2.2.1 MessageEnable" UBYTE IS_BOOLEAN_TRUE 0 0 0 1 ECU_ADDRESS 0x204A1BB READ_WRITE /end MEASUREMENT
/begin MEASUREMENT OUT_PCAN.Tx_Dig.In_Dig_17_Sts.IN_DIG_DIAG.Task3 "" UWORD COMP_DEFAULT 0 0 0 65535 ECU_ADDRESS 0x204A1BC READ_WRITE /end MEASUREMENT
/begin MEASUREMENT OUT_PCAN.Tx_Dig.In_Dig_17_Sts.IN_DIG_Val.Task3 "" UBYTE IS_BOOLEAN_TRUE 0 0 0 1 ECU_ADDRESS 0x204A1BE READ_WRITE /end MEASUREMENT
/begin MEASUREMENT OUT_PCAN.Tx_Dig.In_Dig_17_Sts.MessageEnable.Task3 "3.3.2.2.1 MessageEnable" UBYTE IS_BOOLEAN_TRUE 0 0 0 1 ECU_ADDRESS 0x204A1BF READ_WRITE /end MEASUREMENT
/begin MEASUREMENT OUT_PCAN.Tx_Dig.In_Dig_16_Sts.IN_DIG_DIAG.Task3 "" UWORD COMP_DEFAULT 0 0 0 65535 ECU_ADDRESS 0x204A1C0 READ_WRITE /end MEASUREMENT
/begin MEASUREMENT OUT_PCAN.Tx_Dig.In_Dig_16_Sts.IN_DIG_Val.Task3 "" UBYTE IS_BOOLEAN_TRUE 0 0 0 1 ECU_ADDRESS 0x204A1C2 READ_WRITE /end MEASUREMENT
/begin MEASUREMENT OUT_PCAN.Tx_Dig.In_Dig_16_Sts.MessageEnable.Task3 "3.3.2.2.1 MessageEnable" UBYTE IS_BOOLEAN_TRUE 0 0 0 1 ECU_ADDRESS 0x204A1C3 READ_WRITE /end MEASUREMENT
/begin MEASUREMENT OUT_PCAN.Tx_Dig.In_Dig_15_Sts.IN_DIG_DIAG.Task3 "" UWORD COMP_DEFAULT 0 0 0 65535 ECU_ADDRESS 0x204A1C4 READ_WRITE /end MEASUREMENT
/begin MEASUREMENT OUT_PCAN.Tx_Dig.In_Dig_15_Sts.IN_DIG_Val.Task3 "" UBYTE IS_BOOLEAN_TRUE 0 0 0 1 ECU_ADDRESS 0x204A1C6 READ_WRITE /end MEASUREMENT
/begin MEASUREMENT OUT_PCAN.Tx_Dig.In_Dig_15_Sts.MessageEnable.Task3 "3.3.2.2.1 MessageEnable" UBYTE IS_BOOLEAN_TRUE 0 0 0 1 ECU_ADDRESS 0x204A1C7 READ_WRITE /end MEASUREMENT
/begin MEASUREMENT OUT_PCAN.Tx_Dig.In_Dig_14_Sts.IN_DIG_DIAG.Task3 "" UWORD COMP_DEFAULT 0 0 0 65535 ECU_ADDRESS 0x204A1C8 READ_WRITE /end MEASUREMENT
/begin MEASUREMENT OUT_PCAN.Tx_Dig.In_Dig_14_Sts.IN_DIG_Val.Task3 "" UBYTE IS_BOOLEAN_TRUE 0 0 0 1 ECU_ADDRESS 0x204A1CA READ_WRITE /end MEASUREMENT
/begin MEASUREMENT OUT_PCAN.Tx_Dig.In_Dig_14_Sts.MessageEnable.Task3 "3.3.2.2.1 MessageEnable" UBYTE IS_BOOLEAN_TRUE 0 0 0 1 ECU_ADDRESS 0x204A1CB READ_WRITE /end MEASUREMENT
/begin MEASUREMENT OUT_PCAN.Tx_Dig.In_Dig_13_Sts.IN_DIG_DIAG.Task3 "" UWORD COMP_DEFAULT 0 0 0 65535 ECU_ADDRESS 0x204A1CC READ_WRITE /end MEASUREMENT
/begin MEASUREMENT OUT_PCAN.Tx_Dig.In_Dig_13_Sts.IN_DIG_Val.Task3 "" UBYTE IS_BOOLEAN_TRUE 0 0 0 1 ECU_ADDRESS 0x204A1CE READ_WRITE /end MEASUREMENT
/begin MEASUREMENT OUT_PCAN.Tx_Dig.In_Dig_13_Sts.MessageEnable.Task3 "3.3.2.2.1 MessageEnable" UBYTE IS_BOOLEAN_TRUE 0 0 0 1 ECU_ADDRESS 0x204A1CF READ_WRITE /end MEASUREMENT
/begin MEASUREMENT OUT_PCAN.Tx_Dig.In_Dig_12_Sts.IN_DIG_DIAG.Task3 "" UWORD COMP_DEFAULT 0 0 0 65535 ECU_ADDRESS 0x204A1D0 READ_WRITE /end MEASUREMENT
/begin MEASUREMENT OUT_PCAN.Tx_Dig.In_Dig_12_Sts.IN_DIG_Val.Task3 "" UBYTE IS_BOOLEAN_TRUE 0 0 0 1 ECU_ADDRESS 0x204A1D2 READ_WRITE /end MEASUREMENT
/begin MEASUREMENT OUT_PCAN.Tx_Dig.In_Dig_12_Sts.MessageEnable.Task3 "3.3.2.2.1 MessageEnable" UBYTE IS_BOOLEAN_TRUE 0 0 0 1 ECU_ADDRESS 0x204A1D3 READ_WRITE /end MEASUREMENT
/begin MEASUREMENT OUT_PCAN.Tx_Dig.In_Dig_11_Sts.IN_DIG_DIAG.Task3 "" UWORD COMP_DEFAULT 0 0 0 65535 ECU_ADDRESS 0x204A1D4 READ_WRITE /end MEASUREMENT
/begin MEASUREMENT OUT_PCAN.Tx_Dig.In_Dig_11_Sts.IN_DIG_Val.Task3 "" UBYTE IS_BOOLEAN_TRUE 0 0 0 1 ECU_ADDRESS 0x204A1D6 READ_WRITE /end MEASUREMENT
/begin MEASUREMENT OUT_PCAN.Tx_Dig.In_Dig_11_Sts.MessageEnable.Task3 "3.3.2.2.1 MessageEnable" UBYTE IS_BOOLEAN_TRUE 0 0 0 1 ECU_ADDRESS 0x204A1D7 READ_WRITE /end MEASUREMENT
/begin MEASUREMENT OUT_PCAN.Tx_Dig.In_Dig_10_Sts.IN_DIG_DIAG.Task3 "" UWORD COMP_DEFAULT 0 0 0 65535 ECU_ADDRESS 0x204A1D8 READ_WRITE /end MEASUREMENT
/begin MEASUREMENT OUT_PCAN.Tx_Dig.In_Dig_10_Sts.IN_DIG_Val.Task3 "" UBYTE IS_BOOLEAN_TRUE 0 0 0 1 ECU_ADDRESS 0x204A1DA READ_WRITE /end MEASUREMENT
/begin MEASUREMENT OUT_PCAN.Tx_Dig.In_Dig_10_Sts.MessageEnable.Task3 "3.3.2.2.1 MessageEnable" UBYTE IS_BOOLEAN_TRUE 0 0 0 1 ECU_ADDRESS 0x204A1DB READ_WRITE /end MEASUREMENT
/begin MEASUREMENT OUT_PCAN.Tx_Dig.In_Dig_09_Sts.IN_DIG_DIAG.Task3 "" UWORD COMP_DEFAULT 0 0 0 65535 ECU_ADDRESS 0x204A1DC READ_WRITE /end MEASUREMENT
/begin MEASUREMENT OUT_PCAN.Tx_Dig.In_Dig_09_Sts.IN_DIG_Val.Task3 "" UBYTE IS_BOOLEAN_TRUE 0 0 0 1 ECU_ADDRESS 0x204A1DE READ_WRITE /end MEASUREMENT
/begin MEASUREMENT OUT_PCAN.Tx_Dig.In_Dig_09_Sts.MessageEnable.Task3 "3.3.2.2.1 MessageEnable" UBYTE IS_BOOLEAN_TRUE 0 0 0 1 ECU_ADDRESS 0x204A1DF READ_WRITE /end MEASUREMENT
/begin MEASUREMENT OUT_PCAN.Tx_Dig.In_Dig_08_Sts.IN_DIG_DIAG.Task3 "" UWORD COMP_DEFAULT 0 0 0 65535 ECU_ADDRESS 0x204A1E0 READ_WRITE /end MEASUREMENT
/begin MEASUREMENT OUT_PCAN.Tx_Dig.In_Dig_08_Sts.IN_DIG_Val.Task3 "" UBYTE IS_BOOLEAN_TRUE 0 0 0 1 ECU_ADDRESS 0x204A1E2 READ_WRITE /end MEASUREMENT
/begin MEASUREMENT OUT_PCAN.Tx_Dig.In_Dig_08_Sts.MessageEnable.Task3 "3.3.2.2.1 MessageEnable" UBYTE IS_BOOLEAN_TRUE 0 0 0 1 ECU_ADDRESS 0x204A1E3 READ_WRITE /end MEASUREMENT
/begin MEASUREMENT OUT_PCAN.Tx_Dig.In_Dig_07_Sts.IN_DIG_DIAG.Task3 "" UWORD COMP_DEFAULT 0 0 0 65535 ECU_ADDRESS 0x204A1E4 READ_WRITE /end MEASUREMENT
/begin MEASUREMENT OUT_PCAN.Tx_Dig.In_Dig_07_Sts.IN_DIG_Val.Task3 "" UBYTE IS_BOOLEAN_TRUE 0 0 0 1 ECU_ADDRESS 0x204A1E6 READ_WRITE /end MEASUREMENT
/begin MEASUREMENT OUT_PCAN.Tx_Dig.In_Dig_07_Sts.MessageEnable.Task3 "3.3.2.2.1 MessageEnable" UBYTE IS_BOOLEAN_TRUE 0 0 0 1 ECU_ADDRESS 0x204A1E7 READ_WRITE /end MEASUREMENT
/begin MEASUREMENT OUT_PCAN.Tx_Dig.In_Dig_06_Sts.IN_DIG_DIAG.Task3 "" UWORD COMP_DEFAULT 0 0 0 65535 ECU_ADDRESS 0x204A1E8 READ_WRITE /end MEASUREMENT
/begin MEASUREMENT OUT_PCAN.Tx_Dig.In_Dig_06_Sts.IN_DIG_Val.Task3 "" UBYTE IS_BOOLEAN_TRUE 0 0 0 1 ECU_ADDRESS 0x204A1EA READ_WRITE /end MEASUREMENT
/begin MEASUREMENT OUT_PCAN.Tx_Dig.In_Dig_06_Sts.MessageEnable.Task3 "3.3.2.2.1 MessageEnable" UBYTE IS_BOOLEAN_TRUE 0 0 0 1 ECU_ADDRESS 0x204A1EB READ_WRITE /end MEASUREMENT
/begin MEASUREMENT OUT_PCAN.Tx_Dig.In_Dig_05_Sts.IN_DIG_DIAG.Task3 "" UWORD COMP_DEFAULT 0 0 0 65535 ECU_ADDRESS 0x204A1EC READ_WRITE /end MEASUREMENT
/begin MEASUREMENT OUT_PCAN.Tx_Dig.In_Dig_05_Sts.IN_DIG_Val.Task3 "" UBYTE IS_BOOLEAN_TRUE 0 0 0 1 ECU_ADDRESS 0x204A1EE READ_WRITE /end MEASUREMENT
/begin MEASUREMENT OUT_PCAN.Tx_Dig.In_Dig_05_Sts.MessageEnable.Task3 "3.3.2.2.1 MessageEnable" UBYTE IS_BOOLEAN_TRUE 0 0 0 1 ECU_ADDRESS 0x204A1EF READ_WRITE /end MEASUREMENT
/begin MEASUREMENT OUT_PCAN.Tx_Dig.In_Dig_04_Sts.IN_DIG_DIAG.Task3 "" UWORD COMP_DEFAULT 0 0 0 65535 ECU_ADDRESS 0x204A1F0 READ_WRITE /end MEASUREMENT
/begin MEASUREMENT OUT_PCAN.Tx_Dig.In_Dig_04_Sts.IN_DIG_Val.Task3 "" UBYTE IS_BOOLEAN_TRUE 0 0 0 1 ECU_ADDRESS 0x204A1F2 READ_WRITE /end MEASUREMENT
/begin MEASUREMENT OUT_PCAN.Tx_Dig.In_Dig_04_Sts.MessageEnable.Task3 "3.3.2.2.1 MessageEnable" UBYTE IS_BOOLEAN_TRUE 0 0 0 1 ECU_ADDRESS 0x204A1F3 READ_WRITE /end MEASUREMENT
/begin MEASUREMENT OUT_PCAN.Tx_Dig.In_Dig_03_Sts.IN_DIG_DIAG.Task3 "" UWORD COMP_DEFAULT 0 0 0 65535 ECU_ADDRESS 0x204A1F4 READ_WRITE /end MEASUREMENT
/begin MEASUREMENT OUT_PCAN.Tx_Dig.In_Dig_03_Sts.IN_DIG_Val.Task3 "" UBYTE IS_BOOLEAN_TRUE 0 0 0 1 ECU_ADDRESS 0x204A1F6 READ_WRITE /end MEASUREMENT
/begin MEASUREMENT OUT_PCAN.Tx_Dig.In_Dig_03_Sts.MessageEnable.Task3 "3.3.2.2.1 MessageEnable" UBYTE IS_BOOLEAN_TRUE 0 0 0 1 ECU_ADDRESS 0x204A1F7 READ_WRITE /end MEASUREMENT
/begin MEASUREMENT OUT_PCAN.Tx_Dig.In_Dig_02_Sts.IN_DIG_DIAG.Task3 "" UWORD COMP_DEFAULT 0 0 0 65535 ECU_ADDRESS 0x204A1F8 READ_WRITE /end MEASUREMENT
/begin MEASUREMENT OUT_PCAN.Tx_Dig.In_Dig_02_Sts.IN_DIG_Val.Task3 "" UBYTE IS_BOOLEAN_TRUE 0 0 0 1 ECU_ADDRESS 0x204A1FA READ_WRITE /end MEASUREMENT
/begin MEASUREMENT OUT_PCAN.Tx_Dig.In_Dig_02_Sts.MessageEnable.Task3 "3.3.2.2.1 MessageEnable" UBYTE IS_BOOLEAN_TRUE 0 0 0 1 ECU_ADDRESS 0x204A1FB READ_WRITE /end MEASUREMENT
/begin MEASUREMENT OUT_PCAN.Tx_Dig.In_Dig_01_Sts.IN_DIG_DIAG.Task3 "" UWORD COMP_DEFAULT 0 0 0 65535 ECU_ADDRESS 0x204A1FC READ_WRITE /end MEASUREMENT
/begin MEASUREMENT OUT_PCAN.Tx_Dig.In_Dig_01_Sts.IN_DIG_Val.Task3 "" UBYTE IS_BOOLEAN_TRUE 0 0 0 1 ECU_ADDRESS 0x204A1FE READ_WRITE /end MEASUREMENT
/begin MEASUREMENT OUT_PCAN.Tx_Dig.In_Dig_01_Sts.MessageEnable.Task3 "3.3.2.2.1 MessageEnable" UBYTE IS_BOOLEAN_TRUE 0 0 0 1 ECU_ADDRESS 0x204A1FF READ_WRITE /end MEASUREMENT
/begin MEASUREMENT OUT_PCAN.Tx_Pwr.Out_Supply_ANA_03_Sts.Supply_ANA_DIAG.Task3 "" UWORD COMP_DEFAULT 0 0 0 65535 ECU_ADDRESS 0x204A200 READ_WRITE /end MEASUREMENT
/begin MEASUREMENT OUT_PCAN.Tx_Pwr.Out_Supply_ANA_03_Sts.Supply_ANA_Val.Task3 "" UWORD COMP_DEFAULT 0 0 0 65535 ECU_ADDRESS 0x204A202 READ_WRITE /end MEASUREMENT
/begin MEASUREMENT OUT_PCAN.Tx_Pwr.Out_Supply_ANA_03_Sts.MessageEnable.Task3 "3.3.2.2.1 MessageEnable" UBYTE IS_BOOLEAN_TRUE 0 0 0 1 ECU_ADDRESS 0x204A204 READ_WRITE /end MEASUREMENT
/begin MEASUREMENT OUT_PCAN.Tx_Pwr.Out_Supply_ANA_02_Sts.Supply_ANA_DIAG.Task3 "" UWORD COMP_DEFAULT 0 0 0 65535 ECU_ADDRESS 0x204A206 READ_WRITE /end MEASUREMENT
/begin MEASUREMENT OUT_PCAN.Tx_Pwr.Out_Supply_ANA_02_Sts.Supply_ANA_Val.Task3 "" UWORD COMP_DEFAULT 0 0 0 65535 ECU_ADDRESS 0x204A208 READ_WRITE /end MEASUREMENT
/begin MEASUREMENT OUT_PCAN.Tx_Pwr.Out_Supply_ANA_02_Sts.MessageEnable.Task3 "3.3.2.2.1 MessageEnable" UBYTE IS_BOOLEAN_TRUE 0 0 0 1 ECU_ADDRESS 0x204A20A READ_WRITE /end MEASUREMENT
/begin MEASUREMENT OUT_PCAN.Tx_Pwr.Out_Supply_ANA_01_Sts.Supply_ANA_DIAG.Task3 "" UWORD COMP_DEFAULT 0 0 0 65535 ECU_ADDRESS 0x204A20C READ_WRITE /end MEASUREMENT
/begin MEASUREMENT OUT_PCAN.Tx_Pwr.Out_Supply_ANA_01_Sts.Supply_ANA_Val.Task3 "" UWORD COMP_DEFAULT 0 0 0 65535 ECU_ADDRESS 0x204A20E READ_WRITE /end MEASUREMENT
/begin MEASUREMENT OUT_PCAN.Tx_Pwr.Out_Supply_ANA_01_Sts.MessageEnable.Task3 "3.3.2.2.1 MessageEnable" UBYTE IS_BOOLEAN_TRUE 0 0 0 1 ECU_ADDRESS 0x204A210 READ_WRITE /end MEASUREMENT
/begin MEASUREMENT OUT_PCAN.Tx_Acc.Lin_Sts.BatteryVoltage.Task5 "" UWORD COMP_DEFAULT 0 0 0 65535 ECU_ADDRESS 0x204C036 READ_WRITE /end MEASUREMENT
/begin MEASUREMENT OUT_PCAN.Tx_Acc.Lin_Sts.Button_KL15.Task5 "" UBYTE IS_BOOLEAN_TRUE 0 0 0 1 ECU_ADDRESS 0x204C038 READ_WRITE /end MEASUREMENT
/begin MEASUREMENT OUT_PCAN.Tx_Acc.Lin_Sts.MessageEnable.Task5 "3.3.2.2.1 MessageEnable" UBYTE IS_BOOLEAN_TRUE 0 0 0 1 ECU_ADDRESS 0x204C039 READ_WRITE /end MEASUREMENT
/begin MEASUREMENT OUT_PCAN.Tx_Acc.ACCELEROMETER.X.Task5 "" UWORD COMP_DEFAULT 0 0 0 0 ECU_ADDRESS 0x204C03A READ_WRITE /end MEASUREMENT
/begin MEASUREMENT OUT_PCAN.Tx_Acc.ACCELEROMETER.Y.Task5 "" UWORD COMP_DEFAULT 0 0 0 0 ECU_ADDRESS 0x204C03C READ_WRITE /end MEASUREMENT
/begin MEASUREMENT OUT_PCAN.Tx_Acc.ACCELEROMETER.Z.Task5 "" UWORD COMP_DEFAULT 0 0 0 0 ECU_ADDRESS 0x204C03E READ_WRITE /end MEASUREMENT
/begin MEASUREMENT OUT_PCAN.Tx_Acc.ACCELEROMETER.MessageEnable.Task5 "3.3.2.2.1 MessageEnable" UBYTE IS_BOOLEAN_TRUE 0 0 0 1 ECU_ADDRESS 0x204C040 READ_WRITE /end MEASUREMENT
/begin MEASUREMENT OUT_PCAN.Tx_Out.Out_27_Sts.Out_DIAG.Task3 "" UWORD COMP_DEFAULT 0 0 0 65535 ECU_ADDRESS 0x204A212 READ_WRITE /end MEASUREMENT
/begin MEASUREMENT OUT_PCAN.Tx_Out.Out_27_Sts.Out_SENSE.Task3 "" UWORD COMP_DEFAULT 0 0 0 65535 ECU_ADDRESS 0x204A214 READ_WRITE /end MEASUREMENT
/begin MEASUREMENT OUT_PCAN.Tx_Out.Out_27_Sts.MessageEnable.Task3 "3.3.2.2.1 MessageEnable" UBYTE IS_BOOLEAN_TRUE 0 0 0 1 ECU_ADDRESS 0x204A216 READ_WRITE /end MEASUREMENT
/begin MEASUREMENT OUT_PCAN.Tx_Out.Out_27_Sts.Out_STATUS.Task3 "" UBYTE COMP_DEFAULT 0 0 0 255 ECU_ADDRESS 0x204A217 READ_WRITE /end MEASUREMENT
/begin MEASUREMENT OUT_PCAN.Tx_Out.Out_26_Sts.Out_DIAG.Task3 "" UWORD COMP_DEFAULT 0 0 0 65535 ECU_ADDRESS 0x204A218 READ_WRITE /end MEASUREMENT
/begin MEASUREMENT OUT_PCAN.Tx_Out.Out_26_Sts.Out_SENSE.Task3 "" UWORD COMP_DEFAULT 0 0 0 65535 ECU_ADDRESS 0x204A21A READ_WRITE /end MEASUREMENT
/begin MEASUREMENT OUT_PCAN.Tx_Out.Out_26_Sts.MessageEnable.Task3 "3.3.2.2.1 MessageEnable" UBYTE IS_BOOLEAN_TRUE 0 0 0 1 ECU_ADDRESS 0x204A21C READ_WRITE /end MEASUREMENT
/begin MEASUREMENT OUT_PCAN.Tx_Out.Out_26_Sts.Out_STATUS.Task3 "" UBYTE COMP_DEFAULT 0 0 0 255 ECU_ADDRESS 0x204A21D READ_WRITE /end MEASUREMENT
/begin MEASUREMENT OUT_PCAN.Tx_Out.Out_25_Sts.Out_DIAG.Task3 "" UWORD COMP_DEFAULT 0 0 0 65535 ECU_ADDRESS 0x204A21E READ_WRITE /end MEASUREMENT
/begin MEASUREMENT OUT_PCAN.Tx_Out.Out_25_Sts.Out_SENSE.Task3 "" UWORD COMP_DEFAULT 0 0 0 65535 ECU_ADDRESS 0x204A220 READ_WRITE /end MEASUREMENT
/begin MEASUREMENT OUT_PCAN.Tx_Out.Out_25_Sts.MessageEnable.Task3 "3.3.2.2.1 MessageEnable" UBYTE IS_BOOLEAN_TRUE 0 0 0 1 ECU_ADDRESS 0x204A222 READ_WRITE /end MEASUREMENT
/begin MEASUREMENT OUT_PCAN.Tx_Out.Out_25_Sts.Out_STATUS.Task3 "" UBYTE COMP_DEFAULT 0 0 0 255 ECU_ADDRESS 0x204A223 READ_WRITE /end MEASUREMENT
/begin MEASUREMENT OUT_PCAN.Tx_Out.Out_24_Sts.Out_DIAG.Task3 "" UWORD COMP_DEFAULT 0 0 0 65535 ECU_ADDRESS 0x204A224 READ_WRITE /end MEASUREMENT
/begin MEASUREMENT OUT_PCAN.Tx_Out.Out_24_Sts.Out_SENSE.Task3 "" UWORD COMP_DEFAULT 0 0 0 65535 ECU_ADDRESS 0x204A226 READ_WRITE /end MEASUREMENT
/begin MEASUREMENT OUT_PCAN.Tx_Out.Out_24_Sts.MessageEnable.Task3 "3.3.2.2.1 MessageEnable" UBYTE IS_BOOLEAN_TRUE 0 0 0 1 ECU_ADDRESS 0x204A228 READ_WRITE /end MEASUREMENT
/begin MEASUREMENT OUT_PCAN.Tx_Out.Out_24_Sts.Out_STATUS.Task3 "" UBYTE COMP_DEFAULT 0 0 0 255 ECU_ADDRESS 0x204A229 READ_WRITE /end MEASUREMENT
/begin MEASUREMENT OUT_PCAN.Tx_Out.Out_23_Sts.Out_DIAG.Task3 "" UWORD COMP_DEFAULT 0 0 0 65535 ECU_ADDRESS 0x204A22A READ_WRITE /end MEASUREMENT
/begin MEASUREMENT OUT_PCAN.Tx_Out.Out_23_Sts.Out_SENSE.Task3 "" UWORD COMP_DEFAULT 0 0 0 65535 ECU_ADDRESS 0x204A22C READ_WRITE /end MEASUREMENT
/begin MEASUREMENT OUT_PCAN.Tx_Out.Out_23_Sts.MessageEnable.Task3 "3.3.2.2.1 MessageEnable" UBYTE IS_BOOLEAN_TRUE 0 0 0 1 ECU_ADDRESS 0x204A22E READ_WRITE /end MEASUREMENT
/begin MEASUREMENT OUT_PCAN.Tx_Out.Out_23_Sts.Out_STATUS.Task3 "" UBYTE COMP_DEFAULT 0 0 0 255 ECU_ADDRESS 0x204A22F READ_WRITE /end MEASUREMENT
/begin MEASUREMENT OUT_PCAN.Tx_Out.Out_22_Sts.Out_DIAG.Task3 "" UWORD COMP_DEFAULT 0 0 0 65535 ECU_ADDRESS 0x204A230 READ_WRITE /end MEASUREMENT
/begin MEASUREMENT OUT_PCAN.Tx_Out.Out_22_Sts.Out_SENSE.Task3 "" UWORD COMP_DEFAULT 0 0 0 65535 ECU_ADDRESS 0x204A232 READ_WRITE /end MEASUREMENT
/begin MEASUREMENT OUT_PCAN.Tx_Out.Out_22_Sts.MessageEnable.Task3 "3.3.2.2.1 MessageEnable" UBYTE IS_BOOLEAN_TRUE 0 0 0 1 ECU_ADDRESS 0x204A234 READ_WRITE /end MEASUREMENT
/begin MEASUREMENT OUT_PCAN.Tx_Out.Out_22_Sts.Out_STATUS.Task3 "" UBYTE COMP_DEFAULT 0 0 0 255 ECU_ADDRESS 0x204A235 READ_WRITE /end MEASUREMENT
/begin MEASUREMENT OUT_PCAN.Tx_Out.Out_21_Sts.Out_DIAG.Task3 "" UWORD COMP_DEFAULT 0 0 0 65535 ECU_ADDRESS 0x204A236 READ_WRITE /end MEASUREMENT
/begin MEASUREMENT OUT_PCAN.Tx_Out.Out_21_Sts.Out_SENSE.Task3 "" UWORD COMP_DEFAULT 0 0 0 65535 ECU_ADDRESS 0x204A238 READ_WRITE /end MEASUREMENT
/begin MEASUREMENT OUT_PCAN.Tx_Out.Out_21_Sts.Out_TD_DIAG.Task3 "" UWORD COMP_DEFAULT 0 0 0 0 ECU_ADDRESS 0x204A23A READ_WRITE /end MEASUREMENT
/begin MEASUREMENT OUT_PCAN.Tx_Out.Out_21_Sts.MessageEnable.Task3 "3.3.2.2.1 MessageEnable" UBYTE IS_BOOLEAN_TRUE 0 0 0 1 ECU_ADDRESS 0x204A23C READ_WRITE /end MEASUREMENT
/begin MEASUREMENT OUT_PCAN.Tx_Out.Out_21_Sts.Out_STATUS.Task3 "" UBYTE COMP_DEFAULT 0 0 0 255 ECU_ADDRESS 0x204A23D READ_WRITE /end MEASUREMENT
/begin MEASUREMENT OUT_PCAN.Tx_Out.Out_21_Sts.Out_TD.Task3 "" UBYTE IS_BOOLEAN_TRUE 0 0 0 0 ECU_ADDRESS 0x204A23E READ_WRITE /end MEASUREMENT
/begin MEASUREMENT OUT_PCAN.Tx_Out.Out_20_Sts.Out_DIAG.Task3 "" UWORD COMP_DEFAULT 0 0 0 65535 ECU_ADDRESS 0x204A240 READ_WRITE /end MEASUREMENT
/begin MEASUREMENT OUT_PCAN.Tx_Out.Out_20_Sts.Out_SENSE.Task3 "" UWORD COMP_DEFAULT 0 0 0 65535 ECU_ADDRESS 0x204A242 READ_WRITE /end MEASUREMENT
/begin MEASUREMENT OUT_PCAN.Tx_Out.Out_20_Sts.Out_TD_DIAG.Task3 "" UWORD COMP_DEFAULT 0 0 0 0 ECU_ADDRESS 0x204A244 READ_WRITE /end MEASUREMENT
/begin MEASUREMENT OUT_PCAN.Tx_Out.Out_20_Sts.MessageEnable.Task3 "3.3.2.2.1 MessageEnable" UBYTE IS_BOOLEAN_TRUE 0 0 0 1 ECU_ADDRESS 0x204A246 READ_WRITE /end MEASUREMENT
/begin MEASUREMENT OUT_PCAN.Tx_Out.Out_20_Sts.Out_STATUS.Task3 "" UBYTE COMP_DEFAULT 0 0 0 255 ECU_ADDRESS 0x204A247 READ_WRITE /end MEASUREMENT
/begin MEASUREMENT OUT_PCAN.Tx_Out.Out_20_Sts.Out_TD.Task3 "" UBYTE IS_BOOLEAN_TRUE 0 0 0 0 ECU_ADDRESS 0x204A248 READ_WRITE /end MEASUREMENT
/begin MEASUREMENT OUT_PCAN.Tx_Out.Out_19_Sts.Out_DIAG.Task3 "" UWORD COMP_DEFAULT 0 0 0 65535 ECU_ADDRESS 0x204A24A READ_WRITE /end MEASUREMENT
/begin MEASUREMENT OUT_PCAN.Tx_Out.Out_19_Sts.Out_SENSE.Task3 "" UWORD COMP_DEFAULT 0 0 0 65535 ECU_ADDRESS 0x204A24C READ_WRITE /end MEASUREMENT
/begin MEASUREMENT OUT_PCAN.Tx_Out.Out_19_Sts.MessageEnable.Task3 "3.3.2.2.1 MessageEnable" UBYTE IS_BOOLEAN_TRUE 0 0 0 1 ECU_ADDRESS 0x204A24E READ_WRITE /end MEASUREMENT
/begin MEASUREMENT OUT_PCAN.Tx_Out.Out_19_Sts.Out_STATUS.Task3 "" UBYTE COMP_DEFAULT 0 0 0 255 ECU_ADDRESS 0x204A24F READ_WRITE /end MEASUREMENT
/begin MEASUREMENT OUT_PCAN.Tx_Out.Out_18_Sts.Out_DIAG.Task3 "" UWORD COMP_DEFAULT 0 0 0 65535 ECU_ADDRESS 0x204A250 READ_WRITE /end MEASUREMENT
/begin MEASUREMENT OUT_PCAN.Tx_Out.Out_18_Sts.Out_SENSE.Task3 "" UWORD COMP_DEFAULT 0 0 0 65535 ECU_ADDRESS 0x204A252 READ_WRITE /end MEASUREMENT
/begin MEASUREMENT OUT_PCAN.Tx_Out.Out_18_Sts.MessageEnable.Task3 "3.3.2.2.1 MessageEnable" UBYTE IS_BOOLEAN_TRUE 0 0 0 1 ECU_ADDRESS 0x204A254 READ_WRITE /end MEASUREMENT
/begin MEASUREMENT OUT_PCAN.Tx_Out.Out_18_Sts.Out_STATUS.Task3 "" UBYTE COMP_DEFAULT 0 0 0 255 ECU_ADDRESS 0x204A255 READ_WRITE /end MEASUREMENT
/begin MEASUREMENT OUT_PCAN.Tx_Out.Out_17_Sts.Out_DIAG.Task3 "" UWORD COMP_DEFAULT 0 0 0 65535 ECU_ADDRESS 0x204A256 READ_WRITE /end MEASUREMENT
/begin MEASUREMENT OUT_PCAN.Tx_Out.Out_17_Sts.Out_SENSE.Task3 "" UWORD COMP_DEFAULT 0 0 0 65535 ECU_ADDRESS 0x204A258 READ_WRITE /end MEASUREMENT
/begin MEASUREMENT OUT_PCAN.Tx_Out.Out_17_Sts.MessageEnable.Task3 "3.3.2.2.1 MessageEnable" UBYTE IS_BOOLEAN_TRUE 0 0 0 1 ECU_ADDRESS 0x204A25A READ_WRITE /end MEASUREMENT
/begin MEASUREMENT OUT_PCAN.Tx_Out.Out_17_Sts.Out_STATUS.Task3 "" UBYTE COMP_DEFAULT 0 0 0 255 ECU_ADDRESS 0x204A25B READ_WRITE /end MEASUREMENT
/begin MEASUREMENT OUT_PCAN.Tx_Out.Out_16_Sts.Out_DIAG.Task3 "" UWORD COMP_DEFAULT 0 0 0 65535 ECU_ADDRESS 0x204A25C READ_WRITE /end MEASUREMENT
/begin MEASUREMENT OUT_PCAN.Tx_Out.Out_16_Sts.Out_SENSE.Task3 "" UWORD COMP_DEFAULT 0 0 0 65535 ECU_ADDRESS 0x204A25E READ_WRITE /end MEASUREMENT
/begin MEASUREMENT OUT_PCAN.Tx_Out.Out_16_Sts.MessageEnable.Task3 "3.3.2.2.1 MessageEnable" UBYTE IS_BOOLEAN_TRUE 0 0 0 1 ECU_ADDRESS 0x204A260 READ_WRITE /end MEASUREMENT
/begin MEASUREMENT OUT_PCAN.Tx_Out.Out_16_Sts.Out_STATUS.Task3 "" UBYTE COMP_DEFAULT 0 0 0 255 ECU_ADDRESS 0x204A261 READ_WRITE /end MEASUREMENT
/begin MEASUREMENT OUT_PCAN.Tx_Out.Out_15_Sts.Out_DIAG.Task3 "" UWORD COMP_DEFAULT 0 0 0 65535 ECU_ADDRESS 0x204A262 READ_WRITE /end MEASUREMENT
/begin MEASUREMENT OUT_PCAN.Tx_Out.Out_15_Sts.Out_SENSE.Task3 "" UWORD COMP_DEFAULT 0 0 0 65535 ECU_ADDRESS 0x204A264 READ_WRITE /end MEASUREMENT
/begin MEASUREMENT OUT_PCAN.Tx_Out.Out_15_Sts.Out_TD_DIAG.Task3 "" UWORD COMP_DEFAULT 0 0 0 0 ECU_ADDRESS 0x204A266 READ_WRITE /end MEASUREMENT
/begin MEASUREMENT OUT_PCAN.Tx_Out.Out_15_Sts.MessageEnable.Task3 "3.3.2.2.1 MessageEnable" UBYTE IS_BOOLEAN_TRUE 0 0 0 1 ECU_ADDRESS 0x204A268 READ_WRITE /end MEASUREMENT
/begin MEASUREMENT OUT_PCAN.Tx_Out.Out_15_Sts.Out_STATUS.Task3 "" UBYTE COMP_DEFAULT 0 0 0 255 ECU_ADDRESS 0x204A269 READ_WRITE /end MEASUREMENT
/begin MEASUREMENT OUT_PCAN.Tx_Out.Out_15_Sts.Out_TD.Task3 "" UBYTE IS_BOOLEAN_TRUE 0 0 0 0 ECU_ADDRESS 0x204A26A READ_WRITE /end MEASUREMENT
/begin MEASUREMENT OUT_PCAN.Tx_Out.Out_14_Sts.Out_DIAG.Task3 "" UWORD COMP_DEFAULT 0 0 0 65535 ECU_ADDRESS 0x204A26C READ_WRITE /end MEASUREMENT
/begin MEASUREMENT OUT_PCAN.Tx_Out.Out_14_Sts.Out_SENSE.Task3 "" UWORD COMP_DEFAULT 0 0 0 65535 ECU_ADDRESS 0x204A26E READ_WRITE /end MEASUREMENT
/begin MEASUREMENT OUT_PCAN.Tx_Out.Out_14_Sts.Out_TD_DIAG.Task3 "" UWORD COMP_DEFAULT 0 0 0 0 ECU_ADDRESS 0x204A270 READ_WRITE /end MEASUREMENT
/begin MEASUREMENT OUT_PCAN.Tx_Out.Out_14_Sts.MessageEnable.Task3 "3.3.2.2.1 MessageEnable" UBYTE IS_BOOLEAN_TRUE 0 0 0 1 ECU_ADDRESS 0x204A272 READ_WRITE /end MEASUREMENT
/begin MEASUREMENT OUT_PCAN.Tx_Out.Out_14_Sts.Out_STATUS.Task3 "" UBYTE COMP_DEFAULT 0 0 0 255 ECU_ADDRESS 0x204A273 READ_WRITE /end MEASUREMENT
/begin MEASUREMENT OUT_PCAN.Tx_Out.Out_14_Sts.Out_TD.Task3 "" UBYTE IS_BOOLEAN_TRUE 0 0 0 0 ECU_ADDRESS 0x204A274 READ_WRITE /end MEASUREMENT
/begin MEASUREMENT OUT_PCAN.Tx_Out.Out_13_Sts.Out_DIAG.Task3 "" UWORD COMP_DEFAULT 0 0 0 65535 ECU_ADDRESS 0x204A276 READ_WRITE /end MEASUREMENT
/begin MEASUREMENT OUT_PCAN.Tx_Out.Out_13_Sts.Out_SENSE.Task3 "" UWORD COMP_DEFAULT 0 0 0 65535 ECU_ADDRESS 0x204A278 READ_WRITE /end MEASUREMENT
/begin MEASUREMENT OUT_PCAN.Tx_Out.Out_13_Sts.Out_TD_DIAG.Task3 "" UWORD COMP_DEFAULT 0 0 0 0 ECU_ADDRESS 0x204A27A READ_WRITE /end MEASUREMENT
/begin MEASUREMENT OUT_PCAN.Tx_Out.Out_13_Sts.MessageEnable.Task3 "3.3.2.2.1 MessageEnable" UBYTE IS_BOOLEAN_TRUE 0 0 0 1 ECU_ADDRESS 0x204A27C READ_WRITE /end MEASUREMENT
/begin MEASUREMENT OUT_PCAN.Tx_Out.Out_13_Sts.Out_STATUS.Task3 "" UBYTE COMP_DEFAULT 0 0 0 255 ECU_ADDRESS 0x204A27D READ_WRITE /end MEASUREMENT
/begin MEASUREMENT OUT_PCAN.Tx_Out.Out_13_Sts.Out_TD.Task3 "" UBYTE IS_BOOLEAN_TRUE 0 0 0 0 ECU_ADDRESS 0x204A27E READ_WRITE /end MEASUREMENT
/begin MEASUREMENT OUT_PCAN.Tx_Out.Out_12_Sts.Out_DIAG.Task3 "" UWORD COMP_DEFAULT 0 0 0 65535 ECU_ADDRESS 0x204A280 READ_WRITE /end MEASUREMENT
/begin MEASUREMENT OUT_PCAN.Tx_Out.Out_12_Sts.Out_SENSE.Task3 "" UWORD COMP_DEFAULT 0 0 0 65535 ECU_ADDRESS 0x204A282 READ_WRITE /end MEASUREMENT
/begin MEASUREMENT OUT_PCAN.Tx_Out.Out_12_Sts.Out_TD_DIAG.Task3 "" UWORD COMP_DEFAULT 0 0 0 0 ECU_ADDRESS 0x204A284 READ_WRITE /end MEASUREMENT
/begin MEASUREMENT OUT_PCAN.Tx_Out.Out_12_Sts.MessageEnable.Task3 "3.3.2.2.1 MessageEnable" UBYTE IS_BOOLEAN_TRUE 0 0 0 1 ECU_ADDRESS 0x204A286 READ_WRITE /end MEASUREMENT
/begin MEASUREMENT OUT_PCAN.Tx_Out.Out_12_Sts.Out_STATUS.Task3 "" UBYTE COMP_DEFAULT 0 0 0 255 ECU_ADDRESS 0x204A287 READ_WRITE /end MEASUREMENT
/begin MEASUREMENT OUT_PCAN.Tx_Out.Out_12_Sts.Out_TD.Task3 "" UBYTE IS_BOOLEAN_TRUE 0 0 0 0 ECU_ADDRESS 0x204A288 READ_WRITE /end MEASUREMENT
/begin MEASUREMENT OUT_PCAN.Tx_Out.Out_11_Sts.Out_DIAG.Task3 "" UWORD COMP_DEFAULT 0 0 0 65535 ECU_ADDRESS 0x204A28A READ_WRITE /end MEASUREMENT
/begin MEASUREMENT OUT_PCAN.Tx_Out.Out_11_Sts.Out_SENSE.Task3 "" UWORD COMP_DEFAULT 0 0 0 65535 ECU_ADDRESS 0x204A28C READ_WRITE /end MEASUREMENT
/begin MEASUREMENT OUT_PCAN.Tx_Out.Out_11_Sts.MessageEnable.Task3 "3.3.2.2.1 MessageEnable" UBYTE IS_BOOLEAN_TRUE 0 0 0 1 ECU_ADDRESS 0x204A28E READ_WRITE /end MEASUREMENT
/begin MEASUREMENT OUT_PCAN.Tx_Out.Out_11_Sts.Out_STATUS.Task3 "" UBYTE COMP_DEFAULT 0 0 0 255 ECU_ADDRESS 0x204A28F READ_WRITE /end MEASUREMENT
/begin MEASUREMENT OUT_PCAN.Tx_Out.Out_10_Sts.Out_DIAG.Task3 "" UWORD COMP_DEFAULT 0 0 0 65535 ECU_ADDRESS 0x204A290 READ_WRITE /end MEASUREMENT
/begin MEASUREMENT OUT_PCAN.Tx_Out.Out_10_Sts.Out_SENSE.Task3 "" UWORD COMP_DEFAULT 0 0 0 65535 ECU_ADDRESS 0x204A292 READ_WRITE /end MEASUREMENT
/begin MEASUREMENT OUT_PCAN.Tx_Out.Out_10_Sts.MessageEnable.Task3 "3.3.2.2.1 MessageEnable" UBYTE IS_BOOLEAN_TRUE 0 0 0 1 ECU_ADDRESS 0x204A294 READ_WRITE /end MEASUREMENT
/begin MEASUREMENT OUT_PCAN.Tx_Out.Out_10_Sts.Out_STATUS.Task3 "" UBYTE COMP_DEFAULT 0 0 0 255 ECU_ADDRESS 0x204A295 READ_WRITE /end MEASUREMENT
/begin MEASUREMENT OUT_PCAN.Tx_Out.Out_09_Sts.Out_DIAG.Task3 "" UWORD COMP_DEFAULT 0 0 0 65535 ECU_ADDRESS 0x204A296 READ_WRITE /end MEASUREMENT
/begin MEASUREMENT OUT_PCAN.Tx_Out.Out_09_Sts.Out_SENSE.Task3 "" UWORD COMP_DEFAULT 0 0 0 65535 ECU_ADDRESS 0x204A298 READ_WRITE /end MEASUREMENT
/begin MEASUREMENT OUT_PCAN.Tx_Out.Out_09_Sts.MessageEnable.Task3 "3.3.2.2.1 MessageEnable" UBYTE IS_BOOLEAN_TRUE 0 0 0 1 ECU_ADDRESS 0x204A29A READ_WRITE /end MEASUREMENT
/begin MEASUREMENT OUT_PCAN.Tx_Out.Out_09_Sts.Out_STATUS.Task3 "" UBYTE COMP_DEFAULT 0 0 0 255 ECU_ADDRESS 0x204A29B READ_WRITE /end MEASUREMENT
/begin MEASUREMENT OUT_PCAN.Tx_Out.Out_08_Sts.Out_DIAG.Task3 "" UWORD COMP_DEFAULT 0 0 0 65535 ECU_ADDRESS 0x204A29C READ_WRITE /end MEASUREMENT
/begin MEASUREMENT OUT_PCAN.Tx_Out.Out_08_Sts.Out_SENSE.Task3 "" UWORD COMP_DEFAULT 0 0 0 65535 ECU_ADDRESS 0x204A29E READ_WRITE /end MEASUREMENT
/begin MEASUREMENT OUT_PCAN.Tx_Out.Out_08_Sts.Out_TD_DIAG.Task3 "" UWORD COMP_DEFAULT 0 0 0 0 ECU_ADDRESS 0x204A2A0 READ_WRITE /end MEASUREMENT
/begin MEASUREMENT OUT_PCAN.Tx_Out.Out_08_Sts.MessageEnable.Task3 "3.3.2.2.1 MessageEnable" UBYTE IS_BOOLEAN_TRUE 0 0 0 1 ECU_ADDRESS 0x204A2A2 READ_WRITE /end MEASUREMENT
/begin MEASUREMENT OUT_PCAN.Tx_Out.Out_08_Sts.Out_STATUS.Task3 "" UBYTE COMP_DEFAULT 0 0 0 255 ECU_ADDRESS 0x204A2A3 READ_WRITE /end MEASUREMENT
/begin MEASUREMENT OUT_PCAN.Tx_Out.Out_08_Sts.Out_TD.Task3 "" UBYTE IS_BOOLEAN_TRUE 0 0 0 0 ECU_ADDRESS 0x204A2A4 READ_WRITE /end MEASUREMENT
/begin MEASUREMENT OUT_PCAN.Tx_Out.Out_07_Sts.Out_DIAG.Task3 "" UWORD COMP_DEFAULT 0 0 0 65535 ECU_ADDRESS 0x204A2A6 READ_WRITE /end MEASUREMENT
/begin MEASUREMENT OUT_PCAN.Tx_Out.Out_07_Sts.Out_SENSE.Task3 "" UWORD COMP_DEFAULT 0 0 0 65535 ECU_ADDRESS 0x204A2A8 READ_WRITE /end MEASUREMENT
/begin MEASUREMENT OUT_PCAN.Tx_Out.Out_07_Sts.Out_TD_DIAG.Task3 "" UWORD COMP_DEFAULT 0 0 0 0 ECU_ADDRESS 0x204A2AA READ_WRITE /end MEASUREMENT
/begin MEASUREMENT OUT_PCAN.Tx_Out.Out_07_Sts.MessageEnable.Task3 "3.3.2.2.1 MessageEnable" UBYTE IS_BOOLEAN_TRUE 0 0 0 1 ECU_ADDRESS 0x204A2AC READ_WRITE /end MEASUREMENT
/begin MEASUREMENT OUT_PCAN.Tx_Out.Out_07_Sts.Out_STATUS.Task3 "" UBYTE COMP_DEFAULT 0 0 0 255 ECU_ADDRESS 0x204A2AD READ_WRITE /end MEASUREMENT
/begin MEASUREMENT OUT_PCAN.Tx_Out.Out_07_Sts.Out_TD.Task3 "" UBYTE IS_BOOLEAN_TRUE 0 0 0 0 ECU_ADDRESS 0x204A2AE READ_WRITE /end MEASUREMENT
/begin MEASUREMENT OUT_PCAN.Tx_Out.Out_06_Sts.Out_DIAG.Task3 "" UWORD COMP_DEFAULT 0 0 0 65535 ECU_ADDRESS 0x204A2B0 READ_WRITE /end MEASUREMENT
/begin MEASUREMENT OUT_PCAN.Tx_Out.Out_06_Sts.Out_SENSE.Task3 "" UWORD COMP_DEFAULT 0 0 0 65535 ECU_ADDRESS 0x204A2B2 READ_WRITE /end MEASUREMENT
/begin MEASUREMENT OUT_PCAN.Tx_Out.Out_06_Sts.Out_TD_DIAG.Task3 "" UWORD COMP_DEFAULT 0 0 0 0 ECU_ADDRESS 0x204A2B4 READ_WRITE /end MEASUREMENT
/begin MEASUREMENT OUT_PCAN.Tx_Out.Out_06_Sts.MessageEnable.Task3 "3.3.2.2.1 MessageEnable" UBYTE IS_BOOLEAN_TRUE 0 0 0 1 ECU_ADDRESS 0x204A2B6 READ_WRITE /end MEASUREMENT
/begin MEASUREMENT OUT_PCAN.Tx_Out.Out_06_Sts.Out_STATUS.Task3 "" UBYTE COMP_DEFAULT 0 0 0 255 ECU_ADDRESS 0x204A2B7 READ_WRITE /end MEASUREMENT
/begin MEASUREMENT OUT_PCAN.Tx_Out.Out_06_Sts.Out_TD.Task3 "" UBYTE IS_BOOLEAN_TRUE 0 0 0 0 ECU_ADDRESS 0x204A2B8 READ_WRITE /end MEASUREMENT
/begin MEASUREMENT OUT_PCAN.Tx_Out.Out_05_Sts.Out_DIAG.Task3 "" UWORD COMP_DEFAULT 0 0 0 65535 ECU_ADDRESS 0x204A2BA READ_WRITE /end MEASUREMENT
/begin MEASUREMENT OUT_PCAN.Tx_Out.Out_05_Sts.Out_SENSE.Task3 "" UWORD COMP_DEFAULT 0 0 0 65535 ECU_ADDRESS 0x204A2BC READ_WRITE /end MEASUREMENT
/begin MEASUREMENT OUT_PCAN.Tx_Out.Out_05_Sts.MessageEnable.Task3 "3.3.2.2.1 MessageEnable" UBYTE IS_BOOLEAN_TRUE 0 0 0 1 ECU_ADDRESS 0x204A2BE READ_WRITE /end MEASUREMENT
/begin MEASUREMENT OUT_PCAN.Tx_Out.Out_05_Sts.Out_STATUS.Task3 "" UBYTE COMP_DEFAULT 0 0 0 255 ECU_ADDRESS 0x204A2BF READ_WRITE /end MEASUREMENT
/begin MEASUREMENT OUT_PCAN.Tx_Out.Out_04_Sts.Out_DIAG.Task3 "" UWORD COMP_DEFAULT 0 0 0 65535 ECU_ADDRESS 0x204A2C0 READ_WRITE /end MEASUREMENT
/begin MEASUREMENT OUT_PCAN.Tx_Out.Out_04_Sts.Out_SENSE.Task3 "" UWORD COMP_DEFAULT 0 0 0 65535 ECU_ADDRESS 0x204A2C2 READ_WRITE /end MEASUREMENT
/begin MEASUREMENT OUT_PCAN.Tx_Out.Out_04_Sts.Out_TD_DIAG.Task3 "" UWORD COMP_DEFAULT 0 0 0 0 ECU_ADDRESS 0x204A2C4 READ_WRITE /end MEASUREMENT
/begin MEASUREMENT OUT_PCAN.Tx_Out.Out_04_Sts.MessageEnable.Task3 "3.3.2.2.1 MessageEnable" UBYTE IS_BOOLEAN_TRUE 0 0 0 1 ECU_ADDRESS 0x204A2C6 READ_WRITE /end MEASUREMENT
/begin MEASUREMENT OUT_PCAN.Tx_Out.Out_04_Sts.Out_STATUS.Task3 "" UBYTE COMP_DEFAULT 0 0 0 255 ECU_ADDRESS 0x204A2C7 READ_WRITE /end MEASUREMENT
/begin MEASUREMENT OUT_PCAN.Tx_Out.Out_04_Sts.Out_TD.Task3 "" UBYTE IS_BOOLEAN_TRUE 0 0 0 0 ECU_ADDRESS 0x204A2C8 READ_WRITE /end MEASUREMENT
/begin MEASUREMENT OUT_PCAN.Tx_Out.Out_03_Sts.Out_DIAG.Task3 "" UWORD COMP_DEFAULT 0 0 0 65535 ECU_ADDRESS 0x204A2CA READ_WRITE /end MEASUREMENT
/begin MEASUREMENT OUT_PCAN.Tx_Out.Out_03_Sts.Out_SENSE.Task3 "" UWORD COMP_DEFAULT 0 0 0 65535 ECU_ADDRESS 0x204A2CC READ_WRITE /end MEASUREMENT
/begin MEASUREMENT OUT_PCAN.Tx_Out.Out_03_Sts.MessageEnable.Task3 "3.3.2.2.1 MessageEnable" UBYTE IS_BOOLEAN_TRUE 0 0 0 1 ECU_ADDRESS 0x204A2CE READ_WRITE /end MEASUREMENT
/begin MEASUREMENT OUT_PCAN.Tx_Out.Out_03_Sts.Out_STATUS.Task3 "" UBYTE COMP_DEFAULT 0 0 0 255 ECU_ADDRESS 0x204A2CF READ_WRITE /end MEASUREMENT
/begin MEASUREMENT OUT_PCAN.Tx_Out.Out_02_Sts.Out_DIAG.Task3 "" UWORD COMP_DEFAULT 0 0 0 65535 ECU_ADDRESS 0x204A2D0 READ_WRITE /end MEASUREMENT
/begin MEASUREMENT OUT_PCAN.Tx_Out.Out_02_Sts.Out_SENSE.Task3 "" UWORD COMP_DEFAULT 0 0 0 65535 ECU_ADDRESS 0x204A2D2 READ_WRITE /end MEASUREMENT
/begin MEASUREMENT OUT_PCAN.Tx_Out.Out_02_Sts.MessageEnable.Task3 "3.3.2.2.1 MessageEnable" UBYTE IS_BOOLEAN_TRUE 0 0 0 1 ECU_ADDRESS 0x204A2D4 READ_WRITE /end MEASUREMENT
/begin MEASUREMENT OUT_PCAN.Tx_Out.Out_02_Sts.Out_STATUS.Task3 "" UBYTE COMP_DEFAULT 0 0 0 255 ECU_ADDRESS 0x204A2D5 READ_WRITE /end MEASUREMENT
/begin MEASUREMENT OUT_PCAN.Tx_Out.Out_01_Sts.Out_DIAG.Task3 "" UWORD COMP_DEFAULT 0 0 0 65535 ECU_ADDRESS 0x204A2D6 READ_WRITE /end MEASUREMENT
/begin MEASUREMENT OUT_PCAN.Tx_Out.Out_01_Sts.Out_SENSE.Task3 "" UWORD COMP_DEFAULT 0 0 0 65535 ECU_ADDRESS 0x204A2D8 READ_WRITE /end MEASUREMENT
/begin MEASUREMENT OUT_PCAN.Tx_Out.Out_01_Sts.Out_TD_DIAG.Task3 "" UWORD COMP_DEFAULT 0 0 0 0 ECU_ADDRESS 0x204A2DA READ_WRITE /end MEASUREMENT
/begin MEASUREMENT OUT_PCAN.Tx_Out.Out_01_Sts.MessageEnable.Task3 "3.3.2.2.1 MessageEnable" UBYTE IS_BOOLEAN_TRUE 0 0 0 1 ECU_ADDRESS 0x204A2DC READ_WRITE /end MEASUREMENT
/begin MEASUREMENT OUT_PCAN.Tx_Out.Out_01_Sts.Out_STATUS.Task3 "" UBYTE COMP_DEFAULT 0 0 0 255 ECU_ADDRESS 0x204A2DD READ_WRITE /end MEASUREMENT
/begin MEASUREMENT OUT_PCAN.Tx_Out.Out_01_Sts.Out_TD.Task3 "" UBYTE IS_BOOLEAN_TRUE 0 0 0 0 ECU_ADDRESS 0x204A2DE READ_WRITE /end MEASUREMENT
/begin MEASUREMENT OUT_PCAN.Tx_Out.Out_21_TD_Sts.Out_SENSE_PULSE.Task3 "" UWORD COMP_DEFAULT 0 0 0 0 ECU_ADDRESS 0x204A034 READ_WRITE /end MEASUREMENT
/begin MEASUREMENT OUT_PCAN.Tx_Out.Out_21_TD_Sts.Out_SENSE_PULSE_DIAG.Task3 "" UWORD COMP_DEFAULT 0 0 0 0 ECU_ADDRESS 0x204A036 READ_WRITE /end MEASUREMENT
/begin MEASUREMENT OUT_PCAN.Tx_Out.Out_21_TD_Sts.MessageEnable.Task3 "3.3.2.2.1 MessageEnable" UBYTE IS_BOOLEAN_TRUE 0 0 0 1 ECU_ADDRESS 0x204A038 READ_WRITE /end MEASUREMENT
/begin MEASUREMENT IN_PCAN.DM1_10.MessageState.Task2 "3.1.2.1.1 DeviceState" UWORD COMP_DEFAULT 0 0 0 65535 ECU_ADDRESS 0x204001E READ_WRITE /end MEASUREMENT
/begin MEASUREMENT IN_PCAN.DM1_10.AmberWarningLamp.Task2 "3.1.2.1.5 AmberWarningLamp" UBYTE IS_BOOLEAN_TRUE 0 0 0 1 ECU_ADDRESS 0x2040020 READ_WRITE /end MEASUREMENT
/begin MEASUREMENT IN_PCAN.DM1_10.AmberWarningLampFlash.Task2 "3.1.2.1.5 AmberWarningLamp" UBYTE COMP_DEFAULT 0 0 0 255 ECU_ADDRESS 0x2040021 READ_WRITE /end MEASUREMENT
/begin MEASUREMENT IN_PCAN.DM1_10.MalfunctionIndicatorLamp.Task2 "3.1.2.1.3 MalfunctionIndicatorLamp" UBYTE IS_BOOLEAN_TRUE 0 0 0 1 ECU_ADDRESS 0x2040022 READ_WRITE /end MEASUREMENT
/begin MEASUREMENT IN_PCAN.DM1_10.MalfunctionIndicatorLampFlash.Task2 "3.1.2.1.3 MalfunctionIndicatorLamp" UBYTE COMP_DEFAULT 0 0 0 255 ECU_ADDRESS 0x2040023 READ_WRITE /end MEASUREMENT
/begin MEASUREMENT IN_PCAN.DM1_10.ProtectLamp.Task2 "3.1.2.1.6 ProtectLamp" UBYTE IS_BOOLEAN_TRUE 0 0 0 1 ECU_ADDRESS 0x2040024 READ_WRITE /end MEASUREMENT
/begin MEASUREMENT IN_PCAN.DM1_10.ProtectLampFlash.Task2 "3.1.2.1.6 ProtectLamp" UBYTE COMP_DEFAULT 0 0 0 255 ECU_ADDRESS 0x2040025 READ_WRITE /end MEASUREMENT
/begin MEASUREMENT IN_PCAN.DM1_10.RedStopLamp.Task2 "3.1.2.1.4 RedStopLamp" UBYTE IS_BOOLEAN_TRUE 0 0 0 1 ECU_ADDRESS 0x2040026 READ_WRITE /end MEASUREMENT
/begin MEASUREMENT IN_PCAN.DM1_10.RedStopLampFlash.Task2 "3.1.2.1.4 RedStopLamp" UBYTE COMP_DEFAULT 0 0 0 255 ECU_ADDRESS 0x2040027 READ_WRITE /end MEASUREMENT
/begin MEASUREMENT OUT_PCAN.DM1_10.MessageEnable.Task2 "3.1.2.2.1 DeviceEnable" UBYTE IS_BOOLEAN_TRUE 0 0 0 1 ECU_ADDRESS 0x2049043 READ_WRITE /end MEASUREMENT
/begin MEASUREMENT IN_DM1_10.Filter.boFilter1.Task2 "" UBYTE IS_BOOLEAN_TRUE 0 0 0 1 ECU_ADDRESS 0x204001C READ_WRITE /end MEASUREMENT
/begin MEASUREMENT OUT_PCAN.GenericDM1TxMessage.DeviceEnable.Task2 "3.1.2.2.1 DeviceEnable" UBYTE IS_BOOLEAN_TRUE 0 0 0 1 ECU_ADDRESS 0x2049044 READ_WRITE /end MEASUREMENT
/begin GROUP SYSTEM.P_CAN.Out_06_TD_Sts "Out_06_TD_Sts"
 /begin ANNOTATION ANNOTATION_LABEL "Instance" ANNOTATION_ORIGIN "Group" /begin ANNOTATION_TEXT "8" /end ANNOTATION_TEXT /end ANNOTATION
 /begin ANNOTATION ANNOTATION_LABEL "TaskCycleTime" ANNOTATION_ORIGIN "Group" /begin ANNOTATION_TEXT "0" /end ANNOTATION_TEXT /end ANNOTATION
 /begin ANNOTATION ANNOTATION_LABEL "TimeResolution" ANNOTATION_ORIGIN "Group" /begin ANNOTATION_TEXT "0" /end ANNOTATION_TEXT /end ANNOTATION
 /begin REF_MEASUREMENT OUT_PCAN.Tx_Out.Out_06_TD_Sts.Out_SENSE_PULSE.Task3 OUT_PCAN.Tx_Out.Out_06_TD_Sts.Out_SENSE_PULSE_DIAG.Task3 OUT_PCAN.Tx_Out.Out_06_TD_Sts.MessageEnable.Task3 /end REF_MEASUREMENT
/end GROUP
/begin GROUP SYSTEM.P_CAN.Out_04_TD_Sts "Out_04_TD_Sts"
 /begin ANNOTATION ANNOTATION_LABEL "Instance" ANNOTATION_ORIGIN "Group" /begin ANNOTATION_TEXT "9" /end ANNOTATION_TEXT /end ANNOTATION
 /begin ANNOTATION ANNOTATION_LABEL "TaskCycleTime" ANNOTATION_ORIGIN "Group" /begin ANNOTATION_TEXT "0" /end ANNOTATION_TEXT /end ANNOTATION
 /begin ANNOTATION ANNOTATION_LABEL "TimeResolution" ANNOTATION_ORIGIN "Group" /begin ANNOTATION_TEXT "0" /end ANNOTATION_TEXT /end ANNOTATION
 /begin REF_MEASUREMENT OUT_PCAN.Tx_Out.Out_04_TD_Sts.Out_SENSE_PULSE.Task3 OUT_PCAN.Tx_Out.Out_04_TD_Sts.Out_SENSE_PULSE_DIAG.Task3 OUT_PCAN.Tx_Out.Out_04_TD_Sts.MessageEnable.Task3 /end REF_MEASUREMENT
/end GROUP
/begin GROUP SYSTEM.P_CAN.Out_01_TD_Sts "Out_01_TD_Sts"
 /begin ANNOTATION ANNOTATION_LABEL "Instance" ANNOTATION_ORIGIN "Group" /begin ANNOTATION_TEXT "10" /end ANNOTATION_TEXT /end ANNOTATION
 /begin ANNOTATION ANNOTATION_LABEL "TaskCycleTime" ANNOTATION_ORIGIN "Group" /begin ANNOTATION_TEXT "0" /end ANNOTATION_TEXT /end ANNOTATION
 /begin ANNOTATION ANNOTATION_LABEL "TimeResolution" ANNOTATION_ORIGIN "Group" /begin ANNOTATION_TEXT "0" /end ANNOTATION_TEXT /end ANNOTATION
 /begin REF_MEASUREMENT OUT_PCAN.Tx_Out.Out_01_TD_Sts.Out_SENSE_PULSE.Task3 OUT_PCAN.Tx_Out.Out_01_TD_Sts.Out_SENSE_PULSE_DIAG.Task3 OUT_PCAN.Tx_Out.Out_01_TD_Sts.MessageEnable.Task3 /end REF_MEASUREMENT
/end GROUP
/begin GROUP SYSTEM.P_CAN.DateTime_SetTime_Sts "DateTime_SetTime_Sts"
 /begin ANNOTATION ANNOTATION_LABEL "Instance" ANNOTATION_ORIGIN "Group" /begin ANNOTATION_TEXT "11" /end ANNOTATION_TEXT /end ANNOTATION
 /begin ANNOTATION ANNOTATION_LABEL "TaskCycleTime" ANNOTATION_ORIGIN "Group" /begin ANNOTATION_TEXT "0" /end ANNOTATION_TEXT /end ANNOTATION
 /begin ANNOTATION ANNOTATION_LABEL "TimeResolution" ANNOTATION_ORIGIN "Group" /begin ANNOTATION_TEXT "0" /end ANNOTATION_TEXT /end ANNOTATION
 /begin REF_MEASUREMENT OUT_PCAN.Tx_Date.DateTime_SetTime_Sts.DateTime_DIAG.Task5 OUT_PCAN.Tx_Date.DateTime_SetTime_Sts.MessageEnable.Task5 /end REF_MEASUREMENT
/end GROUP
/begin GROUP SYSTEM.P_CAN.DateTime_TicksCount_Sts "DateTime_TicksCount_Sts"
 /begin ANNOTATION ANNOTATION_LABEL "Instance" ANNOTATION_ORIGIN "Group" /begin ANNOTATION_TEXT "12" /end ANNOTATION_TEXT /end ANNOTATION
 /begin ANNOTATION ANNOTATION_LABEL "TaskCycleTime" ANNOTATION_ORIGIN "Group" /begin ANNOTATION_TEXT "0" /end ANNOTATION_TEXT /end ANNOTATION
 /begin ANNOTATION ANNOTATION_LABEL "TimeResolution" ANNOTATION_ORIGIN "Group" /begin ANNOTATION_TEXT "0" /end ANNOTATION_TEXT /end ANNOTATION
 /begin REF_MEASUREMENT OUT_PCAN.Tx_Date.DateTime_TicksCount_Sts.DateTime_TicksCount.Task5 OUT_PCAN.Tx_Date.DateTime_TicksCount_Sts.MessageEnable.Task5 /end REF_MEASUREMENT
/end GROUP
/begin GROUP SYSTEM.P_CAN.DateTime_SystemTime_Sts "DateTime_SystemTime_Sts"
 /begin ANNOTATION ANNOTATION_LABEL "Instance" ANNOTATION_ORIGIN "Group" /begin ANNOTATION_TEXT "13" /end ANNOTATION_TEXT /end ANNOTATION
 /begin ANNOTATION ANNOTATION_LABEL "TaskCycleTime" ANNOTATION_ORIGIN "Group" /begin ANNOTATION_TEXT "0" /end ANNOTATION_TEXT /end ANNOTATION
 /begin ANNOTATION ANNOTATION_LABEL "TimeResolution" ANNOTATION_ORIGIN "Group" /begin ANNOTATION_TEXT "0" /end ANNOTATION_TEXT /end ANNOTATION
 /begin REF_MEASUREMENT OUT_PCAN.Tx_Date.DateTime_SystemTime_Sts.DateTime_SystemTime.Task5 OUT_PCAN.Tx_Date.DateTime_SystemTime_Sts.DateTime_DIAG.Task5 OUT_PCAN.Tx_Date.DateTime_SystemTime_Sts.MessageEnable.Task5 /end REF_MEASUREMENT
/end GROUP
/begin GROUP SYSTEM.P_CAN.DateTime_LocalTime_Sts "DateTime_LocalTime_Sts"
 /begin ANNOTATION ANNOTATION_LABEL "Instance" ANNOTATION_ORIGIN "Group" /begin ANNOTATION_TEXT "14" /end ANNOTATION_TEXT /end ANNOTATION
 /begin ANNOTATION ANNOTATION_LABEL "TaskCycleTime" ANNOTATION_ORIGIN "Group" /begin ANNOTATION_TEXT "0" /end ANNOTATION_TEXT /end ANNOTATION
 /begin ANNOTATION ANNOTATION_LABEL "TimeResolution" ANNOTATION_ORIGIN "Group" /begin ANNOTATION_TEXT "0" /end ANNOTATION_TEXT /end ANNOTATION
 /begin REF_MEASUREMENT OUT_PCAN.Tx_Date.DateTime_LocalTime_Sts.DateTime_LocalTime.Task5 OUT_PCAN.Tx_Date.DateTime_LocalTime_Sts.DateTime_DIAG.Task5 OUT_PCAN.Tx_Date.DateTime_LocalTime_Sts.MessageEnable.Task5 /end REF_MEASUREMENT
/end GROUP
/begin GROUP SYSTEM.P_CAN.IN_ANA_11_SEL2_Sts "IN_ANA_11_SEL2_Sts"
 /begin ANNOTATION ANNOTATION_LABEL "Instance" ANNOTATION_ORIGIN "Group" /begin ANNOTATION_TEXT "15" /end ANNOTATION_TEXT /end ANNOTATION
 /begin ANNOTATION ANNOTATION_LABEL "TaskCycleTime" ANNOTATION_ORIGIN "Group" /begin ANNOTATION_TEXT "0" /end ANNOTATION_TEXT /end ANNOTATION
 /begin ANNOTATION ANNOTATION_LABEL "TimeResolution" ANNOTATION_ORIGIN "Group" /begin ANNOTATION_TEXT "0" /end ANNOTATION_TEXT /end ANNOTATION
 /begin REF_MEASUREMENT OUT_PCAN.Tx_Ana.IN_ANA_11_SEL2_Sts.IN_ANA_Val.Task3 OUT_PCAN.Tx_Ana.IN_ANA_11_SEL2_Sts.IN_ANA_DIAG.Task3 OUT_PCAN.Tx_Ana.IN_ANA_11_SEL2_Sts.MessageEnable.Task3 /end REF_MEASUREMENT
/end GROUP
/begin GROUP SYSTEM.P_CAN.IN_ANA_10_SEL2_Sts "IN_ANA_10_SEL2_Sts"
 /begin ANNOTATION ANNOTATION_LABEL "Instance" ANNOTATION_ORIGIN "Group" /begin ANNOTATION_TEXT "16" /end ANNOTATION_TEXT /end ANNOTATION
 /begin ANNOTATION ANNOTATION_LABEL "TaskCycleTime" ANNOTATION_ORIGIN "Group" /begin ANNOTATION_TEXT "0" /end ANNOTATION_TEXT /end ANNOTATION
 /begin ANNOTATION ANNOTATION_LABEL "TimeResolution" ANNOTATION_ORIGIN "Group" /begin ANNOTATION_TEXT "0" /end ANNOTATION_TEXT /end ANNOTATION
 /begin REF_MEASUREMENT OUT_PCAN.Tx_Ana.IN_ANA_10_SEL2_Sts.IN_ANA_Val.Task3 OUT_PCAN.Tx_Ana.IN_ANA_10_SEL2_Sts.IN_ANA_DIAG.Task3 OUT_PCAN.Tx_Ana.IN_ANA_10_SEL2_Sts.MessageEnable.Task3 /end REF_MEASUREMENT
/end GROUP
/begin GROUP SYSTEM.P_CAN.IN_ANA_09_SEL2_Sts "IN_ANA_09_SEL2_Sts"
 /begin ANNOTATION ANNOTATION_LABEL "Instance" ANNOTATION_ORIGIN "Group" /begin ANNOTATION_TEXT "17" /end ANNOTATION_TEXT /end ANNOTATION
 /begin ANNOTATION ANNOTATION_LABEL "TaskCycleTime" ANNOTATION_ORIGIN "Group" /begin ANNOTATION_TEXT "0" /end ANNOTATION_TEXT /end ANNOTATION
 /begin ANNOTATION ANNOTATION_LABEL "TimeResolution" ANNOTATION_ORIGIN "Group" /begin ANNOTATION_TEXT "0" /end ANNOTATION_TEXT /end ANNOTATION
 /begin REF_MEASUREMENT OUT_PCAN.Tx_Ana.IN_ANA_09_SEL2_Sts.IN_ANA_Val.Task3 OUT_PCAN.Tx_Ana.IN_ANA_09_SEL2_Sts.IN_ANA_DIAG.Task3 OUT_PCAN.Tx_Ana.IN_ANA_09_SEL2_Sts.MessageEnable.Task3 /end REF_MEASUREMENT
/end GROUP
/begin GROUP SYSTEM.P_CAN.IN_ANA_08_SEL2_Sts "IN_ANA_08_SEL2_Sts"
 /begin ANNOTATION ANNOTATION_LABEL "Instance" ANNOTATION_ORIGIN "Group" /begin ANNOTATION_TEXT "18" /end ANNOTATION_TEXT /end ANNOTATION
 /begin ANNOTATION ANNOTATION_LABEL "TaskCycleTime" ANNOTATION_ORIGIN "Group" /begin ANNOTATION_TEXT "0" /end ANNOTATION_TEXT /end ANNOTATION
 /begin ANNOTATION ANNOTATION_LABEL "TimeResolution" ANNOTATION_ORIGIN "Group" /begin ANNOTATION_TEXT "0" /end ANNOTATION_TEXT /end ANNOTATION
 /begin REF_MEASUREMENT OUT_PCAN.Tx_Ana.IN_ANA_08_SEL2_Sts.IN_ANA_Val.Task3 OUT_PCAN.Tx_Ana.IN_ANA_08_SEL2_Sts.IN_ANA_DIAG.Task3 OUT_PCAN.Tx_Ana.IN_ANA_08_SEL2_Sts.MessageEnable.Task3 /end REF_MEASUREMENT
/end GROUP
/begin GROUP SYSTEM.P_CAN.In_Ana_15_Sts "In_Ana_15_Sts"
 /begin ANNOTATION ANNOTATION_LABEL "Instance" ANNOTATION_ORIGIN "Group" /begin ANNOTATION_TEXT "19" /end ANNOTATION_TEXT /end ANNOTATION
 /begin ANNOTATION ANNOTATION_LABEL "TaskCycleTime" ANNOTATION_ORIGIN "Group" /begin ANNOTATION_TEXT "0" /end ANNOTATION_TEXT /end ANNOTATION
 /begin ANNOTATION ANNOTATION_LABEL "TimeResolution" ANNOTATION_ORIGIN "Group" /begin ANNOTATION_TEXT "0" /end ANNOTATION_TEXT /end ANNOTATION
 /begin REF_MEASUREMENT OUT_PCAN.Tx_Ana.In_Ana_15_Sts.IN_ANA_Val.Task3 OUT_PCAN.Tx_Ana.In_Ana_15_Sts.IN_ANA_DIAG.Task3 OUT_PCAN.Tx_Ana.In_Ana_15_Sts.MessageEnable.Task3 /end REF_MEASUREMENT
/end GROUP
/begin GROUP SYSTEM.P_CAN.In_Ana_14_Sts "In_Ana_14_Sts"
 /begin ANNOTATION ANNOTATION_LABEL "Instance" ANNOTATION_ORIGIN "Group" /begin ANNOTATION_TEXT "20" /end ANNOTATION_TEXT /end ANNOTATION
 /begin ANNOTATION ANNOTATION_LABEL "TaskCycleTime" ANNOTATION_ORIGIN "Group" /begin ANNOTATION_TEXT "0" /end ANNOTATION_TEXT /end ANNOTATION
 /begin ANNOTATION ANNOTATION_LABEL "TimeResolution" ANNOTATION_ORIGIN "Group" /begin ANNOTATION_TEXT "0" /end ANNOTATION_TEXT /end ANNOTATION
 /begin REF_MEASUREMENT OUT_PCAN.Tx_Ana.In_Ana_14_Sts.IN_ANA_Val.Task3 OUT_PCAN.Tx_Ana.In_Ana_14_Sts.IN_ANA_DIAG.Task3 OUT_PCAN.Tx_Ana.In_Ana_14_Sts.MessageEnable.Task3 /end REF_MEASUREMENT
/end GROUP
/begin GROUP SYSTEM.P_CAN.In_Ana_13_Sts "In_Ana_13_Sts"
 /begin ANNOTATION ANNOTATION_LABEL "Instance" ANNOTATION_ORIGIN "Group" /begin ANNOTATION_TEXT "21" /end ANNOTATION_TEXT /end ANNOTATION
 /begin ANNOTATION ANNOTATION_LABEL "TaskCycleTime" ANNOTATION_ORIGIN "Group" /begin ANNOTATION_TEXT "0" /end ANNOTATION_TEXT /end ANNOTATION
 /begin ANNOTATION ANNOTATION_LABEL "TimeResolution" ANNOTATION_ORIGIN "Group" /begin ANNOTATION_TEXT "0" /end ANNOTATION_TEXT /end ANNOTATION
 /begin REF_MEASUREMENT OUT_PCAN.Tx_Ana.In_Ana_13_Sts.IN_ANA_Val.Task3 OUT_PCAN.Tx_Ana.In_Ana_13_Sts.IN_ANA_DIAG.Task3 OUT_PCAN.Tx_Ana.In_Ana_13_Sts.MessageEnable.Task3 /end REF_MEASUREMENT
/end GROUP
/begin GROUP SYSTEM.P_CAN.In_Ana_12_Sts "In_Ana_12_Sts"
 /begin ANNOTATION ANNOTATION_LABEL "Instance" ANNOTATION_ORIGIN "Group" /begin ANNOTATION_TEXT "22" /end ANNOTATION_TEXT /end ANNOTATION
 /begin ANNOTATION ANNOTATION_LABEL "TaskCycleTime" ANNOTATION_ORIGIN "Group" /begin ANNOTATION_TEXT "0" /end ANNOTATION_TEXT /end ANNOTATION
 /begin ANNOTATION ANNOTATION_LABEL "TimeResolution" ANNOTATION_ORIGIN "Group" /begin ANNOTATION_TEXT "0" /end ANNOTATION_TEXT /end ANNOTATION
 /begin REF_MEASUREMENT OUT_PCAN.Tx_Ana.In_Ana_12_Sts.IN_ANA_Val.Task3 OUT_PCAN.Tx_Ana.In_Ana_12_Sts.IN_ANA_DIAG.Task3 OUT_PCAN.Tx_Ana.In_Ana_12_Sts.MessageEnable.Task3 /end REF_MEASUREMENT
/end GROUP
/begin GROUP SYSTEM.P_CAN.IN_ANA_11_SEL1_Sts "IN_ANA_11_SEL1_Sts"
 /begin ANNOTATION ANNOTATION_LABEL "Instance" ANNOTATION_ORIGIN "Group" /begin ANNOTATION_TEXT "23" /end ANNOTATION_TEXT /end ANNOTATION
 /begin ANNOTATION ANNOTATION_LABEL "TaskCycleTime" ANNOTATION_ORIGIN "Group" /begin ANNOTATION_TEXT "0" /end ANNOTATION_TEXT /end ANNOTATION
 /begin ANNOTATION ANNOTATION_LABEL "TimeResolution" ANNOTATION_ORIGIN "Group" /begin ANNOTATION_TEXT "0" /end ANNOTATION_TEXT /end ANNOTATION
 /begin REF_MEASUREMENT OUT_PCAN.Tx_Ana.IN_ANA_11_SEL1_Sts.IN_ANA_Val.Task3 OUT_PCAN.Tx_Ana.IN_ANA_11_SEL1_Sts.IN_ANA_DIAG.Task3 OUT_PCAN.Tx_Ana.IN_ANA_11_SEL1_Sts.MessageEnable.Task3 /end REF_MEASUREMENT
/end GROUP
/begin GROUP SYSTEM.P_CAN.IN_ANA_10_SEL1_Sts "IN_ANA_10_SEL1_Sts"
 /begin ANNOTATION ANNOTATION_LABEL "Instance" ANNOTATION_ORIGIN "Group" /begin ANNOTATION_TEXT "24" /end ANNOTATION_TEXT /end ANNOTATION
 /begin ANNOTATION ANNOTATION_LABEL "TaskCycleTime" ANNOTATION_ORIGIN "Group" /begin ANNOTATION_TEXT "0" /end ANNOTATION_TEXT /end ANNOTATION
 /begin ANNOTATION ANNOTATION_LABEL "TimeResolution" ANNOTATION_ORIGIN "Group" /begin ANNOTATION_TEXT "0" /end ANNOTATION_TEXT /end ANNOTATION
 /begin REF_MEASUREMENT OUT_PCAN.Tx_Ana.IN_ANA_10_SEL1_Sts.IN_ANA_Val.Task3 OUT_PCAN.Tx_Ana.IN_ANA_10_SEL1_Sts.IN_ANA_DIAG.Task3 OUT_PCAN.Tx_Ana.IN_ANA_10_SEL1_Sts.MessageEnable.Task3 /end REF_MEASUREMENT
/end GROUP
/begin GROUP SYSTEM.P_CAN.IN_ANA_09_SEL1_Sts "IN_ANA_09_SEL1_Sts"
 /begin ANNOTATION ANNOTATION_LABEL "Instance" ANNOTATION_ORIGIN "Group" /begin ANNOTATION_TEXT "25" /end ANNOTATION_TEXT /end ANNOTATION
 /begin ANNOTATION ANNOTATION_LABEL "TaskCycleTime" ANNOTATION_ORIGIN "Group" /begin ANNOTATION_TEXT "0" /end ANNOTATION_TEXT /end ANNOTATION
 /begin ANNOTATION ANNOTATION_LABEL "TimeResolution" ANNOTATION_ORIGIN "Group" /begin ANNOTATION_TEXT "0" /end ANNOTATION_TEXT /end ANNOTATION
 /begin REF_MEASUREMENT OUT_PCAN.Tx_Ana.IN_ANA_09_SEL1_Sts.IN_ANA_Val.Task3 OUT_PCAN.Tx_Ana.IN_ANA_09_SEL1_Sts.IN_ANA_DIAG.Task3 OUT_PCAN.Tx_Ana.IN_ANA_09_SEL1_Sts.MessageEnable.Task3 /end REF_MEASUREMENT
/end GROUP
/begin GROUP SYSTEM.P_CAN.IN_ANA_08_SEL1_Sts "IN_ANA_08_SEL1_Sts"
 /begin ANNOTATION ANNOTATION_LABEL "Instance" ANNOTATION_ORIGIN "Group" /begin ANNOTATION_TEXT "26" /end ANNOTATION_TEXT /end ANNOTATION
 /begin ANNOTATION ANNOTATION_LABEL "TaskCycleTime" ANNOTATION_ORIGIN "Group" /begin ANNOTATION_TEXT "0" /end ANNOTATION_TEXT /end ANNOTATION
 /begin ANNOTATION ANNOTATION_LABEL "TimeResolution" ANNOTATION_ORIGIN "Group" /begin ANNOTATION_TEXT "0" /end ANNOTATION_TEXT /end ANNOTATION
 /begin REF_MEASUREMENT OUT_PCAN.Tx_Ana.IN_ANA_08_SEL1_Sts.IN_ANA_Val.Task3 OUT_PCAN.Tx_Ana.IN_ANA_08_SEL1_Sts.IN_ANA_DIAG.Task3 OUT_PCAN.Tx_Ana.IN_ANA_08_SEL1_Sts.MessageEnable.Task3 /end REF_MEASUREMENT
/end GROUP
/begin GROUP SYSTEM.P_CAN.In_Ana_07_Sts "In_Ana_07_Sts"
 /begin ANNOTATION ANNOTATION_LABEL "Instance" ANNOTATION_ORIGIN "Group" /begin ANNOTATION_TEXT "27" /end ANNOTATION_TEXT /end ANNOTATION
 /begin ANNOTATION ANNOTATION_LABEL "TaskCycleTime" ANNOTATION_ORIGIN "Group" /begin ANNOTATION_TEXT "0" /end ANNOTATION_TEXT /end ANNOTATION
 /begin ANNOTATION ANNOTATION_LABEL "TimeResolution" ANNOTATION_ORIGIN "Group" /begin ANNOTATION_TEXT "0" /end ANNOTATION_TEXT /end ANNOTATION
 /begin REF_MEASUREMENT OUT_PCAN.Tx_Ana.In_Ana_07_Sts.IN_ANA_Val.Task3 OUT_PCAN.Tx_Ana.In_Ana_07_Sts.IN_ANA_DIAG.Task3 OUT_PCAN.Tx_Ana.In_Ana_07_Sts.MessageEnable.Task3 /end REF_MEASUREMENT
/end GROUP
/begin GROUP SYSTEM.P_CAN.In_Ana_06_Sts "In_Ana_06_Sts"
 /begin ANNOTATION ANNOTATION_LABEL "Instance" ANNOTATION_ORIGIN "Group" /begin ANNOTATION_TEXT "28" /end ANNOTATION_TEXT /end ANNOTATION
 /begin ANNOTATION ANNOTATION_LABEL "TaskCycleTime" ANNOTATION_ORIGIN "Group" /begin ANNOTATION_TEXT "0" /end ANNOTATION_TEXT /end ANNOTATION
 /begin ANNOTATION ANNOTATION_LABEL "TimeResolution" ANNOTATION_ORIGIN "Group" /begin ANNOTATION_TEXT "0" /end ANNOTATION_TEXT /end ANNOTATION
 /begin REF_MEASUREMENT OUT_PCAN.Tx_Ana.In_Ana_06_Sts.IN_ANA_Val.Task3 OUT_PCAN.Tx_Ana.In_Ana_06_Sts.IN_ANA_DIAG.Task3 OUT_PCAN.Tx_Ana.In_Ana_06_Sts.MessageEnable.Task3 /end REF_MEASUREMENT
/end GROUP
/begin GROUP SYSTEM.P_CAN.In_Ana_05_Sts "In_Ana_05_Sts"
 /begin ANNOTATION ANNOTATION_LABEL "Instance" ANNOTATION_ORIGIN "Group" /begin ANNOTATION_TEXT "29" /end ANNOTATION_TEXT /end ANNOTATION
 /begin ANNOTATION ANNOTATION_LABEL "TaskCycleTime" ANNOTATION_ORIGIN "Group" /begin ANNOTATION_TEXT "0" /end ANNOTATION_TEXT /end ANNOTATION
 /begin ANNOTATION ANNOTATION_LABEL "TimeResolution" ANNOTATION_ORIGIN "Group" /begin ANNOTATION_TEXT "0" /end ANNOTATION_TEXT /end ANNOTATION
 /begin REF_MEASUREMENT OUT_PCAN.Tx_Ana.In_Ana_05_Sts.IN_ANA_Val.Task3 OUT_PCAN.Tx_Ana.In_Ana_05_Sts.IN_ANA_DIAG.Task3 OUT_PCAN.Tx_Ana.In_Ana_05_Sts.MessageEnable.Task3 /end REF_MEASUREMENT
/end GROUP
/begin GROUP SYSTEM.P_CAN.In_Ana_04_Sts "In_Ana_04_Sts"
 /begin ANNOTATION ANNOTATION_LABEL "Instance" ANNOTATION_ORIGIN "Group" /begin ANNOTATION_TEXT "30" /end ANNOTATION_TEXT /end ANNOTATION
 /begin ANNOTATION ANNOTATION_LABEL "TaskCycleTime" ANNOTATION_ORIGIN "Group" /begin ANNOTATION_TEXT "0" /end ANNOTATION_TEXT /end ANNOTATION
 /begin ANNOTATION ANNOTATION_LABEL "TimeResolution" ANNOTATION_ORIGIN "Group" /begin ANNOTATION_TEXT "0" /end ANNOTATION_TEXT /end ANNOTATION
 /begin REF_MEASUREMENT OUT_PCAN.Tx_Ana.In_Ana_04_Sts.IN_ANA_Val.Task3 OUT_PCAN.Tx_Ana.In_Ana_04_Sts.IN_ANA_DIAG.Task3 OUT_PCAN.Tx_Ana.In_Ana_04_Sts.MessageEnable.Task3 /end REF_MEASUREMENT
/end GROUP
/begin GROUP SYSTEM.P_CAN.In_Ana_03_Sts "In_Ana_03_Sts"
 /begin ANNOTATION ANNOTATION_LABEL "Instance" ANNOTATION_ORIGIN "Group" /begin ANNOTATION_TEXT "31" /end ANNOTATION_TEXT /end ANNOTATION
 /begin ANNOTATION ANNOTATION_LABEL "TaskCycleTime" ANNOTATION_ORIGIN "Group" /begin ANNOTATION_TEXT "0" /end ANNOTATION_TEXT /end ANNOTATION
 /begin ANNOTATION ANNOTATION_LABEL "TimeResolution" ANNOTATION_ORIGIN "Group" /begin ANNOTATION_TEXT "0" /end ANNOTATION_TEXT /end ANNOTATION
 /begin REF_MEASUREMENT OUT_PCAN.Tx_Ana.In_Ana_03_Sts.IN_ANA_Val.Task3 OUT_PCAN.Tx_Ana.In_Ana_03_Sts.IN_ANA_DIAG.Task3 OUT_PCAN.Tx_Ana.In_Ana_03_Sts.MessageEnable.Task3 /end REF_MEASUREMENT
/end GROUP
/begin GROUP SYSTEM.P_CAN.In_Ana_02_Sts "In_Ana_02_Sts"
 /begin ANNOTATION ANNOTATION_LABEL "Instance" ANNOTATION_ORIGIN "Group" /begin ANNOTATION_TEXT "32" /end ANNOTATION_TEXT /end ANNOTATION
 /begin ANNOTATION ANNOTATION_LABEL "TaskCycleTime" ANNOTATION_ORIGIN "Group" /begin ANNOTATION_TEXT "0" /end ANNOTATION_TEXT /end ANNOTATION
 /begin ANNOTATION ANNOTATION_LABEL "TimeResolution" ANNOTATION_ORIGIN "Group" /begin ANNOTATION_TEXT "0" /end ANNOTATION_TEXT /end ANNOTATION
 /begin REF_MEASUREMENT OUT_PCAN.Tx_Ana.In_Ana_02_Sts.IN_ANA_Val.Task3 OUT_PCAN.Tx_Ana.In_Ana_02_Sts.IN_ANA_DIAG.Task3 OUT_PCAN.Tx_Ana.In_Ana_02_Sts.MessageEnable.Task3 /end REF_MEASUREMENT
/end GROUP
/begin GROUP SYSTEM.P_CAN.In_Ana_01_Sts "In_Ana_01_Sts"
 /begin ANNOTATION ANNOTATION_LABEL "Instance" ANNOTATION_ORIGIN "Group" /begin ANNOTATION_TEXT "33" /end ANNOTATION_TEXT /end ANNOTATION
 /begin ANNOTATION ANNOTATION_LABEL "TaskCycleTime" ANNOTATION_ORIGIN "Group" /begin ANNOTATION_TEXT "0" /end ANNOTATION_TEXT /end ANNOTATION
 /begin ANNOTATION ANNOTATION_LABEL "TimeResolution" ANNOTATION_ORIGIN "Group" /begin ANNOTATION_TEXT "0" /end ANNOTATION_TEXT /end ANNOTATION
 /begin REF_MEASUREMENT OUT_PCAN.Tx_Ana.In_Ana_01_Sts.IN_ANA_Val.Task3 OUT_PCAN.Tx_Ana.In_Ana_01_Sts.IN_ANA_DIAG.Task3 OUT_PCAN.Tx_Ana.In_Ana_01_Sts.MessageEnable.Task3 /end REF_MEASUREMENT
/end GROUP
/begin GROUP SYSTEM.P_CAN.TSU_Sts "TSU_Sts"
 /begin ANNOTATION ANNOTATION_LABEL "Instance" ANNOTATION_ORIGIN "Group" /begin ANNOTATION_TEXT "34" /end ANNOTATION_TEXT /end ANNOTATION
 /begin ANNOTATION ANNOTATION_LABEL "TaskCycleTime" ANNOTATION_ORIGIN "Group" /begin ANNOTATION_TEXT "0" /end ANNOTATION_TEXT /end ANNOTATION
 /begin ANNOTATION ANNOTATION_LABEL "TimeResolution" ANNOTATION_ORIGIN "Group" /begin ANNOTATION_TEXT "0" /end ANNOTATION_TEXT /end ANNOTATION
 /begin REF_MEASUREMENT OUT_PCAN.Tx_Tsu.TSU_Sts.Speed_Shaft.Task5 OUT_PCAN.Tx_Tsu.TSU_Sts.Speed_Shaft_DIAG.Task5 OUT_PCAN.Tx_Tsu.TSU_Sts.Speed_Vehicle.Task5 OUT_PCAN.Tx_Tsu.TSU_Sts.Speed_Vehicle_DIAG.Task5 OUT_PCAN.Tx_Tsu.TSU_Sts.MessageEnable.Task5 /end REF_MEASUREMENT
/end GROUP
/begin GROUP SYSTEM.P_CAN.PWR_G7_Sts "PWR_G7_Sts"
 /begin ANNOTATION ANNOTATION_LABEL "Instance" ANNOTATION_ORIGIN "Group" /begin ANNOTATION_TEXT "35" /end ANNOTATION_TEXT /end ANNOTATION
 /begin ANNOTATION ANNOTATION_LABEL "TaskCycleTime" ANNOTATION_ORIGIN "Group" /begin ANNOTATION_TEXT "0" /end ANNOTATION_TEXT /end ANNOTATION
 /begin ANNOTATION ANNOTATION_LABEL "TimeResolution" ANNOTATION_ORIGIN "Group" /begin ANNOTATION_TEXT "0" /end ANNOTATION_TEXT /end ANNOTATION
 /begin REF_MEASUREMENT OUT_PCAN.Tx_Pwr.PWR_G7_Sts.PWR_Gx_DIAG.Task3 OUT_PCAN.Tx_Pwr.PWR_G7_Sts.PWR_Gx_Val.Task3 OUT_PCAN.Tx_Pwr.PWR_G7_Sts.MessageEnable.Task3 /end REF_MEASUREMENT
/end GROUP
/begin GROUP SYSTEM.P_CAN.PWR_G5_Sts "PWR_G5_Sts"
 /begin ANNOTATION ANNOTATION_LABEL "Instance" ANNOTATION_ORIGIN "Group" /begin ANNOTATION_TEXT "36" /end ANNOTATION_TEXT /end ANNOTATION
 /begin ANNOTATION ANNOTATION_LABEL "TaskCycleTime" ANNOTATION_ORIGIN "Group" /begin ANNOTATION_TEXT "0" /end ANNOTATION_TEXT /end ANNOTATION
 /begin ANNOTATION ANNOTATION_LABEL "TimeResolution" ANNOTATION_ORIGIN "Group" /begin ANNOTATION_TEXT "0" /end ANNOTATION_TEXT /end ANNOTATION
 /begin REF_MEASUREMENT OUT_PCAN.Tx_Pwr.PWR_G5_Sts.PWR_Gx_DIAG.Task3 OUT_PCAN.Tx_Pwr.PWR_G5_Sts.PWR_Gx_Val.Task3 OUT_PCAN.Tx_Pwr.PWR_G5_Sts.MessageEnable.Task3 /end REF_MEASUREMENT
/end GROUP
/begin GROUP SYSTEM.P_CAN.PWR_G4_Sts "PWR_G4_Sts"
 /begin ANNOTATION ANNOTATION_LABEL "Instance" ANNOTATION_ORIGIN "Group" /begin ANNOTATION_TEXT "37" /end ANNOTATION_TEXT /end ANNOTATION
 /begin ANNOTATION ANNOTATION_LABEL "TaskCycleTime" ANNOTATION_ORIGIN "Group" /begin ANNOTATION_TEXT "0" /end ANNOTATION_TEXT /end ANNOTATION
 /begin ANNOTATION ANNOTATION_LABEL "TimeResolution" ANNOTATION_ORIGIN "Group" /begin ANNOTATION_TEXT "0" /end ANNOTATION_TEXT /end ANNOTATION
 /begin REF_MEASUREMENT OUT_PCAN.Tx_Pwr.PWR_G4_Sts.PWR_Gx_DIAG.Task3 OUT_PCAN.Tx_Pwr.PWR_G4_Sts.PWR_Gx_Val.Task3 OUT_PCAN.Tx_Pwr.PWR_G4_Sts.MessageEnable.Task3 /end REF_MEASUREMENT
/end GROUP
/begin GROUP SYSTEM.P_CAN.PWR_G3_Sts "PWR_G3_Sts"
 /begin ANNOTATION ANNOTATION_LABEL "Instance" ANNOTATION_ORIGIN "Group" /begin ANNOTATION_TEXT "38" /end ANNOTATION_TEXT /end ANNOTATION
 /begin ANNOTATION ANNOTATION_LABEL "TaskCycleTime" ANNOTATION_ORIGIN "Group" /begin ANNOTATION_TEXT "0" /end ANNOTATION_TEXT /end ANNOTATION
 /begin ANNOTATION ANNOTATION_LABEL "TimeResolution" ANNOTATION_ORIGIN "Group" /begin ANNOTATION_TEXT "0" /end ANNOTATION_TEXT /end ANNOTATION
 /begin REF_MEASUREMENT OUT_PCAN.Tx_Pwr.PWR_G3_Sts.PWR_Gx_DIAG.Task3 OUT_PCAN.Tx_Pwr.PWR_G3_Sts.PWR_Gx_Val.Task3 OUT_PCAN.Tx_Pwr.PWR_G3_Sts.MessageEnable.Task3 /end REF_MEASUREMENT
/end GROUP
/begin GROUP SYSTEM.P_CAN.PWR_G2_Sts "PWR_G2_Sts"
 /begin ANNOTATION ANNOTATION_LABEL "Instance" ANNOTATION_ORIGIN "Group" /begin ANNOTATION_TEXT "39" /end ANNOTATION_TEXT /end ANNOTATION
 /begin ANNOTATION ANNOTATION_LABEL "TaskCycleTime" ANNOTATION_ORIGIN "Group" /begin ANNOTATION_TEXT "0" /end ANNOTATION_TEXT /end ANNOTATION
 /begin ANNOTATION ANNOTATION_LABEL "TimeResolution" ANNOTATION_ORIGIN "Group" /begin ANNOTATION_TEXT "0" /end ANNOTATION_TEXT /end ANNOTATION
 /begin REF_MEASUREMENT OUT_PCAN.Tx_Pwr.PWR_G2_Sts.PWR_Gx_DIAG.Task3 OUT_PCAN.Tx_Pwr.PWR_G2_Sts.PWR_Gx_Val.Task3 OUT_PCAN.Tx_Pwr.PWR_G2_Sts.MessageEnable.Task3 /end REF_MEASUREMENT
/end GROUP
/begin GROUP SYSTEM.P_CAN.PWR_G1_Sts "PWR_G1_Sts"
 /begin ANNOTATION ANNOTATION_LABEL "Instance" ANNOTATION_ORIGIN "Group" /begin ANNOTATION_TEXT "40" /end ANNOTATION_TEXT /end ANNOTATION
 /begin ANNOTATION ANNOTATION_LABEL "TaskCycleTime" ANNOTATION_ORIGIN "Group" /begin ANNOTATION_TEXT "0" /end ANNOTATION_TEXT /end ANNOTATION
 /begin ANNOTATION ANNOTATION_LABEL "TimeResolution" ANNOTATION_ORIGIN "Group" /begin ANNOTATION_TEXT "0" /end ANNOTATION_TEXT /end ANNOTATION
 /begin REF_MEASUREMENT OUT_PCAN.Tx_Pwr.PWR_G1_Sts.PWR_Gx_DIAG.Task3 OUT_PCAN.Tx_Pwr.PWR_G1_Sts.PWR_Gx_Val.Task3 OUT_PCAN.Tx_Pwr.PWR_G1_Sts.MessageEnable.Task3 /end REF_MEASUREMENT
/end GROUP
/begin GROUP SYSTEM.P_CAN.PWR_Sts "PWR_Sts"
 /begin ANNOTATION ANNOTATION_LABEL "Instance" ANNOTATION_ORIGIN "Group" /begin ANNOTATION_TEXT "41" /end ANNOTATION_TEXT /end ANNOTATION
 /begin ANNOTATION ANNOTATION_LABEL "TaskCycleTime" ANNOTATION_ORIGIN "Group" /begin ANNOTATION_TEXT "0" /end ANNOTATION_TEXT /end ANNOTATION
 /begin ANNOTATION ANNOTATION_LABEL "TimeResolution" ANNOTATION_ORIGIN "Group" /begin ANNOTATION_TEXT "0" /end ANNOTATION_TEXT /end ANNOTATION
 /begin REF_MEASUREMENT OUT_PCAN.Tx_Pwr.PWR_Sts.PWR_Val.Task3 OUT_PCAN.Tx_Pwr.PWR_Sts.PWR_DIAG.Task3 OUT_PCAN.Tx_Pwr.PWR_Sts.MessageEnable.Task3 /end REF_MEASUREMENT
/end GROUP
/begin GROUP SYSTEM.P_CAN.In_Dig_50_Sts "In_Dig_50_Sts"
 /begin ANNOTATION ANNOTATION_LABEL "Instance" ANNOTATION_ORIGIN "Group" /begin ANNOTATION_TEXT "42" /end ANNOTATION_TEXT /end ANNOTATION
 /begin ANNOTATION ANNOTATION_LABEL "TaskCycleTime" ANNOTATION_ORIGIN "Group" /begin ANNOTATION_TEXT "0" /end ANNOTATION_TEXT /end ANNOTATION
 /begin ANNOTATION ANNOTATION_LABEL "TimeResolution" ANNOTATION_ORIGIN "Group" /begin ANNOTATION_TEXT "0" /end ANNOTATION_TEXT /end ANNOTATION
 /begin REF_MEASUREMENT OUT_PCAN.Tx_Dig.In_Dig_50_Sts.IN_DIG_DIAG.Task3 OUT_PCAN.Tx_Dig.In_Dig_50_Sts.IN_DIG_Val.Task3 OUT_PCAN.Tx_Dig.In_Dig_50_Sts.MessageEnable.Task3 /end REF_MEASUREMENT
/end GROUP
/begin GROUP SYSTEM.P_CAN.In_Dig_49_Sts "In_Dig_49_Sts"
 /begin ANNOTATION ANNOTATION_LABEL "Instance" ANNOTATION_ORIGIN "Group" /begin ANNOTATION_TEXT "43" /end ANNOTATION_TEXT /end ANNOTATION
 /begin ANNOTATION ANNOTATION_LABEL "TaskCycleTime" ANNOTATION_ORIGIN "Group" /begin ANNOTATION_TEXT "0" /end ANNOTATION_TEXT /end ANNOTATION
 /begin ANNOTATION ANNOTATION_LABEL "TimeResolution" ANNOTATION_ORIGIN "Group" /begin ANNOTATION_TEXT "0" /end ANNOTATION_TEXT /end ANNOTATION
 /begin REF_MEASUREMENT OUT_PCAN.Tx_Dig.In_Dig_49_Sts.IN_DIG_DIAG.Task3 OUT_PCAN.Tx_Dig.In_Dig_49_Sts.IN_DIG_Val.Task3 OUT_PCAN.Tx_Dig.In_Dig_49_Sts.MessageEnable.Task3 /end REF_MEASUREMENT
/end GROUP
/begin GROUP SYSTEM.P_CAN.In_Dig_48_Sts "In_Dig_48_Sts"
 /begin ANNOTATION ANNOTATION_LABEL "Instance" ANNOTATION_ORIGIN "Group" /begin ANNOTATION_TEXT "44" /end ANNOTATION_TEXT /end ANNOTATION
 /begin ANNOTATION ANNOTATION_LABEL "TaskCycleTime" ANNOTATION_ORIGIN "Group" /begin ANNOTATION_TEXT "0" /end ANNOTATION_TEXT /end ANNOTATION
 /begin ANNOTATION ANNOTATION_LABEL "TimeResolution" ANNOTATION_ORIGIN "Group" /begin ANNOTATION_TEXT "0" /end ANNOTATION_TEXT /end ANNOTATION
 /begin REF_MEASUREMENT OUT_PCAN.Tx_Dig.In_Dig_48_Sts.IN_DIG_DIAG.Task3 OUT_PCAN.Tx_Dig.In_Dig_48_Sts.IN_DIG_Val.Task3 OUT_PCAN.Tx_Dig.In_Dig_48_Sts.MessageEnable.Task3 /end REF_MEASUREMENT
/end GROUP
/begin GROUP SYSTEM.P_CAN.In_Dig_46_Sts "In_Dig_46_Sts"
 /begin ANNOTATION ANNOTATION_LABEL "Instance" ANNOTATION_ORIGIN "Group" /begin ANNOTATION_TEXT "45" /end ANNOTATION_TEXT /end ANNOTATION
 /begin ANNOTATION ANNOTATION_LABEL "TaskCycleTime" ANNOTATION_ORIGIN "Group" /begin ANNOTATION_TEXT "0" /end ANNOTATION_TEXT /end ANNOTATION
 /begin ANNOTATION ANNOTATION_LABEL "TimeResolution" ANNOTATION_ORIGIN "Group" /begin ANNOTATION_TEXT "0" /end ANNOTATION_TEXT /end ANNOTATION
 /begin REF_MEASUREMENT OUT_PCAN.Tx_Dig.In_Dig_46_Sts.IN_DIG_DIAG.Task3 OUT_PCAN.Tx_Dig.In_Dig_46_Sts.IN_DIG_Val.Task3 OUT_PCAN.Tx_Dig.In_Dig_46_Sts.MessageEnable.Task3 /end REF_MEASUREMENT
/end GROUP
/begin GROUP SYSTEM.P_CAN.In_Dig_45_Sts "In_Dig_45_Sts"
 /begin ANNOTATION ANNOTATION_LABEL "Instance" ANNOTATION_ORIGIN "Group" /begin ANNOTATION_TEXT "46" /end ANNOTATION_TEXT /end ANNOTATION
 /begin ANNOTATION ANNOTATION_LABEL "TaskCycleTime" ANNOTATION_ORIGIN "Group" /begin ANNOTATION_TEXT "0" /end ANNOTATION_TEXT /end ANNOTATION
 /begin ANNOTATION ANNOTATION_LABEL "TimeResolution" ANNOTATION_ORIGIN "Group" /begin ANNOTATION_TEXT "0" /end ANNOTATION_TEXT /end ANNOTATION
 /begin REF_MEASUREMENT OUT_PCAN.Tx_Dig.In_Dig_45_Sts.IN_DIG_DIAG.Task3 OUT_PCAN.Tx_Dig.In_Dig_45_Sts.IN_DIG_Val.Task3 OUT_PCAN.Tx_Dig.In_Dig_45_Sts.MessageEnable.Task3 /end REF_MEASUREMENT
/end GROUP
/begin GROUP SYSTEM.P_CAN.In_Dig_44_Sts "In_Dig_44_Sts"
 /begin ANNOTATION ANNOTATION_LABEL "Instance" ANNOTATION_ORIGIN "Group" /begin ANNOTATION_TEXT "47" /end ANNOTATION_TEXT /end ANNOTATION
 /begin ANNOTATION ANNOTATION_LABEL "TaskCycleTime" ANNOTATION_ORIGIN "Group" /begin ANNOTATION_TEXT "0" /end ANNOTATION_TEXT /end ANNOTATION
 /begin ANNOTATION ANNOTATION_LABEL "TimeResolution" ANNOTATION_ORIGIN "Group" /begin ANNOTATION_TEXT "0" /end ANNOTATION_TEXT /end ANNOTATION
 /begin REF_MEASUREMENT OUT_PCAN.Tx_Dig.In_Dig_44_Sts.IN_DIG_DIAG.Task3 OUT_PCAN.Tx_Dig.In_Dig_44_Sts.IN_DIG_Val.Task3 OUT_PCAN.Tx_Dig.In_Dig_44_Sts.MessageEnable.Task3 /end REF_MEASUREMENT
/end GROUP
/begin GROUP SYSTEM.P_CAN.In_Dig_43_Sts "In_Dig_43_Sts"
 /begin ANNOTATION ANNOTATION_LABEL "Instance" ANNOTATION_ORIGIN "Group" /begin ANNOTATION_TEXT "48" /end ANNOTATION_TEXT /end ANNOTATION
 /begin ANNOTATION ANNOTATION_LABEL "TaskCycleTime" ANNOTATION_ORIGIN "Group" /begin ANNOTATION_TEXT "0" /end ANNOTATION_TEXT /end ANNOTATION
 /begin ANNOTATION ANNOTATION_LABEL "TimeResolution" ANNOTATION_ORIGIN "Group" /begin ANNOTATION_TEXT "0" /end ANNOTATION_TEXT /end ANNOTATION
 /begin REF_MEASUREMENT OUT_PCAN.Tx_Dig.In_Dig_43_Sts.IN_DIG_DIAG.Task3 OUT_PCAN.Tx_Dig.In_Dig_43_Sts.IN_DIG_Val.Task3 OUT_PCAN.Tx_Dig.In_Dig_43_Sts.MessageEnable.Task3 /end REF_MEASUREMENT
/end GROUP
/begin GROUP SYSTEM.P_CAN.In_Dig_42_Sts "In_Dig_42_Sts"
 /begin ANNOTATION ANNOTATION_LABEL "Instance" ANNOTATION_ORIGIN "Group" /begin ANNOTATION_TEXT "49" /end ANNOTATION_TEXT /end ANNOTATION
 /begin ANNOTATION ANNOTATION_LABEL "TaskCycleTime" ANNOTATION_ORIGIN "Group" /begin ANNOTATION_TEXT "0" /end ANNOTATION_TEXT /end ANNOTATION
 /begin ANNOTATION ANNOTATION_LABEL "TimeResolution" ANNOTATION_ORIGIN "Group" /begin ANNOTATION_TEXT "0" /end ANNOTATION_TEXT /end ANNOTATION
 /begin REF_MEASUREMENT OUT_PCAN.Tx_Dig.In_Dig_42_Sts.IN_DIG_DIAG.Task3 OUT_PCAN.Tx_Dig.In_Dig_42_Sts.IN_DIG_Val.Task3 OUT_PCAN.Tx_Dig.In_Dig_42_Sts.MessageEnable.Task3 /end REF_MEASUREMENT
/end GROUP
/begin GROUP SYSTEM.P_CAN.In_Dig_41_Sts "In_Dig_41_Sts"
 /begin ANNOTATION ANNOTATION_LABEL "Instance" ANNOTATION_ORIGIN "Group" /begin ANNOTATION_TEXT "50" /end ANNOTATION_TEXT /end ANNOTATION
 /begin ANNOTATION ANNOTATION_LABEL "TaskCycleTime" ANNOTATION_ORIGIN "Group" /begin ANNOTATION_TEXT "0" /end ANNOTATION_TEXT /end ANNOTATION
 /begin ANNOTATION ANNOTATION_LABEL "TimeResolution" ANNOTATION_ORIGIN "Group" /begin ANNOTATION_TEXT "0" /end ANNOTATION_TEXT /end ANNOTATION
 /begin REF_MEASUREMENT OUT_PCAN.Tx_Dig.In_Dig_41_Sts.IN_DIG_DIAG.Task3 OUT_PCAN.Tx_Dig.In_Dig_41_Sts.IN_DIG_Val.Task3 OUT_PCAN.Tx_Dig.In_Dig_41_Sts.MessageEnable.Task3 /end REF_MEASUREMENT
/end GROUP
/begin GROUP SYSTEM.P_CAN.In_Dig_40_Sts "In_Dig_40_Sts"
 /begin ANNOTATION ANNOTATION_LABEL "Instance" ANNOTATION_ORIGIN "Group" /begin ANNOTATION_TEXT "51" /end ANNOTATION_TEXT /end ANNOTATION
 /begin ANNOTATION ANNOTATION_LABEL "TaskCycleTime" ANNOTATION_ORIGIN "Group" /begin ANNOTATION_TEXT "0" /end ANNOTATION_TEXT /end ANNOTATION
 /begin ANNOTATION ANNOTATION_LABEL "TimeResolution" ANNOTATION_ORIGIN "Group" /begin ANNOTATION_TEXT "0" /end ANNOTATION_TEXT /end ANNOTATION
 /begin REF_MEASUREMENT OUT_PCAN.Tx_Dig.In_Dig_40_Sts.IN_DIG_DIAG.Task3 OUT_PCAN.Tx_Dig.In_Dig_40_Sts.IN_DIG_Val.Task3 OUT_PCAN.Tx_Dig.In_Dig_40_Sts.MessageEnable.Task3 /end REF_MEASUREMENT
/end GROUP
/begin GROUP SYSTEM.P_CAN.In_Dig_39_Sts "In_Dig_39_Sts"
 /begin ANNOTATION ANNOTATION_LABEL "Instance" ANNOTATION_ORIGIN "Group" /begin ANNOTATION_TEXT "52" /end ANNOTATION_TEXT /end ANNOTATION
 /begin ANNOTATION ANNOTATION_LABEL "TaskCycleTime" ANNOTATION_ORIGIN "Group" /begin ANNOTATION_TEXT "0" /end ANNOTATION_TEXT /end ANNOTATION
 /begin ANNOTATION ANNOTATION_LABEL "TimeResolution" ANNOTATION_ORIGIN "Group" /begin ANNOTATION_TEXT "0" /end ANNOTATION_TEXT /end ANNOTATION
 /begin REF_MEASUREMENT OUT_PCAN.Tx_Dig.In_Dig_39_Sts.IN_DIG_DIAG.Task3 OUT_PCAN.Tx_Dig.In_Dig_39_Sts.IN_DIG_Val.Task3 OUT_PCAN.Tx_Dig.In_Dig_39_Sts.MessageEnable.Task3 /end REF_MEASUREMENT
/end GROUP
/begin GROUP SYSTEM.P_CAN.In_Dig_38_Sts "In_Dig_38_Sts"
 /begin ANNOTATION ANNOTATION_LABEL "Instance" ANNOTATION_ORIGIN "Group" /begin ANNOTATION_TEXT "53" /end ANNOTATION_TEXT /end ANNOTATION
 /begin ANNOTATION ANNOTATION_LABEL "TaskCycleTime" ANNOTATION_ORIGIN "Group" /begin ANNOTATION_TEXT "0" /end ANNOTATION_TEXT /end ANNOTATION
 /begin ANNOTATION ANNOTATION_LABEL "TimeResolution" ANNOTATION_ORIGIN "Group" /begin ANNOTATION_TEXT "0" /end ANNOTATION_TEXT /end ANNOTATION
 /begin REF_MEASUREMENT OUT_PCAN.Tx_Dig.In_Dig_38_Sts.IN_DIG_DIAG.Task3 OUT_PCAN.Tx_Dig.In_Dig_38_Sts.IN_DIG_Val.Task3 OUT_PCAN.Tx_Dig.In_Dig_38_Sts.MessageEnable.Task3 /end REF_MEASUREMENT
/end GROUP
/begin GROUP SYSTEM.P_CAN.In_Dig_37_Sts "In_Dig_37_Sts"
 /begin ANNOTATION ANNOTATION_LABEL "Instance" ANNOTATION_ORIGIN "Group" /begin ANNOTATION_TEXT "54" /end ANNOTATION_TEXT /end ANNOTATION
 /begin ANNOTATION ANNOTATION_LABEL "TaskCycleTime" ANNOTATION_ORIGIN "Group" /begin ANNOTATION_TEXT "0" /end ANNOTATION_TEXT /end ANNOTATION
 /begin ANNOTATION ANNOTATION_LABEL "TimeResolution" ANNOTATION_ORIGIN "Group" /begin ANNOTATION_TEXT "0" /end ANNOTATION_TEXT /end ANNOTATION
 /begin REF_MEASUREMENT OUT_PCAN.Tx_Dig.In_Dig_37_Sts.IN_DIG_DIAG.Task3 OUT_PCAN.Tx_Dig.In_Dig_37_Sts.IN_DIG_Val.Task3 OUT_PCAN.Tx_Dig.In_Dig_37_Sts.MessageEnable.Task3 /end REF_MEASUREMENT
/end GROUP
/begin GROUP SYSTEM.P_CAN.In_Dig_36_Sts "In_Dig_36_Sts"
 /begin ANNOTATION ANNOTATION_LABEL "Instance" ANNOTATION_ORIGIN "Group" /begin ANNOTATION_TEXT "55" /end ANNOTATION_TEXT /end ANNOTATION
 /begin ANNOTATION ANNOTATION_LABEL "TaskCycleTime" ANNOTATION_ORIGIN "Group" /begin ANNOTATION_TEXT "0" /end ANNOTATION_TEXT /end ANNOTATION
 /begin ANNOTATION ANNOTATION_LABEL "TimeResolution" ANNOTATION_ORIGIN "Group" /begin ANNOTATION_TEXT "0" /end ANNOTATION_TEXT /end ANNOTATION
 /begin REF_MEASUREMENT OUT_PCAN.Tx_Dig.In_Dig_36_Sts.IN_DIG_DIAG.Task3 OUT_PCAN.Tx_Dig.In_Dig_36_Sts.IN_DIG_Val.Task3 OUT_PCAN.Tx_Dig.In_Dig_36_Sts.MessageEnable.Task3 /end REF_MEASUREMENT
/end GROUP
/begin GROUP SYSTEM.P_CAN.In_Dig_35_Sts "In_Dig_35_Sts"
 /begin ANNOTATION ANNOTATION_LABEL "Instance" ANNOTATION_ORIGIN "Group" /begin ANNOTATION_TEXT "56" /end ANNOTATION_TEXT /end ANNOTATION
 /begin ANNOTATION ANNOTATION_LABEL "TaskCycleTime" ANNOTATION_ORIGIN "Group" /begin ANNOTATION_TEXT "0" /end ANNOTATION_TEXT /end ANNOTATION
 /begin ANNOTATION ANNOTATION_LABEL "TimeResolution" ANNOTATION_ORIGIN "Group" /begin ANNOTATION_TEXT "0" /end ANNOTATION_TEXT /end ANNOTATION
 /begin REF_MEASUREMENT OUT_PCAN.Tx_Dig.In_Dig_35_Sts.IN_DIG_DIAG.Task3 OUT_PCAN.Tx_Dig.In_Dig_35_Sts.IN_DIG_Val.Task3 OUT_PCAN.Tx_Dig.In_Dig_35_Sts.MessageEnable.Task3 /end REF_MEASUREMENT
/end GROUP
/begin GROUP SYSTEM.P_CAN.In_Dig_34_Sts "In_Dig_34_Sts"
 /begin ANNOTATION ANNOTATION_LABEL "Instance" ANNOTATION_ORIGIN "Group" /begin ANNOTATION_TEXT "57" /end ANNOTATION_TEXT /end ANNOTATION
 /begin ANNOTATION ANNOTATION_LABEL "TaskCycleTime" ANNOTATION_ORIGIN "Group" /begin ANNOTATION_TEXT "0" /end ANNOTATION_TEXT /end ANNOTATION
 /begin ANNOTATION ANNOTATION_LABEL "TimeResolution" ANNOTATION_ORIGIN "Group" /begin ANNOTATION_TEXT "0" /end ANNOTATION_TEXT /end ANNOTATION
 /begin REF_MEASUREMENT OUT_PCAN.Tx_Dig.In_Dig_34_Sts.IN_DIG_DIAG.Task3 OUT_PCAN.Tx_Dig.In_Dig_34_Sts.IN_DIG_Val.Task3 OUT_PCAN.Tx_Dig.In_Dig_34_Sts.MessageEnable.Task3 /end REF_MEASUREMENT
/end GROUP
/begin GROUP SYSTEM.P_CAN.In_Dig_33_Sts "In_Dig_33_Sts"
 /begin ANNOTATION ANNOTATION_LABEL "Instance" ANNOTATION_ORIGIN "Group" /begin ANNOTATION_TEXT "58" /end ANNOTATION_TEXT /end ANNOTATION
 /begin ANNOTATION ANNOTATION_LABEL "TaskCycleTime" ANNOTATION_ORIGIN "Group" /begin ANNOTATION_TEXT "0" /end ANNOTATION_TEXT /end ANNOTATION
 /begin ANNOTATION ANNOTATION_LABEL "TimeResolution" ANNOTATION_ORIGIN "Group" /begin ANNOTATION_TEXT "0" /end ANNOTATION_TEXT /end ANNOTATION
 /begin REF_MEASUREMENT OUT_PCAN.Tx_Dig.In_Dig_33_Sts.IN_DIG_DIAG.Task3 OUT_PCAN.Tx_Dig.In_Dig_33_Sts.IN_DIG_Val.Task3 OUT_PCAN.Tx_Dig.In_Dig_33_Sts.MessageEnable.Task3 /end REF_MEASUREMENT
/end GROUP
/begin GROUP SYSTEM.P_CAN.In_Dig_32_Sts "In_Dig_32_Sts"
 /begin ANNOTATION ANNOTATION_LABEL "Instance" ANNOTATION_ORIGIN "Group" /begin ANNOTATION_TEXT "59" /end ANNOTATION_TEXT /end ANNOTATION
 /begin ANNOTATION ANNOTATION_LABEL "TaskCycleTime" ANNOTATION_ORIGIN "Group" /begin ANNOTATION_TEXT "0" /end ANNOTATION_TEXT /end ANNOTATION
 /begin ANNOTATION ANNOTATION_LABEL "TimeResolution" ANNOTATION_ORIGIN "Group" /begin ANNOTATION_TEXT "0" /end ANNOTATION_TEXT /end ANNOTATION
 /begin REF_MEASUREMENT OUT_PCAN.Tx_Dig.In_Dig_32_Sts.IN_DIG_DIAG.Task3 OUT_PCAN.Tx_Dig.In_Dig_32_Sts.IN_DIG_Val.Task3 OUT_PCAN.Tx_Dig.In_Dig_32_Sts.MessageEnable.Task3 /end REF_MEASUREMENT
/end GROUP
/begin GROUP SYSTEM.P_CAN.In_Dig_31_Sts "In_Dig_31_Sts"
 /begin ANNOTATION ANNOTATION_LABEL "Instance" ANNOTATION_ORIGIN "Group" /begin ANNOTATION_TEXT "60" /end ANNOTATION_TEXT /end ANNOTATION
 /begin ANNOTATION ANNOTATION_LABEL "TaskCycleTime" ANNOTATION_ORIGIN "Group" /begin ANNOTATION_TEXT "0" /end ANNOTATION_TEXT /end ANNOTATION
 /begin ANNOTATION ANNOTATION_LABEL "TimeResolution" ANNOTATION_ORIGIN "Group" /begin ANNOTATION_TEXT "0" /end ANNOTATION_TEXT /end ANNOTATION
 /begin REF_MEASUREMENT OUT_PCAN.Tx_Dig.In_Dig_31_Sts.IN_DIG_DIAG.Task3 OUT_PCAN.Tx_Dig.In_Dig_31_Sts.IN_DIG_Val.Task3 OUT_PCAN.Tx_Dig.In_Dig_31_Sts.MessageEnable.Task3 /end REF_MEASUREMENT
/end GROUP
/begin GROUP SYSTEM.P_CAN.In_Dig_30_Sts "In_Dig_30_Sts"
 /begin ANNOTATION ANNOTATION_LABEL "Instance" ANNOTATION_ORIGIN "Group" /begin ANNOTATION_TEXT "61" /end ANNOTATION_TEXT /end ANNOTATION
 /begin ANNOTATION ANNOTATION_LABEL "TaskCycleTime" ANNOTATION_ORIGIN "Group" /begin ANNOTATION_TEXT "0" /end ANNOTATION_TEXT /end ANNOTATION
 /begin ANNOTATION ANNOTATION_LABEL "TimeResolution" ANNOTATION_ORIGIN "Group" /begin ANNOTATION_TEXT "0" /end ANNOTATION_TEXT /end ANNOTATION
 /begin REF_MEASUREMENT OUT_PCAN.Tx_Dig.In_Dig_30_Sts.IN_DIG_DIAG.Task3 OUT_PCAN.Tx_Dig.In_Dig_30_Sts.IN_DIG_Val.Task3 OUT_PCAN.Tx_Dig.In_Dig_30_Sts.MessageEnable.Task3 /end REF_MEASUREMENT
/end GROUP
/begin GROUP SYSTEM.P_CAN.In_Dig_29_Sts "In_Dig_29_Sts"
 /begin ANNOTATION ANNOTATION_LABEL "Instance" ANNOTATION_ORIGIN "Group" /begin ANNOTATION_TEXT "62" /end ANNOTATION_TEXT /end ANNOTATION
 /begin ANNOTATION ANNOTATION_LABEL "TaskCycleTime" ANNOTATION_ORIGIN "Group" /begin ANNOTATION_TEXT "0" /end ANNOTATION_TEXT /end ANNOTATION
 /begin ANNOTATION ANNOTATION_LABEL "TimeResolution" ANNOTATION_ORIGIN "Group" /begin ANNOTATION_TEXT "0" /end ANNOTATION_TEXT /end ANNOTATION
 /begin REF_MEASUREMENT OUT_PCAN.Tx_Dig.In_Dig_29_Sts.IN_DIG_DIAG.Task3 OUT_PCAN.Tx_Dig.In_Dig_29_Sts.IN_DIG_Val.Task3 OUT_PCAN.Tx_Dig.In_Dig_29_Sts.MessageEnable.Task3 /end REF_MEASUREMENT
/end GROUP
/begin GROUP SYSTEM.P_CAN.In_Dig_28_Sts "In_Dig_28_Sts"
 /begin ANNOTATION ANNOTATION_LABEL "Instance" ANNOTATION_ORIGIN "Group" /begin ANNOTATION_TEXT "63" /end ANNOTATION_TEXT /end ANNOTATION
 /begin ANNOTATION ANNOTATION_LABEL "TaskCycleTime" ANNOTATION_ORIGIN "Group" /begin ANNOTATION_TEXT "0" /end ANNOTATION_TEXT /end ANNOTATION
 /begin ANNOTATION ANNOTATION_LABEL "TimeResolution" ANNOTATION_ORIGIN "Group" /begin ANNOTATION_TEXT "0" /end ANNOTATION_TEXT /end ANNOTATION
 /begin REF_MEASUREMENT OUT_PCAN.Tx_Dig.In_Dig_28_Sts.IN_DIG_DIAG.Task3 OUT_PCAN.Tx_Dig.In_Dig_28_Sts.IN_DIG_Val.Task3 OUT_PCAN.Tx_Dig.In_Dig_28_Sts.MessageEnable.Task3 /end REF_MEASUREMENT
/end GROUP
/begin GROUP SYSTEM.P_CAN.In_Dig_27_Sts "In_Dig_27_Sts"
 /begin ANNOTATION ANNOTATION_LABEL "Instance" ANNOTATION_ORIGIN "Group" /begin ANNOTATION_TEXT "64" /end ANNOTATION_TEXT /end ANNOTATION
 /begin ANNOTATION ANNOTATION_LABEL "TaskCycleTime" ANNOTATION_ORIGIN "Group" /begin ANNOTATION_TEXT "0" /end ANNOTATION_TEXT /end ANNOTATION
 /begin ANNOTATION ANNOTATION_LABEL "TimeResolution" ANNOTATION_ORIGIN "Group" /begin ANNOTATION_TEXT "0" /end ANNOTATION_TEXT /end ANNOTATION
 /begin REF_MEASUREMENT OUT_PCAN.Tx_Dig.In_Dig_27_Sts.IN_DIG_DIAG.Task3 OUT_PCAN.Tx_Dig.In_Dig_27_Sts.IN_DIG_Val.Task3 OUT_PCAN.Tx_Dig.In_Dig_27_Sts.MessageEnable.Task3 /end REF_MEASUREMENT
/end GROUP
/begin GROUP SYSTEM.P_CAN.In_Dig_26_Sts "In_Dig_26_Sts"
 /begin ANNOTATION ANNOTATION_LABEL "Instance" ANNOTATION_ORIGIN "Group" /begin ANNOTATION_TEXT "65" /end ANNOTATION_TEXT /end ANNOTATION
 /begin ANNOTATION ANNOTATION_LABEL "TaskCycleTime" ANNOTATION_ORIGIN "Group" /begin ANNOTATION_TEXT "0" /end ANNOTATION_TEXT /end ANNOTATION
 /begin ANNOTATION ANNOTATION_LABEL "TimeResolution" ANNOTATION_ORIGIN "Group" /begin ANNOTATION_TEXT "0" /end ANNOTATION_TEXT /end ANNOTATION
 /begin REF_MEASUREMENT OUT_PCAN.Tx_Dig.In_Dig_26_Sts.IN_DIG_DIAG.Task3 OUT_PCAN.Tx_Dig.In_Dig_26_Sts.IN_DIG_Val.Task3 OUT_PCAN.Tx_Dig.In_Dig_26_Sts.MessageEnable.Task3 /end REF_MEASUREMENT
/end GROUP
/begin GROUP SYSTEM.P_CAN.In_Dig_25_Sts "In_Dig_25_Sts"
 /begin ANNOTATION ANNOTATION_LABEL "Instance" ANNOTATION_ORIGIN "Group" /begin ANNOTATION_TEXT "66" /end ANNOTATION_TEXT /end ANNOTATION
 /begin ANNOTATION ANNOTATION_LABEL "TaskCycleTime" ANNOTATION_ORIGIN "Group" /begin ANNOTATION_TEXT "0" /end ANNOTATION_TEXT /end ANNOTATION
 /begin ANNOTATION ANNOTATION_LABEL "TimeResolution" ANNOTATION_ORIGIN "Group" /begin ANNOTATION_TEXT "0" /end ANNOTATION_TEXT /end ANNOTATION
 /begin REF_MEASUREMENT OUT_PCAN.Tx_Dig.In_Dig_25_Sts.IN_DIG_DIAG.Task3 OUT_PCAN.Tx_Dig.In_Dig_25_Sts.IN_DIG_Val.Task3 OUT_PCAN.Tx_Dig.In_Dig_25_Sts.MessageEnable.Task3 /end REF_MEASUREMENT
/end GROUP
/begin GROUP SYSTEM.P_CAN.In_Dig_24_Sts "In_Dig_24_Sts"
 /begin ANNOTATION ANNOTATION_LABEL "Instance" ANNOTATION_ORIGIN "Group" /begin ANNOTATION_TEXT "67" /end ANNOTATION_TEXT /end ANNOTATION
 /begin ANNOTATION ANNOTATION_LABEL "TaskCycleTime" ANNOTATION_ORIGIN "Group" /begin ANNOTATION_TEXT "0" /end ANNOTATION_TEXT /end ANNOTATION
 /begin ANNOTATION ANNOTATION_LABEL "TimeResolution" ANNOTATION_ORIGIN "Group" /begin ANNOTATION_TEXT "0" /end ANNOTATION_TEXT /end ANNOTATION
 /begin REF_MEASUREMENT OUT_PCAN.Tx_Dig.In_Dig_24_Sts.IN_DIG_DIAG.Task3 OUT_PCAN.Tx_Dig.In_Dig_24_Sts.IN_DIG_Val.Task3 OUT_PCAN.Tx_Dig.In_Dig_24_Sts.MessageEnable.Task3 /end REF_MEASUREMENT
/end GROUP
/begin GROUP SYSTEM.P_CAN.In_Dig_23_Sts "In_Dig_23_Sts"
 /begin ANNOTATION ANNOTATION_LABEL "Instance" ANNOTATION_ORIGIN "Group" /begin ANNOTATION_TEXT "68" /end ANNOTATION_TEXT /end ANNOTATION
 /begin ANNOTATION ANNOTATION_LABEL "TaskCycleTime" ANNOTATION_ORIGIN "Group" /begin ANNOTATION_TEXT "0" /end ANNOTATION_TEXT /end ANNOTATION
 /begin ANNOTATION ANNOTATION_LABEL "TimeResolution" ANNOTATION_ORIGIN "Group" /begin ANNOTATION_TEXT "0" /end ANNOTATION_TEXT /end ANNOTATION
 /begin REF_MEASUREMENT OUT_PCAN.Tx_Dig.In_Dig_23_Sts.IN_DIG_DIAG.Task3 OUT_PCAN.Tx_Dig.In_Dig_23_Sts.IN_DIG_Val.Task3 OUT_PCAN.Tx_Dig.In_Dig_23_Sts.MessageEnable.Task3 /end REF_MEASUREMENT
/end GROUP
/begin GROUP SYSTEM.P_CAN.In_Dig_22_Sts "In_Dig_22_Sts"
 /begin ANNOTATION ANNOTATION_LABEL "Instance" ANNOTATION_ORIGIN "Group" /begin ANNOTATION_TEXT "69" /end ANNOTATION_TEXT /end ANNOTATION
 /begin ANNOTATION ANNOTATION_LABEL "TaskCycleTime" ANNOTATION_ORIGIN "Group" /begin ANNOTATION_TEXT "0" /end ANNOTATION_TEXT /end ANNOTATION
 /begin ANNOTATION ANNOTATION_LABEL "TimeResolution" ANNOTATION_ORIGIN "Group" /begin ANNOTATION_TEXT "0" /end ANNOTATION_TEXT /end ANNOTATION
 /begin REF_MEASUREMENT OUT_PCAN.Tx_Dig.In_Dig_22_Sts.IN_DIG_DIAG.Task3 OUT_PCAN.Tx_Dig.In_Dig_22_Sts.IN_DIG_Val.Task3 OUT_PCAN.Tx_Dig.In_Dig_22_Sts.MessageEnable.Task3 /end REF_MEASUREMENT
/end GROUP
/begin GROUP SYSTEM.P_CAN.In_Dig_21_Sts "In_Dig_21_Sts"
 /begin ANNOTATION ANNOTATION_LABEL "Instance" ANNOTATION_ORIGIN "Group" /begin ANNOTATION_TEXT "70" /end ANNOTATION_TEXT /end ANNOTATION
 /begin ANNOTATION ANNOTATION_LABEL "TaskCycleTime" ANNOTATION_ORIGIN "Group" /begin ANNOTATION_TEXT "0" /end ANNOTATION_TEXT /end ANNOTATION
 /begin ANNOTATION ANNOTATION_LABEL "TimeResolution" ANNOTATION_ORIGIN "Group" /begin ANNOTATION_TEXT "0" /end ANNOTATION_TEXT /end ANNOTATION
 /begin REF_MEASUREMENT OUT_PCAN.Tx_Dig.In_Dig_21_Sts.IN_DIG_DIAG.Task3 OUT_PCAN.Tx_Dig.In_Dig_21_Sts.IN_DIG_Val.Task3 OUT_PCAN.Tx_Dig.In_Dig_21_Sts.MessageEnable.Task3 /end REF_MEASUREMENT
/end GROUP
/begin GROUP SYSTEM.P_CAN.In_Dig_20_Sts "In_Dig_20_Sts"
 /begin ANNOTATION ANNOTATION_LABEL "Instance" ANNOTATION_ORIGIN "Group" /begin ANNOTATION_TEXT "71" /end ANNOTATION_TEXT /end ANNOTATION
 /begin ANNOTATION ANNOTATION_LABEL "TaskCycleTime" ANNOTATION_ORIGIN "Group" /begin ANNOTATION_TEXT "0" /end ANNOTATION_TEXT /end ANNOTATION
 /begin ANNOTATION ANNOTATION_LABEL "TimeResolution" ANNOTATION_ORIGIN "Group" /begin ANNOTATION_TEXT "0" /end ANNOTATION_TEXT /end ANNOTATION
 /begin REF_MEASUREMENT OUT_PCAN.Tx_Dig.In_Dig_20_Sts.IN_DIG_DIAG.Task3 OUT_PCAN.Tx_Dig.In_Dig_20_Sts.IN_DIG_Val.Task3 OUT_PCAN.Tx_Dig.In_Dig_20_Sts.MessageEnable.Task3 /end REF_MEASUREMENT
/end GROUP
/begin GROUP SYSTEM.P_CAN.In_Dig_19_Sts "In_Dig_19_Sts"
 /begin ANNOTATION ANNOTATION_LABEL "Instance" ANNOTATION_ORIGIN "Group" /begin ANNOTATION_TEXT "72" /end ANNOTATION_TEXT /end ANNOTATION
 /begin ANNOTATION ANNOTATION_LABEL "TaskCycleTime" ANNOTATION_ORIGIN "Group" /begin ANNOTATION_TEXT "0" /end ANNOTATION_TEXT /end ANNOTATION
 /begin ANNOTATION ANNOTATION_LABEL "TimeResolution" ANNOTATION_ORIGIN "Group" /begin ANNOTATION_TEXT "0" /end ANNOTATION_TEXT /end ANNOTATION
 /begin REF_MEASUREMENT OUT_PCAN.Tx_Dig.In_Dig_19_Sts.IN_DIG_DIAG.Task3 OUT_PCAN.Tx_Dig.In_Dig_19_Sts.IN_DIG_Val.Task3 OUT_PCAN.Tx_Dig.In_Dig_19_Sts.MessageEnable.Task3 /end REF_MEASUREMENT
/end GROUP
/begin GROUP SYSTEM.P_CAN.In_Dig_18_Sts "In_Dig_18_Sts"
 /begin ANNOTATION ANNOTATION_LABEL "Instance" ANNOTATION_ORIGIN "Group" /begin ANNOTATION_TEXT "73" /end ANNOTATION_TEXT /end ANNOTATION
 /begin ANNOTATION ANNOTATION_LABEL "TaskCycleTime" ANNOTATION_ORIGIN "Group" /begin ANNOTATION_TEXT "0" /end ANNOTATION_TEXT /end ANNOTATION
 /begin ANNOTATION ANNOTATION_LABEL "TimeResolution" ANNOTATION_ORIGIN "Group" /begin ANNOTATION_TEXT "0" /end ANNOTATION_TEXT /end ANNOTATION
 /begin REF_MEASUREMENT OUT_PCAN.Tx_Dig.In_Dig_18_Sts.IN_DIG_DIAG.Task3 OUT_PCAN.Tx_Dig.In_Dig_18_Sts.IN_DIG_Val.Task3 OUT_PCAN.Tx_Dig.In_Dig_18_Sts.MessageEnable.Task3 /end REF_MEASUREMENT
/end GROUP
/begin GROUP SYSTEM.P_CAN.In_Dig_17_Sts "In_Dig_17_Sts"
 /begin ANNOTATION ANNOTATION_LABEL "Instance" ANNOTATION_ORIGIN "Group" /begin ANNOTATION_TEXT "74" /end ANNOTATION_TEXT /end ANNOTATION
 /begin ANNOTATION ANNOTATION_LABEL "TaskCycleTime" ANNOTATION_ORIGIN "Group" /begin ANNOTATION_TEXT "0" /end ANNOTATION_TEXT /end ANNOTATION
 /begin ANNOTATION ANNOTATION_LABEL "TimeResolution" ANNOTATION_ORIGIN "Group" /begin ANNOTATION_TEXT "0" /end ANNOTATION_TEXT /end ANNOTATION
 /begin REF_MEASUREMENT OUT_PCAN.Tx_Dig.In_Dig_17_Sts.IN_DIG_DIAG.Task3 OUT_PCAN.Tx_Dig.In_Dig_17_Sts.IN_DIG_Val.Task3 OUT_PCAN.Tx_Dig.In_Dig_17_Sts.MessageEnable.Task3 /end REF_MEASUREMENT
/end GROUP
/begin GROUP SYSTEM.P_CAN.In_Dig_16_Sts "In_Dig_16_Sts"
 /begin ANNOTATION ANNOTATION_LABEL "Instance" ANNOTATION_ORIGIN "Group" /begin ANNOTATION_TEXT "75" /end ANNOTATION_TEXT /end ANNOTATION
 /begin ANNOTATION ANNOTATION_LABEL "TaskCycleTime" ANNOTATION_ORIGIN "Group" /begin ANNOTATION_TEXT "0" /end ANNOTATION_TEXT /end ANNOTATION
 /begin ANNOTATION ANNOTATION_LABEL "TimeResolution" ANNOTATION_ORIGIN "Group" /begin ANNOTATION_TEXT "0" /end ANNOTATION_TEXT /end ANNOTATION
 /begin REF_MEASUREMENT OUT_PCAN.Tx_Dig.In_Dig_16_Sts.IN_DIG_DIAG.Task3 OUT_PCAN.Tx_Dig.In_Dig_16_Sts.IN_DIG_Val.Task3 OUT_PCAN.Tx_Dig.In_Dig_16_Sts.MessageEnable.Task3 /end REF_MEASUREMENT
/end GROUP
/begin GROUP SYSTEM.P_CAN.In_Dig_15_Sts "In_Dig_15_Sts"
 /begin ANNOTATION ANNOTATION_LABEL "Instance" ANNOTATION_ORIGIN "Group" /begin ANNOTATION_TEXT "76" /end ANNOTATION_TEXT /end ANNOTATION
 /begin ANNOTATION ANNOTATION_LABEL "TaskCycleTime" ANNOTATION_ORIGIN "Group" /begin ANNOTATION_TEXT "0" /end ANNOTATION_TEXT /end ANNOTATION
 /begin ANNOTATION ANNOTATION_LABEL "TimeResolution" ANNOTATION_ORIGIN "Group" /begin ANNOTATION_TEXT "0" /end ANNOTATION_TEXT /end ANNOTATION
 /begin REF_MEASUREMENT OUT_PCAN.Tx_Dig.In_Dig_15_Sts.IN_DIG_DIAG.Task3 OUT_PCAN.Tx_Dig.In_Dig_15_Sts.IN_DIG_Val.Task3 OUT_PCAN.Tx_Dig.In_Dig_15_Sts.MessageEnable.Task3 /end REF_MEASUREMENT
/end GROUP
/begin GROUP SYSTEM.P_CAN.In_Dig_14_Sts "In_Dig_14_Sts"
 /begin ANNOTATION ANNOTATION_LABEL "Instance" ANNOTATION_ORIGIN "Group" /begin ANNOTATION_TEXT "77" /end ANNOTATION_TEXT /end ANNOTATION
 /begin ANNOTATION ANNOTATION_LABEL "TaskCycleTime" ANNOTATION_ORIGIN "Group" /begin ANNOTATION_TEXT "0" /end ANNOTATION_TEXT /end ANNOTATION
 /begin ANNOTATION ANNOTATION_LABEL "TimeResolution" ANNOTATION_ORIGIN "Group" /begin ANNOTATION_TEXT "0" /end ANNOTATION_TEXT /end ANNOTATION
 /begin REF_MEASUREMENT OUT_PCAN.Tx_Dig.In_Dig_14_Sts.IN_DIG_DIAG.Task3 OUT_PCAN.Tx_Dig.In_Dig_14_Sts.IN_DIG_Val.Task3 OUT_PCAN.Tx_Dig.In_Dig_14_Sts.MessageEnable.Task3 /end REF_MEASUREMENT
/end GROUP
/begin GROUP SYSTEM.P_CAN.In_Dig_13_Sts "In_Dig_13_Sts"
 /begin ANNOTATION ANNOTATION_LABEL "Instance" ANNOTATION_ORIGIN "Group" /begin ANNOTATION_TEXT "78" /end ANNOTATION_TEXT /end ANNOTATION
 /begin ANNOTATION ANNOTATION_LABEL "TaskCycleTime" ANNOTATION_ORIGIN "Group" /begin ANNOTATION_TEXT "0" /end ANNOTATION_TEXT /end ANNOTATION
 /begin ANNOTATION ANNOTATION_LABEL "TimeResolution" ANNOTATION_ORIGIN "Group" /begin ANNOTATION_TEXT "0" /end ANNOTATION_TEXT /end ANNOTATION
 /begin REF_MEASUREMENT OUT_PCAN.Tx_Dig.In_Dig_13_Sts.IN_DIG_DIAG.Task3 OUT_PCAN.Tx_Dig.In_Dig_13_Sts.IN_DIG_Val.Task3 OUT_PCAN.Tx_Dig.In_Dig_13_Sts.MessageEnable.Task3 /end REF_MEASUREMENT
/end GROUP
/begin GROUP SYSTEM.P_CAN.In_Dig_12_Sts "In_Dig_12_Sts"
 /begin ANNOTATION ANNOTATION_LABEL "Instance" ANNOTATION_ORIGIN "Group" /begin ANNOTATION_TEXT "79" /end ANNOTATION_TEXT /end ANNOTATION
 /begin ANNOTATION ANNOTATION_LABEL "TaskCycleTime" ANNOTATION_ORIGIN "Group" /begin ANNOTATION_TEXT "0" /end ANNOTATION_TEXT /end ANNOTATION
 /begin ANNOTATION ANNOTATION_LABEL "TimeResolution" ANNOTATION_ORIGIN "Group" /begin ANNOTATION_TEXT "0" /end ANNOTATION_TEXT /end ANNOTATION
 /begin REF_MEASUREMENT OUT_PCAN.Tx_Dig.In_Dig_12_Sts.IN_DIG_DIAG.Task3 OUT_PCAN.Tx_Dig.In_Dig_12_Sts.IN_DIG_Val.Task3 OUT_PCAN.Tx_Dig.In_Dig_12_Sts.MessageEnable.Task3 /end REF_MEASUREMENT
/end GROUP
/begin GROUP SYSTEM.P_CAN.In_Dig_11_Sts "In_Dig_11_Sts"
 /begin ANNOTATION ANNOTATION_LABEL "Instance" ANNOTATION_ORIGIN "Group" /begin ANNOTATION_TEXT "80" /end ANNOTATION_TEXT /end ANNOTATION
 /begin ANNOTATION ANNOTATION_LABEL "TaskCycleTime" ANNOTATION_ORIGIN "Group" /begin ANNOTATION_TEXT "0" /end ANNOTATION_TEXT /end ANNOTATION
 /begin ANNOTATION ANNOTATION_LABEL "TimeResolution" ANNOTATION_ORIGIN "Group" /begin ANNOTATION_TEXT "0" /end ANNOTATION_TEXT /end ANNOTATION
 /begin REF_MEASUREMENT OUT_PCAN.Tx_Dig.In_Dig_11_Sts.IN_DIG_DIAG.Task3 OUT_PCAN.Tx_Dig.In_Dig_11_Sts.IN_DIG_Val.Task3 OUT_PCAN.Tx_Dig.In_Dig_11_Sts.MessageEnable.Task3 /end REF_MEASUREMENT
/end GROUP
/begin GROUP SYSTEM.P_CAN.In_Dig_10_Sts "In_Dig_10_Sts"
 /begin ANNOTATION ANNOTATION_LABEL "Instance" ANNOTATION_ORIGIN "Group" /begin ANNOTATION_TEXT "81" /end ANNOTATION_TEXT /end ANNOTATION
 /begin ANNOTATION ANNOTATION_LABEL "TaskCycleTime" ANNOTATION_ORIGIN "Group" /begin ANNOTATION_TEXT "0" /end ANNOTATION_TEXT /end ANNOTATION
 /begin ANNOTATION ANNOTATION_LABEL "TimeResolution" ANNOTATION_ORIGIN "Group" /begin ANNOTATION_TEXT "0" /end ANNOTATION_TEXT /end ANNOTATION
 /begin REF_MEASUREMENT OUT_PCAN.Tx_Dig.In_Dig_10_Sts.IN_DIG_DIAG.Task3 OUT_PCAN.Tx_Dig.In_Dig_10_Sts.IN_DIG_Val.Task3 OUT_PCAN.Tx_Dig.In_Dig_10_Sts.MessageEnable.Task3 /end REF_MEASUREMENT
/end GROUP
/begin GROUP SYSTEM.P_CAN.In_Dig_09_Sts "In_Dig_09_Sts"
 /begin ANNOTATION ANNOTATION_LABEL "Instance" ANNOTATION_ORIGIN "Group" /begin ANNOTATION_TEXT "82" /end ANNOTATION_TEXT /end ANNOTATION
 /begin ANNOTATION ANNOTATION_LABEL "TaskCycleTime" ANNOTATION_ORIGIN "Group" /begin ANNOTATION_TEXT "0" /end ANNOTATION_TEXT /end ANNOTATION
 /begin ANNOTATION ANNOTATION_LABEL "TimeResolution" ANNOTATION_ORIGIN "Group" /begin ANNOTATION_TEXT "0" /end ANNOTATION_TEXT /end ANNOTATION
 /begin REF_MEASUREMENT OUT_PCAN.Tx_Dig.In_Dig_09_Sts.IN_DIG_DIAG.Task3 OUT_PCAN.Tx_Dig.In_Dig_09_Sts.IN_DIG_Val.Task3 OUT_PCAN.Tx_Dig.In_Dig_09_Sts.MessageEnable.Task3 /end REF_MEASUREMENT
/end GROUP
/begin GROUP SYSTEM.P_CAN.In_Dig_08_Sts "In_Dig_08_Sts"
 /begin ANNOTATION ANNOTATION_LABEL "Instance" ANNOTATION_ORIGIN "Group" /begin ANNOTATION_TEXT "83" /end ANNOTATION_TEXT /end ANNOTATION
 /begin ANNOTATION ANNOTATION_LABEL "TaskCycleTime" ANNOTATION_ORIGIN "Group" /begin ANNOTATION_TEXT "0" /end ANNOTATION_TEXT /end ANNOTATION
 /begin ANNOTATION ANNOTATION_LABEL "TimeResolution" ANNOTATION_ORIGIN "Group" /begin ANNOTATION_TEXT "0" /end ANNOTATION_TEXT /end ANNOTATION
 /begin REF_MEASUREMENT OUT_PCAN.Tx_Dig.In_Dig_08_Sts.IN_DIG_DIAG.Task3 OUT_PCAN.Tx_Dig.In_Dig_08_Sts.IN_DIG_Val.Task3 OUT_PCAN.Tx_Dig.In_Dig_08_Sts.MessageEnable.Task3 /end REF_MEASUREMENT
/end GROUP
/begin GROUP SYSTEM.P_CAN.In_Dig_07_Sts "In_Dig_07_Sts"
 /begin ANNOTATION ANNOTATION_LABEL "Instance" ANNOTATION_ORIGIN "Group" /begin ANNOTATION_TEXT "84" /end ANNOTATION_TEXT /end ANNOTATION
 /begin ANNOTATION ANNOTATION_LABEL "TaskCycleTime" ANNOTATION_ORIGIN "Group" /begin ANNOTATION_TEXT "0" /end ANNOTATION_TEXT /end ANNOTATION
 /begin ANNOTATION ANNOTATION_LABEL "TimeResolution" ANNOTATION_ORIGIN "Group" /begin ANNOTATION_TEXT "0" /end ANNOTATION_TEXT /end ANNOTATION
 /begin REF_MEASUREMENT OUT_PCAN.Tx_Dig.In_Dig_07_Sts.IN_DIG_DIAG.Task3 OUT_PCAN.Tx_Dig.In_Dig_07_Sts.IN_DIG_Val.Task3 OUT_PCAN.Tx_Dig.In_Dig_07_Sts.MessageEnable.Task3 /end REF_MEASUREMENT
/end GROUP
/begin GROUP SYSTEM.P_CAN.In_Dig_06_Sts "In_Dig_06_Sts"
 /begin ANNOTATION ANNOTATION_LABEL "Instance" ANNOTATION_ORIGIN "Group" /begin ANNOTATION_TEXT "85" /end ANNOTATION_TEXT /end ANNOTATION
 /begin ANNOTATION ANNOTATION_LABEL "TaskCycleTime" ANNOTATION_ORIGIN "Group" /begin ANNOTATION_TEXT "0" /end ANNOTATION_TEXT /end ANNOTATION
 /begin ANNOTATION ANNOTATION_LABEL "TimeResolution" ANNOTATION_ORIGIN "Group" /begin ANNOTATION_TEXT "0" /end ANNOTATION_TEXT /end ANNOTATION
 /begin REF_MEASUREMENT OUT_PCAN.Tx_Dig.In_Dig_06_Sts.IN_DIG_DIAG.Task3 OUT_PCAN.Tx_Dig.In_Dig_06_Sts.IN_DIG_Val.Task3 OUT_PCAN.Tx_Dig.In_Dig_06_Sts.MessageEnable.Task3 /end REF_MEASUREMENT
/end GROUP
/begin GROUP SYSTEM.P_CAN.In_Dig_05_Sts "In_Dig_05_Sts"
 /begin ANNOTATION ANNOTATION_LABEL "Instance" ANNOTATION_ORIGIN "Group" /begin ANNOTATION_TEXT "86" /end ANNOTATION_TEXT /end ANNOTATION
 /begin ANNOTATION ANNOTATION_LABEL "TaskCycleTime" ANNOTATION_ORIGIN "Group" /begin ANNOTATION_TEXT "0" /end ANNOTATION_TEXT /end ANNOTATION
 /begin ANNOTATION ANNOTATION_LABEL "TimeResolution" ANNOTATION_ORIGIN "Group" /begin ANNOTATION_TEXT "0" /end ANNOTATION_TEXT /end ANNOTATION
 /begin REF_MEASUREMENT OUT_PCAN.Tx_Dig.In_Dig_05_Sts.IN_DIG_DIAG.Task3 OUT_PCAN.Tx_Dig.In_Dig_05_Sts.IN_DIG_Val.Task3 OUT_PCAN.Tx_Dig.In_Dig_05_Sts.MessageEnable.Task3 /end REF_MEASUREMENT
/end GROUP
/begin GROUP SYSTEM.P_CAN.In_Dig_04_Sts "In_Dig_04_Sts"
 /begin ANNOTATION ANNOTATION_LABEL "Instance" ANNOTATION_ORIGIN "Group" /begin ANNOTATION_TEXT "87" /end ANNOTATION_TEXT /end ANNOTATION
 /begin ANNOTATION ANNOTATION_LABEL "TaskCycleTime" ANNOTATION_ORIGIN "Group" /begin ANNOTATION_TEXT "0" /end ANNOTATION_TEXT /end ANNOTATION
 /begin ANNOTATION ANNOTATION_LABEL "TimeResolution" ANNOTATION_ORIGIN "Group" /begin ANNOTATION_TEXT "0" /end ANNOTATION_TEXT /end ANNOTATION
 /begin REF_MEASUREMENT OUT_PCAN.Tx_Dig.In_Dig_04_Sts.IN_DIG_DIAG.Task3 OUT_PCAN.Tx_Dig.In_Dig_04_Sts.IN_DIG_Val.Task3 OUT_PCAN.Tx_Dig.In_Dig_04_Sts.MessageEnable.Task3 /end REF_MEASUREMENT
/end GROUP
/begin GROUP SYSTEM.P_CAN.In_Dig_03_Sts "In_Dig_03_Sts"
 /begin ANNOTATION ANNOTATION_LABEL "Instance" ANNOTATION_ORIGIN "Group" /begin ANNOTATION_TEXT "88" /end ANNOTATION_TEXT /end ANNOTATION
 /begin ANNOTATION ANNOTATION_LABEL "TaskCycleTime" ANNOTATION_ORIGIN "Group" /begin ANNOTATION_TEXT "0" /end ANNOTATION_TEXT /end ANNOTATION
 /begin ANNOTATION ANNOTATION_LABEL "TimeResolution" ANNOTATION_ORIGIN "Group" /begin ANNOTATION_TEXT "0" /end ANNOTATION_TEXT /end ANNOTATION
 /begin REF_MEASUREMENT OUT_PCAN.Tx_Dig.In_Dig_03_Sts.IN_DIG_DIAG.Task3 OUT_PCAN.Tx_Dig.In_Dig_03_Sts.IN_DIG_Val.Task3 OUT_PCAN.Tx_Dig.In_Dig_03_Sts.MessageEnable.Task3 /end REF_MEASUREMENT
/end GROUP
/begin GROUP SYSTEM.P_CAN.In_Dig_02_Sts "In_Dig_02_Sts"
 /begin ANNOTATION ANNOTATION_LABEL "Instance" ANNOTATION_ORIGIN "Group" /begin ANNOTATION_TEXT "89" /end ANNOTATION_TEXT /end ANNOTATION
 /begin ANNOTATION ANNOTATION_LABEL "TaskCycleTime" ANNOTATION_ORIGIN "Group" /begin ANNOTATION_TEXT "0" /end ANNOTATION_TEXT /end ANNOTATION
 /begin ANNOTATION ANNOTATION_LABEL "TimeResolution" ANNOTATION_ORIGIN "Group" /begin ANNOTATION_TEXT "0" /end ANNOTATION_TEXT /end ANNOTATION
 /begin REF_MEASUREMENT OUT_PCAN.Tx_Dig.In_Dig_02_Sts.IN_DIG_DIAG.Task3 OUT_PCAN.Tx_Dig.In_Dig_02_Sts.IN_DIG_Val.Task3 OUT_PCAN.Tx_Dig.In_Dig_02_Sts.MessageEnable.Task3 /end REF_MEASUREMENT
/end GROUP
/begin GROUP SYSTEM.P_CAN.In_Dig_01_Sts "In_Dig_01_Sts"
 /begin ANNOTATION ANNOTATION_LABEL "Instance" ANNOTATION_ORIGIN "Group" /begin ANNOTATION_TEXT "90" /end ANNOTATION_TEXT /end ANNOTATION
 /begin ANNOTATION ANNOTATION_LABEL "TaskCycleTime" ANNOTATION_ORIGIN "Group" /begin ANNOTATION_TEXT "0" /end ANNOTATION_TEXT /end ANNOTATION
 /begin ANNOTATION ANNOTATION_LABEL "TimeResolution" ANNOTATION_ORIGIN "Group" /begin ANNOTATION_TEXT "0" /end ANNOTATION_TEXT /end ANNOTATION
 /begin REF_MEASUREMENT OUT_PCAN.Tx_Dig.In_Dig_01_Sts.IN_DIG_DIAG.Task3 OUT_PCAN.Tx_Dig.In_Dig_01_Sts.IN_DIG_Val.Task3 OUT_PCAN.Tx_Dig.In_Dig_01_Sts.MessageEnable.Task3 /end REF_MEASUREMENT
/end GROUP
/begin GROUP SYSTEM.P_CAN.Out_Supply_ANA_03_Sts "Out_Supply_ANA_03_Sts"
 /begin ANNOTATION ANNOTATION_LABEL "Instance" ANNOTATION_ORIGIN "Group" /begin ANNOTATION_TEXT "91" /end ANNOTATION_TEXT /end ANNOTATION
 /begin ANNOTATION ANNOTATION_LABEL "TaskCycleTime" ANNOTATION_ORIGIN "Group" /begin ANNOTATION_TEXT "0" /end ANNOTATION_TEXT /end ANNOTATION
 /begin ANNOTATION ANNOTATION_LABEL "TimeResolution" ANNOTATION_ORIGIN "Group" /begin ANNOTATION_TEXT "0" /end ANNOTATION_TEXT /end ANNOTATION
 /begin REF_MEASUREMENT OUT_PCAN.Tx_Pwr.Out_Supply_ANA_03_Sts.Supply_ANA_DIAG.Task3 OUT_PCAN.Tx_Pwr.Out_Supply_ANA_03_Sts.Supply_ANA_Val.Task3 OUT_PCAN.Tx_Pwr.Out_Supply_ANA_03_Sts.MessageEnable.Task3 /end REF_MEASUREMENT
/end GROUP
/begin GROUP SYSTEM.P_CAN.Out_Supply_ANA_02_Sts "Out_Supply_ANA_02_Sts"
 /begin ANNOTATION ANNOTATION_LABEL "Instance" ANNOTATION_ORIGIN "Group" /begin ANNOTATION_TEXT "92" /end ANNOTATION_TEXT /end ANNOTATION
 /begin ANNOTATION ANNOTATION_LABEL "TaskCycleTime" ANNOTATION_ORIGIN "Group" /begin ANNOTATION_TEXT "0" /end ANNOTATION_TEXT /end ANNOTATION
 /begin ANNOTATION ANNOTATION_LABEL "TimeResolution" ANNOTATION_ORIGIN "Group" /begin ANNOTATION_TEXT "0" /end ANNOTATION_TEXT /end ANNOTATION
 /begin REF_MEASUREMENT OUT_PCAN.Tx_Pwr.Out_Supply_ANA_02_Sts.Supply_ANA_DIAG.Task3 OUT_PCAN.Tx_Pwr.Out_Supply_ANA_02_Sts.Supply_ANA_Val.Task3 OUT_PCAN.Tx_Pwr.Out_Supply_ANA_02_Sts.MessageEnable.Task3 /end REF_MEASUREMENT
/end GROUP
/begin GROUP SYSTEM.P_CAN.Out_Supply_ANA_01_Sts "Out_Supply_ANA_01_Sts"
 /begin ANNOTATION ANNOTATION_LABEL "Instance" ANNOTATION_ORIGIN "Group" /begin ANNOTATION_TEXT "93" /end ANNOTATION_TEXT /end ANNOTATION
 /begin ANNOTATION ANNOTATION_LABEL "TaskCycleTime" ANNOTATION_ORIGIN "Group" /begin ANNOTATION_TEXT "0" /end ANNOTATION_TEXT /end ANNOTATION
 /begin ANNOTATION ANNOTATION_LABEL "TimeResolution" ANNOTATION_ORIGIN "Group" /begin ANNOTATION_TEXT "0" /end ANNOTATION_TEXT /end ANNOTATION
 /begin REF_MEASUREMENT OUT_PCAN.Tx_Pwr.Out_Supply_ANA_01_Sts.Supply_ANA_DIAG.Task3 OUT_PCAN.Tx_Pwr.Out_Supply_ANA_01_Sts.Supply_ANA_Val.Task3 OUT_PCAN.Tx_Pwr.Out_Supply_ANA_01_Sts.MessageEnable.Task3 /end REF_MEASUREMENT
/end GROUP
/begin GROUP SYSTEM.P_CAN.Lin_Sts "Lin_Sts"
 /begin ANNOTATION ANNOTATION_LABEL "Instance" ANNOTATION_ORIGIN "Group" /begin ANNOTATION_TEXT "94" /end ANNOTATION_TEXT /end ANNOTATION
 /begin ANNOTATION ANNOTATION_LABEL "TaskCycleTime" ANNOTATION_ORIGIN "Group" /begin ANNOTATION_TEXT "0" /end ANNOTATION_TEXT /end ANNOTATION
 /begin ANNOTATION ANNOTATION_LABEL "TimeResolution" ANNOTATION_ORIGIN "Group" /begin ANNOTATION_TEXT "0" /end ANNOTATION_TEXT /end ANNOTATION
 /begin REF_MEASUREMENT OUT_PCAN.Tx_Acc.Lin_Sts.BatteryVoltage.Task5 OUT_PCAN.Tx_Acc.Lin_Sts.Button_KL15.Task5 OUT_PCAN.Tx_Acc.Lin_Sts.MessageEnable.Task5 /end REF_MEASUREMENT
/end GROUP
/begin GROUP SYSTEM.P_CAN.ACCELEROMETER "ACCELEROMETER"
 /begin ANNOTATION ANNOTATION_LABEL "Instance" ANNOTATION_ORIGIN "Group" /begin ANNOTATION_TEXT "95" /end ANNOTATION_TEXT /end ANNOTATION
 /begin ANNOTATION ANNOTATION_LABEL "TaskCycleTime" ANNOTATION_ORIGIN "Group" /begin ANNOTATION_TEXT "0" /end ANNOTATION_TEXT /end ANNOTATION
 /begin ANNOTATION ANNOTATION_LABEL "TimeResolution" ANNOTATION_ORIGIN "Group" /begin ANNOTATION_TEXT "0" /end ANNOTATION_TEXT /end ANNOTATION
 /begin REF_MEASUREMENT OUT_PCAN.Tx_Acc.ACCELEROMETER.X.Task5 OUT_PCAN.Tx_Acc.ACCELEROMETER.Y.Task5 OUT_PCAN.Tx_Acc.ACCELEROMETER.Z.Task5 OUT_PCAN.Tx_Acc.ACCELEROMETER.MessageEnable.Task5 /end REF_MEASUREMENT
/end GROUP
/begin GROUP SYSTEM.P_CAN.Out_27_Sts "Out_27_Sts"
 /begin ANNOTATION ANNOTATION_LABEL "Instance" ANNOTATION_ORIGIN "Group" /begin ANNOTATION_TEXT "96" /end ANNOTATION_TEXT /end ANNOTATION
 /begin ANNOTATION ANNOTATION_LABEL "TaskCycleTime" ANNOTATION_ORIGIN "Group" /begin ANNOTATION_TEXT "0" /end ANNOTATION_TEXT /end ANNOTATION
 /begin ANNOTATION ANNOTATION_LABEL "TimeResolution" ANNOTATION_ORIGIN "Group" /begin ANNOTATION_TEXT "0" /end ANNOTATION_TEXT /end ANNOTATION
 /begin REF_MEASUREMENT OUT_PCAN.Tx_Out.Out_27_Sts.Out_DIAG.Task3 OUT_PCAN.Tx_Out.Out_27_Sts.Out_SENSE.Task3 OUT_PCAN.Tx_Out.Out_27_Sts.MessageEnable.Task3 OUT_PCAN.Tx_Out.Out_27_Sts.Out_STATUS.Task3 /end REF_MEASUREMENT
/end GROUP
/begin GROUP SYSTEM.P_CAN.Out_26_Sts "Out_26_Sts"
 /begin ANNOTATION ANNOTATION_LABEL "Instance" ANNOTATION_ORIGIN "Group" /begin ANNOTATION_TEXT "97" /end ANNOTATION_TEXT /end ANNOTATION
 /begin ANNOTATION ANNOTATION_LABEL "TaskCycleTime" ANNOTATION_ORIGIN "Group" /begin ANNOTATION_TEXT "0" /end ANNOTATION_TEXT /end ANNOTATION
 /begin ANNOTATION ANNOTATION_LABEL "TimeResolution" ANNOTATION_ORIGIN "Group" /begin ANNOTATION_TEXT "0" /end ANNOTATION_TEXT /end ANNOTATION
 /begin REF_MEASUREMENT OUT_PCAN.Tx_Out.Out_26_Sts.Out_DIAG.Task3 OUT_PCAN.Tx_Out.Out_26_Sts.Out_SENSE.Task3 OUT_PCAN.Tx_Out.Out_26_Sts.MessageEnable.Task3 OUT_PCAN.Tx_Out.Out_26_Sts.Out_STATUS.Task3 /end REF_MEASUREMENT
/end GROUP
/begin GROUP SYSTEM.P_CAN.Out_25_Sts "Out_25_Sts"
 /begin ANNOTATION ANNOTATION_LABEL "Instance" ANNOTATION_ORIGIN "Group" /begin ANNOTATION_TEXT "98" /end ANNOTATION_TEXT /end ANNOTATION
 /begin ANNOTATION ANNOTATION_LABEL "TaskCycleTime" ANNOTATION_ORIGIN "Group" /begin ANNOTATION_TEXT "0" /end ANNOTATION_TEXT /end ANNOTATION
 /begin ANNOTATION ANNOTATION_LABEL "TimeResolution" ANNOTATION_ORIGIN "Group" /begin ANNOTATION_TEXT "0" /end ANNOTATION_TEXT /end ANNOTATION
 /begin REF_MEASUREMENT OUT_PCAN.Tx_Out.Out_25_Sts.Out_DIAG.Task3 OUT_PCAN.Tx_Out.Out_25_Sts.Out_SENSE.Task3 OUT_PCAN.Tx_Out.Out_25_Sts.MessageEnable.Task3 OUT_PCAN.Tx_Out.Out_25_Sts.Out_STATUS.Task3 /end REF_MEASUREMENT
/end GROUP
/begin GROUP SYSTEM.P_CAN.Out_24_Sts "Out_24_Sts"
 /begin ANNOTATION ANNOTATION_LABEL "Instance" ANNOTATION_ORIGIN "Group" /begin ANNOTATION_TEXT "99" /end ANNOTATION_TEXT /end ANNOTATION
 /begin ANNOTATION ANNOTATION_LABEL "TaskCycleTime" ANNOTATION_ORIGIN "Group" /begin ANNOTATION_TEXT "0" /end ANNOTATION_TEXT /end ANNOTATION
 /begin ANNOTATION ANNOTATION_LABEL "TimeResolution" ANNOTATION_ORIGIN "Group" /begin ANNOTATION_TEXT "0" /end ANNOTATION_TEXT /end ANNOTATION
 /begin REF_MEASUREMENT OUT_PCAN.Tx_Out.Out_24_Sts.Out_DIAG.Task3 OUT_PCAN.Tx_Out.Out_24_Sts.Out_SENSE.Task3 OUT_PCAN.Tx_Out.Out_24_Sts.MessageEnable.Task3 OUT_PCAN.Tx_Out.Out_24_Sts.Out_STATUS.Task3 /end REF_MEASUREMENT
/end GROUP
/begin GROUP SYSTEM.P_CAN.Out_23_Sts "Out_23_Sts"
 /begin ANNOTATION ANNOTATION_LABEL "Instance" ANNOTATION_ORIGIN "Group" /begin ANNOTATION_TEXT "100" /end ANNOTATION_TEXT /end ANNOTATION
 /begin ANNOTATION ANNOTATION_LABEL "TaskCycleTime" ANNOTATION_ORIGIN "Group" /begin ANNOTATION_TEXT "0" /end ANNOTATION_TEXT /end ANNOTATION
 /begin ANNOTATION ANNOTATION_LABEL "TimeResolution" ANNOTATION_ORIGIN "Group" /begin ANNOTATION_TEXT "0" /end ANNOTATION_TEXT /end ANNOTATION
 /begin REF_MEASUREMENT OUT_PCAN.Tx_Out.Out_23_Sts.Out_DIAG.Task3 OUT_PCAN.Tx_Out.Out_23_Sts.Out_SENSE.Task3 OUT_PCAN.Tx_Out.Out_23_Sts.MessageEnable.Task3 OUT_PCAN.Tx_Out.Out_23_Sts.Out_STATUS.Task3 /end REF_MEASUREMENT
/end GROUP
/begin GROUP SYSTEM.P_CAN.Out_22_Sts "Out_22_Sts"
 /begin ANNOTATION ANNOTATION_LABEL "Instance" ANNOTATION_ORIGIN "Group" /begin ANNOTATION_TEXT "101" /end ANNOTATION_TEXT /end ANNOTATION
 /begin ANNOTATION ANNOTATION_LABEL "TaskCycleTime" ANNOTATION_ORIGIN "Group" /begin ANNOTATION_TEXT "0" /end ANNOTATION_TEXT /end ANNOTATION
 /begin ANNOTATION ANNOTATION_LABEL "TimeResolution" ANNOTATION_ORIGIN "Group" /begin ANNOTATION_TEXT "0" /end ANNOTATION_TEXT /end ANNOTATION
 /begin REF_MEASUREMENT OUT_PCAN.Tx_Out.Out_22_Sts.Out_DIAG.Task3 OUT_PCAN.Tx_Out.Out_22_Sts.Out_SENSE.Task3 OUT_PCAN.Tx_Out.Out_22_Sts.MessageEnable.Task3 OUT_PCAN.Tx_Out.Out_22_Sts.Out_STATUS.Task3 /end REF_MEASUREMENT
/end GROUP
/begin GROUP SYSTEM.P_CAN.Out_21_Sts "Out_21_Sts"
 /begin ANNOTATION ANNOTATION_LABEL "Instance" ANNOTATION_ORIGIN "Group" /begin ANNOTATION_TEXT "102" /end ANNOTATION_TEXT /end ANNOTATION
 /begin ANNOTATION ANNOTATION_LABEL "TaskCycleTime" ANNOTATION_ORIGIN "Group" /begin ANNOTATION_TEXT "0" /end ANNOTATION_TEXT /end ANNOTATION
 /begin ANNOTATION ANNOTATION_LABEL "TimeResolution" ANNOTATION_ORIGIN "Group" /begin ANNOTATION_TEXT "0" /end ANNOTATION_TEXT /end ANNOTATION
 /begin REF_MEASUREMENT OUT_PCAN.Tx_Out.Out_21_Sts.Out_DIAG.Task3 OUT_PCAN.Tx_Out.Out_21_Sts.Out_SENSE.Task3 OUT_PCAN.Tx_Out.Out_21_Sts.Out_TD_DIAG.Task3 OUT_PCAN.Tx_Out.Out_21_Sts.MessageEnable.Task3 OUT_PCAN.Tx_Out.Out_21_Sts.Out_STATUS.Task3 OUT_PCAN.Tx_Out.Out_21_Sts.Out_TD.Task3 /end REF_MEASUREMENT
/end GROUP
/begin GROUP SYSTEM.P_CAN.Out_20_Sts "Out_20_Sts"
 /begin ANNOTATION ANNOTATION_LABEL "Instance" ANNOTATION_ORIGIN "Group" /begin ANNOTATION_TEXT "103" /end ANNOTATION_TEXT /end ANNOTATION
 /begin ANNOTATION ANNOTATION_LABEL "TaskCycleTime" ANNOTATION_ORIGIN "Group" /begin ANNOTATION_TEXT "0" /end ANNOTATION_TEXT /end ANNOTATION
 /begin ANNOTATION ANNOTATION_LABEL "TimeResolution" ANNOTATION_ORIGIN "Group" /begin ANNOTATION_TEXT "0" /end ANNOTATION_TEXT /end ANNOTATION
 /begin REF_MEASUREMENT OUT_PCAN.Tx_Out.Out_20_Sts.Out_DIAG.Task3 OUT_PCAN.Tx_Out.Out_20_Sts.Out_SENSE.Task3 OUT_PCAN.Tx_Out.Out_20_Sts.Out_TD_DIAG.Task3 OUT_PCAN.Tx_Out.Out_20_Sts.MessageEnable.Task3 OUT_PCAN.Tx_Out.Out_20_Sts.Out_STATUS.Task3 OUT_PCAN.Tx_Out.Out_20_Sts.Out_TD.Task3 /end REF_MEASUREMENT
/end GROUP
/begin GROUP SYSTEM.P_CAN.Out_19_Sts "Out_19_Sts"
 /begin ANNOTATION ANNOTATION_LABEL "Instance" ANNOTATION_ORIGIN "Group" /begin ANNOTATION_TEXT "104" /end ANNOTATION_TEXT /end ANNOTATION
 /begin ANNOTATION ANNOTATION_LABEL "TaskCycleTime" ANNOTATION_ORIGIN "Group" /begin ANNOTATION_TEXT "0" /end ANNOTATION_TEXT /end ANNOTATION
 /begin ANNOTATION ANNOTATION_LABEL "TimeResolution" ANNOTATION_ORIGIN "Group" /begin ANNOTATION_TEXT "0" /end ANNOTATION_TEXT /end ANNOTATION
 /begin REF_MEASUREMENT OUT_PCAN.Tx_Out.Out_19_Sts.Out_DIAG.Task3 OUT_PCAN.Tx_Out.Out_19_Sts.Out_SENSE.Task3 OUT_PCAN.Tx_Out.Out_19_Sts.MessageEnable.Task3 OUT_PCAN.Tx_Out.Out_19_Sts.Out_STATUS.Task3 /end REF_MEASUREMENT
/end GROUP
/begin GROUP SYSTEM.P_CAN.Out_18_Sts "Out_18_Sts"
 /begin ANNOTATION ANNOTATION_LABEL "Instance" ANNOTATION_ORIGIN "Group" /begin ANNOTATION_TEXT "105" /end ANNOTATION_TEXT /end ANNOTATION
 /begin ANNOTATION ANNOTATION_LABEL "TaskCycleTime" ANNOTATION_ORIGIN "Group" /begin ANNOTATION_TEXT "0" /end ANNOTATION_TEXT /end ANNOTATION
 /begin ANNOTATION ANNOTATION_LABEL "TimeResolution" ANNOTATION_ORIGIN "Group" /begin ANNOTATION_TEXT "0" /end ANNOTATION_TEXT /end ANNOTATION
 /begin REF_MEASUREMENT OUT_PCAN.Tx_Out.Out_18_Sts.Out_DIAG.Task3 OUT_PCAN.Tx_Out.Out_18_Sts.Out_SENSE.Task3 OUT_PCAN.Tx_Out.Out_18_Sts.MessageEnable.Task3 OUT_PCAN.Tx_Out.Out_18_Sts.Out_STATUS.Task3 /end REF_MEASUREMENT
/end GROUP
/begin GROUP SYSTEM.P_CAN.Out_17_Sts "Out_17_Sts"
 /begin ANNOTATION ANNOTATION_LABEL "Instance" ANNOTATION_ORIGIN "Group" /begin ANNOTATION_TEXT "106" /end ANNOTATION_TEXT /end ANNOTATION
 /begin ANNOTATION ANNOTATION_LABEL "TaskCycleTime" ANNOTATION_ORIGIN "Group" /begin ANNOTATION_TEXT "0" /end ANNOTATION_TEXT /end ANNOTATION
 /begin ANNOTATION ANNOTATION_LABEL "TimeResolution" ANNOTATION_ORIGIN "Group" /begin ANNOTATION_TEXT "0" /end ANNOTATION_TEXT /end ANNOTATION
 /begin REF_MEASUREMENT OUT_PCAN.Tx_Out.Out_17_Sts.Out_DIAG.Task3 OUT_PCAN.Tx_Out.Out_17_Sts.Out_SENSE.Task3 OUT_PCAN.Tx_Out.Out_17_Sts.MessageEnable.Task3 OUT_PCAN.Tx_Out.Out_17_Sts.Out_STATUS.Task3 /end REF_MEASUREMENT
/end GROUP
/begin GROUP SYSTEM.P_CAN.Out_16_Sts "Out_16_Sts"
 /begin ANNOTATION ANNOTATION_LABEL "Instance" ANNOTATION_ORIGIN "Group" /begin ANNOTATION_TEXT "107" /end ANNOTATION_TEXT /end ANNOTATION
 /begin ANNOTATION ANNOTATION_LABEL "TaskCycleTime" ANNOTATION_ORIGIN "Group" /begin ANNOTATION_TEXT "0" /end ANNOTATION_TEXT /end ANNOTATION
 /begin ANNOTATION ANNOTATION_LABEL "TimeResolution" ANNOTATION_ORIGIN "Group" /begin ANNOTATION_TEXT "0" /end ANNOTATION_TEXT /end ANNOTATION
 /begin REF_MEASUREMENT OUT_PCAN.Tx_Out.Out_16_Sts.Out_DIAG.Task3 OUT_PCAN.Tx_Out.Out_16_Sts.Out_SENSE.Task3 OUT_PCAN.Tx_Out.Out_16_Sts.MessageEnable.Task3 OUT_PCAN.Tx_Out.Out_16_Sts.Out_STATUS.Task3 /end REF_MEASUREMENT
/end GROUP
/begin GROUP SYSTEM.P_CAN.Out_15_Sts "Out_15_Sts"
 /begin ANNOTATION ANNOTATION_LABEL "Instance" ANNOTATION_ORIGIN "Group" /begin ANNOTATION_TEXT "108" /end ANNOTATION_TEXT /end ANNOTATION
 /begin ANNOTATION ANNOTATION_LABEL "TaskCycleTime" ANNOTATION_ORIGIN "Group" /begin ANNOTATION_TEXT "0" /end ANNOTATION_TEXT /end ANNOTATION
 /begin ANNOTATION ANNOTATION_LABEL "TimeResolution" ANNOTATION_ORIGIN "Group" /begin ANNOTATION_TEXT "0" /end ANNOTATION_TEXT /end ANNOTATION
 /begin REF_MEASUREMENT OUT_PCAN.Tx_Out.Out_15_Sts.Out_DIAG.Task3 OUT_PCAN.Tx_Out.Out_15_Sts.Out_SENSE.Task3 OUT_PCAN.Tx_Out.Out_15_Sts.Out_TD_DIAG.Task3 OUT_PCAN.Tx_Out.Out_15_Sts.MessageEnable.Task3 OUT_PCAN.Tx_Out.Out_15_Sts.Out_STATUS.Task3 OUT_PCAN.Tx_Out.Out_15_Sts.Out_TD.Task3 /end REF_MEASUREMENT
/end GROUP
/begin GROUP SYSTEM.P_CAN.Out_14_Sts "Out_14_Sts"
 /begin ANNOTATION ANNOTATION_LABEL "Instance" ANNOTATION_ORIGIN "Group" /begin ANNOTATION_TEXT "109" /end ANNOTATION_TEXT /end ANNOTATION
 /begin ANNOTATION ANNOTATION_LABEL "TaskCycleTime" ANNOTATION_ORIGIN "Group" /begin ANNOTATION_TEXT "0" /end ANNOTATION_TEXT /end ANNOTATION
 /begin ANNOTATION ANNOTATION_LABEL "TimeResolution" ANNOTATION_ORIGIN "Group" /begin ANNOTATION_TEXT "0" /end ANNOTATION_TEXT /end ANNOTATION
 /begin REF_MEASUREMENT OUT_PCAN.Tx_Out.Out_14_Sts.Out_DIAG.Task3 OUT_PCAN.Tx_Out.Out_14_Sts.Out_SENSE.Task3 OUT_PCAN.Tx_Out.Out_14_Sts.Out_TD_DIAG.Task3 OUT_PCAN.Tx_Out.Out_14_Sts.MessageEnable.Task3 OUT_PCAN.Tx_Out.Out_14_Sts.Out_STATUS.Task3 OUT_PCAN.Tx_Out.Out_14_Sts.Out_TD.Task3 /end REF_MEASUREMENT
/end GROUP
/begin GROUP SYSTEM.P_CAN.Out_13_Sts "Out_13_Sts"
 /begin ANNOTATION ANNOTATION_LABEL "Instance" ANNOTATION_ORIGIN "Group" /begin ANNOTATION_TEXT "110" /end ANNOTATION_TEXT /end ANNOTATION
 /begin ANNOTATION ANNOTATION_LABEL "TaskCycleTime" ANNOTATION_ORIGIN "Group" /begin ANNOTATION_TEXT "0" /end ANNOTATION_TEXT /end ANNOTATION
 /begin ANNOTATION ANNOTATION_LABEL "TimeResolution" ANNOTATION_ORIGIN "Group" /begin ANNOTATION_TEXT "0" /end ANNOTATION_TEXT /end ANNOTATION
 /begin REF_MEASUREMENT OUT_PCAN.Tx_Out.Out_13_Sts.Out_DIAG.Task3 OUT_PCAN.Tx_Out.Out_13_Sts.Out_SENSE.Task3 OUT_PCAN.Tx_Out.Out_13_Sts.Out_TD_DIAG.Task3 OUT_PCAN.Tx_Out.Out_13_Sts.MessageEnable.Task3 OUT_PCAN.Tx_Out.Out_13_Sts.Out_STATUS.Task3 OUT_PCAN.Tx_Out.Out_13_Sts.Out_TD.Task3 /end REF_MEASUREMENT
/end GROUP
/begin GROUP SYSTEM.P_CAN.Out_12_Sts "Out_12_Sts"
 /begin ANNOTATION ANNOTATION_LABEL "Instance" ANNOTATION_ORIGIN "Group" /begin ANNOTATION_TEXT "111" /end ANNOTATION_TEXT /end ANNOTATION
 /begin ANNOTATION ANNOTATION_LABEL "TaskCycleTime" ANNOTATION_ORIGIN "Group" /begin ANNOTATION_TEXT "0" /end ANNOTATION_TEXT /end ANNOTATION
 /begin ANNOTATION ANNOTATION_LABEL "TimeResolution" ANNOTATION_ORIGIN "Group" /begin ANNOTATION_TEXT "0" /end ANNOTATION_TEXT /end ANNOTATION
 /begin REF_MEASUREMENT OUT_PCAN.Tx_Out.Out_12_Sts.Out_DIAG.Task3 OUT_PCAN.Tx_Out.Out_12_Sts.Out_SENSE.Task3 OUT_PCAN.Tx_Out.Out_12_Sts.Out_TD_DIAG.Task3 OUT_PCAN.Tx_Out.Out_12_Sts.MessageEnable.Task3 OUT_PCAN.Tx_Out.Out_12_Sts.Out_STATUS.Task3 OUT_PCAN.Tx_Out.Out_12_Sts.Out_TD.Task3 /end REF_MEASUREMENT
/end GROUP
/begin GROUP SYSTEM.P_CAN.Out_11_Sts "Out_11_Sts"
 /begin ANNOTATION ANNOTATION_LABEL "Instance" ANNOTATION_ORIGIN "Group" /begin ANNOTATION_TEXT "112" /end ANNOTATION_TEXT /end ANNOTATION
 /begin ANNOTATION ANNOTATION_LABEL "TaskCycleTime" ANNOTATION_ORIGIN "Group" /begin ANNOTATION_TEXT "0" /end ANNOTATION_TEXT /end ANNOTATION
 /begin ANNOTATION ANNOTATION_LABEL "TimeResolution" ANNOTATION_ORIGIN "Group" /begin ANNOTATION_TEXT "0" /end ANNOTATION_TEXT /end ANNOTATION
 /begin REF_MEASUREMENT OUT_PCAN.Tx_Out.Out_11_Sts.Out_DIAG.Task3 OUT_PCAN.Tx_Out.Out_11_Sts.Out_SENSE.Task3 OUT_PCAN.Tx_Out.Out_11_Sts.MessageEnable.Task3 OUT_PCAN.Tx_Out.Out_11_Sts.Out_STATUS.Task3 /end REF_MEASUREMENT
/end GROUP
/begin GROUP SYSTEM.P_CAN.Out_10_Sts "Out_10_Sts"
 /begin ANNOTATION ANNOTATION_LABEL "Instance" ANNOTATION_ORIGIN "Group" /begin ANNOTATION_TEXT "113" /end ANNOTATION_TEXT /end ANNOTATION
 /begin ANNOTATION ANNOTATION_LABEL "TaskCycleTime" ANNOTATION_ORIGIN "Group" /begin ANNOTATION_TEXT "0" /end ANNOTATION_TEXT /end ANNOTATION
 /begin ANNOTATION ANNOTATION_LABEL "TimeResolution" ANNOTATION_ORIGIN "Group" /begin ANNOTATION_TEXT "0" /end ANNOTATION_TEXT /end ANNOTATION
 /begin REF_MEASUREMENT OUT_PCAN.Tx_Out.Out_10_Sts.Out_DIAG.Task3 OUT_PCAN.Tx_Out.Out_10_Sts.Out_SENSE.Task3 OUT_PCAN.Tx_Out.Out_10_Sts.MessageEnable.Task3 OUT_PCAN.Tx_Out.Out_10_Sts.Out_STATUS.Task3 /end REF_MEASUREMENT
/end GROUP
/begin GROUP SYSTEM.P_CAN.Out_09_Sts "Out_09_Sts"
 /begin ANNOTATION ANNOTATION_LABEL "Instance" ANNOTATION_ORIGIN "Group" /begin ANNOTATION_TEXT "114" /end ANNOTATION_TEXT /end ANNOTATION
 /begin ANNOTATION ANNOTATION_LABEL "TaskCycleTime" ANNOTATION_ORIGIN "Group" /begin ANNOTATION_TEXT "0" /end ANNOTATION_TEXT /end ANNOTATION
 /begin ANNOTATION ANNOTATION_LABEL "TimeResolution" ANNOTATION_ORIGIN "Group" /begin ANNOTATION_TEXT "0" /end ANNOTATION_TEXT /end ANNOTATION
 /begin REF_MEASUREMENT OUT_PCAN.Tx_Out.Out_09_Sts.Out_DIAG.Task3 OUT_PCAN.Tx_Out.Out_09_Sts.Out_SENSE.Task3 OUT_PCAN.Tx_Out.Out_09_Sts.MessageEnable.Task3 OUT_PCAN.Tx_Out.Out_09_Sts.Out_STATUS.Task3 /end REF_MEASUREMENT
/end GROUP
/begin GROUP SYSTEM.P_CAN.Out_08_Sts "Out_08_Sts"
 /begin ANNOTATION ANNOTATION_LABEL "Instance" ANNOTATION_ORIGIN "Group" /begin ANNOTATION_TEXT "115" /end ANNOTATION_TEXT /end ANNOTATION
 /begin ANNOTATION ANNOTATION_LABEL "TaskCycleTime" ANNOTATION_ORIGIN "Group" /begin ANNOTATION_TEXT "0" /end ANNOTATION_TEXT /end ANNOTATION
 /begin ANNOTATION ANNOTATION_LABEL "TimeResolution" ANNOTATION_ORIGIN "Group" /begin ANNOTATION_TEXT "0" /end ANNOTATION_TEXT /end ANNOTATION
 /begin REF_MEASUREMENT OUT_PCAN.Tx_Out.Out_08_Sts.Out_DIAG.Task3 OUT_PCAN.Tx_Out.Out_08_Sts.Out_SENSE.Task3 OUT_PCAN.Tx_Out.Out_08_Sts.Out_TD_DIAG.Task3 OUT_PCAN.Tx_Out.Out_08_Sts.MessageEnable.Task3 OUT_PCAN.Tx_Out.Out_08_Sts.Out_STATUS.Task3 OUT_PCAN.Tx_Out.Out_08_Sts.Out_TD.Task3 /end REF_MEASUREMENT
/end GROUP
/begin GROUP SYSTEM.P_CAN.Out_07_Sts "Out_07_Sts"
 /begin ANNOTATION ANNOTATION_LABEL "Instance" ANNOTATION_ORIGIN "Group" /begin ANNOTATION_TEXT "116" /end ANNOTATION_TEXT /end ANNOTATION
 /begin ANNOTATION ANNOTATION_LABEL "TaskCycleTime" ANNOTATION_ORIGIN "Group" /begin ANNOTATION_TEXT "0" /end ANNOTATION_TEXT /end ANNOTATION
 /begin ANNOTATION ANNOTATION_LABEL "TimeResolution" ANNOTATION_ORIGIN "Group" /begin ANNOTATION_TEXT "0" /end ANNOTATION_TEXT /end ANNOTATION
 /begin REF_MEASUREMENT OUT_PCAN.Tx_Out.Out_07_Sts.Out_DIAG.Task3 OUT_PCAN.Tx_Out.Out_07_Sts.Out_SENSE.Task3 OUT_PCAN.Tx_Out.Out_07_Sts.Out_TD_DIAG.Task3 OUT_PCAN.Tx_Out.Out_07_Sts.MessageEnable.Task3 OUT_PCAN.Tx_Out.Out_07_Sts.Out_STATUS.Task3 OUT_PCAN.Tx_Out.Out_07_Sts.Out_TD.Task3 /end REF_MEASUREMENT
/end GROUP
/begin GROUP SYSTEM.P_CAN.Out_06_Sts "Out_06_Sts"
 /begin ANNOTATION ANNOTATION_LABEL "Instance" ANNOTATION_ORIGIN "Group" /begin ANNOTATION_TEXT "117" /end ANNOTATION_TEXT /end ANNOTATION
 /begin ANNOTATION ANNOTATION_LABEL "TaskCycleTime" ANNOTATION_ORIGIN "Group" /begin ANNOTATION_TEXT "0" /end ANNOTATION_TEXT /end ANNOTATION
 /begin ANNOTATION ANNOTATION_LABEL "TimeResolution" ANNOTATION_ORIGIN "Group" /begin ANNOTATION_TEXT "0" /end ANNOTATION_TEXT /end ANNOTATION
 /begin REF_MEASUREMENT OUT_PCAN.Tx_Out.Out_06_Sts.Out_DIAG.Task3 OUT_PCAN.Tx_Out.Out_06_Sts.Out_SENSE.Task3 OUT_PCAN.Tx_Out.Out_06_Sts.Out_TD_DIAG.Task3 OUT_PCAN.Tx_Out.Out_06_Sts.MessageEnable.Task3 OUT_PCAN.Tx_Out.Out_06_Sts.Out_STATUS.Task3 OUT_PCAN.Tx_Out.Out_06_Sts.Out_TD.Task3 /end REF_MEASUREMENT
/end GROUP
/begin GROUP SYSTEM.P_CAN.Out_05_Sts "Out_05_Sts"
 /begin ANNOTATION ANNOTATION_LABEL "Instance" ANNOTATION_ORIGIN "Group" /begin ANNOTATION_TEXT "118" /end ANNOTATION_TEXT /end ANNOTATION
 /begin ANNOTATION ANNOTATION_LABEL "TaskCycleTime" ANNOTATION_ORIGIN "Group" /begin ANNOTATION_TEXT "0" /end ANNOTATION_TEXT /end ANNOTATION
 /begin ANNOTATION ANNOTATION_LABEL "TimeResolution" ANNOTATION_ORIGIN "Group" /begin ANNOTATION_TEXT "0" /end ANNOTATION_TEXT /end ANNOTATION
 /begin REF_MEASUREMENT OUT_PCAN.Tx_Out.Out_05_Sts.Out_DIAG.Task3 OUT_PCAN.Tx_Out.Out_05_Sts.Out_SENSE.Task3 OUT_PCAN.Tx_Out.Out_05_Sts.MessageEnable.Task3 OUT_PCAN.Tx_Out.Out_05_Sts.Out_STATUS.Task3 /end REF_MEASUREMENT
/end GROUP
/begin GROUP SYSTEM.P_CAN.Out_04_Sts "Out_04_Sts"
 /begin ANNOTATION ANNOTATION_LABEL "Instance" ANNOTATION_ORIGIN "Group" /begin ANNOTATION_TEXT "119" /end ANNOTATION_TEXT /end ANNOTATION
 /begin ANNOTATION ANNOTATION_LABEL "TaskCycleTime" ANNOTATION_ORIGIN "Group" /begin ANNOTATION_TEXT "0" /end ANNOTATION_TEXT /end ANNOTATION
 /begin ANNOTATION ANNOTATION_LABEL "TimeResolution" ANNOTATION_ORIGIN "Group" /begin ANNOTATION_TEXT "0" /end ANNOTATION_TEXT /end ANNOTATION
 /begin REF_MEASUREMENT OUT_PCAN.Tx_Out.Out_04_Sts.Out_DIAG.Task3 OUT_PCAN.Tx_Out.Out_04_Sts.Out_SENSE.Task3 OUT_PCAN.Tx_Out.Out_04_Sts.Out_TD_DIAG.Task3 OUT_PCAN.Tx_Out.Out_04_Sts.MessageEnable.Task3 OUT_PCAN.Tx_Out.Out_04_Sts.Out_STATUS.Task3 OUT_PCAN.Tx_Out.Out_04_Sts.Out_TD.Task3 /end REF_MEASUREMENT
/end GROUP
/begin GROUP SYSTEM.P_CAN.Out_03_Sts "Out_03_Sts"
 /begin ANNOTATION ANNOTATION_LABEL "Instance" ANNOTATION_ORIGIN "Group" /begin ANNOTATION_TEXT "120" /end ANNOTATION_TEXT /end ANNOTATION
 /begin ANNOTATION ANNOTATION_LABEL "TaskCycleTime" ANNOTATION_ORIGIN "Group" /begin ANNOTATION_TEXT "0" /end ANNOTATION_TEXT /end ANNOTATION
 /begin ANNOTATION ANNOTATION_LABEL "TimeResolution" ANNOTATION_ORIGIN "Group" /begin ANNOTATION_TEXT "0" /end ANNOTATION_TEXT /end ANNOTATION
 /begin REF_MEASUREMENT OUT_PCAN.Tx_Out.Out_03_Sts.Out_DIAG.Task3 OUT_PCAN.Tx_Out.Out_03_Sts.Out_SENSE.Task3 OUT_PCAN.Tx_Out.Out_03_Sts.MessageEnable.Task3 OUT_PCAN.Tx_Out.Out_03_Sts.Out_STATUS.Task3 /end REF_MEASUREMENT
/end GROUP
/begin GROUP SYSTEM.P_CAN.Out_02_Sts "Out_02_Sts"
 /begin ANNOTATION ANNOTATION_LABEL "Instance" ANNOTATION_ORIGIN "Group" /begin ANNOTATION_TEXT "121" /end ANNOTATION_TEXT /end ANNOTATION
 /begin ANNOTATION ANNOTATION_LABEL "TaskCycleTime" ANNOTATION_ORIGIN "Group" /begin ANNOTATION_TEXT "0" /end ANNOTATION_TEXT /end ANNOTATION
 /begin ANNOTATION ANNOTATION_LABEL "TimeResolution" ANNOTATION_ORIGIN "Group" /begin ANNOTATION_TEXT "0" /end ANNOTATION_TEXT /end ANNOTATION
 /begin REF_MEASUREMENT OUT_PCAN.Tx_Out.Out_02_Sts.Out_DIAG.Task3 OUT_PCAN.Tx_Out.Out_02_Sts.Out_SENSE.Task3 OUT_PCAN.Tx_Out.Out_02_Sts.MessageEnable.Task3 OUT_PCAN.Tx_Out.Out_02_Sts.Out_STATUS.Task3 /end REF_MEASUREMENT
/end GROUP
/begin GROUP SYSTEM.P_CAN.Out_01_Sts "Out_01_Sts"
 /begin ANNOTATION ANNOTATION_LABEL "Instance" ANNOTATION_ORIGIN "Group" /begin ANNOTATION_TEXT "122" /end ANNOTATION_TEXT /end ANNOTATION
 /begin ANNOTATION ANNOTATION_LABEL "TaskCycleTime" ANNOTATION_ORIGIN "Group" /begin ANNOTATION_TEXT "0" /end ANNOTATION_TEXT /end ANNOTATION
 /begin ANNOTATION ANNOTATION_LABEL "TimeResolution" ANNOTATION_ORIGIN "Group" /begin ANNOTATION_TEXT "0" /end ANNOTATION_TEXT /end ANNOTATION
 /begin REF_MEASUREMENT OUT_PCAN.Tx_Out.Out_01_Sts.Out_DIAG.Task3 OUT_PCAN.Tx_Out.Out_01_Sts.Out_SENSE.Task3 OUT_PCAN.Tx_Out.Out_01_Sts.Out_TD_DIAG.Task3 OUT_PCAN.Tx_Out.Out_01_Sts.MessageEnable.Task3 OUT_PCAN.Tx_Out.Out_01_Sts.Out_STATUS.Task3 OUT_PCAN.Tx_Out.Out_01_Sts.Out_TD.Task3 /end REF_MEASUREMENT
/end GROUP
/begin GROUP SYSTEM.P_CAN.Out_21_TD_Sts "Out_21_TD_Sts"
 /begin ANNOTATION ANNOTATION_LABEL "Instance" ANNOTATION_ORIGIN "Group" /begin ANNOTATION_TEXT "0" /end ANNOTATION_TEXT /end ANNOTATION
 /begin ANNOTATION ANNOTATION_LABEL "TaskCycleTime" ANNOTATION_ORIGIN "Group" /begin ANNOTATION_TEXT "0" /end ANNOTATION_TEXT /end ANNOTATION
 /begin ANNOTATION ANNOTATION_LABEL "TimeResolution" ANNOTATION_ORIGIN "Group" /begin ANNOTATION_TEXT "0" /end ANNOTATION_TEXT /end ANNOTATION
 /begin REF_MEASUREMENT OUT_PCAN.Tx_Out.Out_21_TD_Sts.Out_SENSE_PULSE.Task3 OUT_PCAN.Tx_Out.Out_21_TD_Sts.Out_SENSE_PULSE_DIAG.Task3 OUT_PCAN.Tx_Out.Out_21_TD_Sts.MessageEnable.Task3 /end REF_MEASUREMENT
/end GROUP
/begin GROUP SYSTEM.P_CAN.DM1_10.Filter "Filter"
 /begin ANNOTATION ANNOTATION_LABEL "Instance" ANNOTATION_ORIGIN "Group" /begin ANNOTATION_TEXT "0" /end ANNOTATION_TEXT /end ANNOTATION
 /begin ANNOTATION ANNOTATION_LABEL "TaskCycleTime" ANNOTATION_ORIGIN "Group" /begin ANNOTATION_TEXT "0" /end ANNOTATION_TEXT /end ANNOTATION
 /begin ANNOTATION ANNOTATION_LABEL "TimeResolution" ANNOTATION_ORIGIN "Group" /begin ANNOTATION_TEXT "0" /end ANNOTATION_TEXT /end ANNOTATION
 /begin REF_MEASUREMENT IN_DM1_10.Filter.boFilter1.Task2 /end REF_MEASUREMENT
/end GROUP
/begin GROUP SYSTEM.P_CAN.DM1_10 "DM1_10"
 /begin ANNOTATION ANNOTATION_LABEL "Instance" ANNOTATION_ORIGIN "Group" /begin ANNOTATION_TEXT "0" /end ANNOTATION_TEXT /end ANNOTATION
 /begin ANNOTATION ANNOTATION_LABEL "TaskCycleTime" ANNOTATION_ORIGIN "Group" /begin ANNOTATION_TEXT "0" /end ANNOTATION_TEXT /end ANNOTATION
 /begin ANNOTATION ANNOTATION_LABEL "TimeResolution" ANNOTATION_ORIGIN "Group" /begin ANNOTATION_TEXT "0" /end ANNOTATION_TEXT /end ANNOTATION
 /begin SUB_GROUP SYSTEM.P_CAN.DM1_10.Filter /end SUB_GROUP
 /begin REF_MEASUREMENT IN_PCAN.DM1_10.MessageState.Task2 IN_PCAN.DM1_10.AmberWarningLamp.Task2 IN_PCAN.DM1_10.AmberWarningLampFlash.Task2 IN_PCAN.DM1_10.MalfunctionIndicatorLamp.Task2 IN_PCAN.DM1_10.MalfunctionIndicatorLampFlash.Task2 IN_PCAN.DM1_10.ProtectLamp.Task2 IN_PCAN.DM1_10.ProtectLampFlash.Task2 IN_PCAN.DM1_10.RedStopLamp.Task2 IN_PCAN.DM1_10.RedStopLampFlash.Task2 OUT_PCAN.DM1_10.MessageEnable.Task2 /end REF_MEASUREMENT
/end GROUP
/begin GROUP SYSTEM.P_CAN.DM1_Tx "DM1_Tx"
 /begin ANNOTATION ANNOTATION_LABEL "Instance" ANNOTATION_ORIGIN "Group" /begin ANNOTATION_TEXT "0" /end ANNOTATION_TEXT /end ANNOTATION
 /begin ANNOTATION ANNOTATION_LABEL "TaskCycleTime" ANNOTATION_ORIGIN "Group" /begin ANNOTATION_TEXT "0" /end ANNOTATION_TEXT /end ANNOTATION
 /begin ANNOTATION ANNOTATION_LABEL "TimeResolution" ANNOTATION_ORIGIN "Group" /begin ANNOTATION_TEXT "0" /end ANNOTATION_TEXT /end ANNOTATION
 /begin REF_MEASUREMENT OUT_PCAN.GenericDM1TxMessage.DeviceEnable.Task2 /end REF_MEASUREMENT
/end GROUP
/begin COMPU_METHOD COMP_DEFAULT "" RAT_FUNC "%11.5" "Increments" COEFFS 0 1 0 0 0 1 /end COMPU_METHOD
/begin COMPU_METHOD IS_BOOLEAN_TRUE "" RAT_FUNC "%11.5" "" COEFFS 0 1 0 0 0 1 /end COMPU_METHOD
/begin COMPU_VTAB ButtonSts_Encoding ". " TAB_VERB 2 0 "ButtonSts_Encoding__Button_released" 1 "ButtonSts_Encoding__Button_pressed" /end COMPU_VTAB
/begin COMPU_VTAB DNR_Position_Selected_Encoding ". " TAB_VERB 2 0 "DNR_Position_Selected_Encoding__NonSelected" 1 "DNR_Position_Selected_Encoding__Selected" /end COMPU_VTAB
/begin COMPU_VTAB DNR_Position_SwitchStatus_Encoding ". " TAB_VERB 4 0 "DNR_Position_SwitchStatus_Encoding__Switch_Position_Valid" 1 "DNR_Position_SwitchStatus_Encoding__2_Contiguous_Switching_Positions_Active" 2 "DNR_Position_SwitchStatus_Encoding__Switch_Defect" 3 "DNR_Position_SwitchStatus_Encoding__Signal_Not_Available" /end COMPU_VTAB
/end MODULE
/end PROJECT
