ASAP2_VERSION 1 7
/begin PROJECT IcPrimeEOL "ManPrime_MBDS_IcPrimeEOL"
/begin HEADER "D:\IC_Prime_Github\IcPrimeEOL" VERSION "8.17.01.01_3441" PROJECT_NO _953887613 /end HEADER
/begin MODULE IcPrimeEOL "D:\IC_Prime_Github\IcPrimeEOL"
/begin IF_DATA XCP
 /begin XCP_ON_CAN 0x0100 /*XCP on CAN version*/ CAN_ID_MASTER 0x98EF21FA /* CMD/STIM */ CAN_ID_SLAVE 0x98EFFA21 /* RES/ERR/EV/SERV/DAQ */ BAUDRATE 500000 /* BAUDRATE */ SAMPLE_POINT 75 /* SAMPLE_POINT */ SAMPLE_RATE SINGLE /* SAMPLE_RATE */ BTL_CYCLES 4 /* BTL_CYCLES */ SJW 1 /* length synchr. segment */
  /begin PROTOCOL_LAYER 0x0100 0x07D0 0x2710 0 0 0 0 0 8 /* kXcpMaxCto */ 8 /* kXcpMaxDto */ BYTE_ORDER_MSB_LAST ADDRESS_GRANULARITY_BYTE OPTIONAL_CMD GET_COMM_MODE_INFO OPTIONAL_CMD UNLOCK OPTIONAL_CMD SET_MTA OPTIONAL_CMD UPLOAD OPTIONAL_CMD SHORT_UPLOAD OPTIONAL_CMD DOWNLOAD OPTIONAL_CMD DOWNLOAD_MAX OPTIONAL_CMD GET_PAG_PROCESSOR_INFO OPTIONAL_CMD SET_DAQ_PTR OPTIONAL_CMD WRITE_DAQ OPTIONAL_CMD SET_DAQ_LIST_MODE OPTIONAL_CMD GET_DAQ_LIST_MODE OPTIONAL_CMD START_STOP_DAQ_LIST OPTIONAL_CMD START_STOP_SYNCH OPTIONAL_CMD GET_DAQ_PROCESSOR_INFO OPTIONAL_CMD GET_DAQ_RESOLUTION_INFO OPTIONAL_CMD GET_DAQ_EVENT_INFO OPTIONAL_CMD FREE_DAQ OPTIONAL_CMD ALLOC_DAQ OPTIONAL_CMD ALLOC_ODT OPTIONAL_CMD ALLOC_ODT_ENTRY COMMUNICATION_MODE_SUPPORTED BLOCK SLAVE 43 0 /end PROTOCOL_LAYER
  /begin DAQ DYNAMIC 0 /* MAX_DAQ */ 2 /* MAX_EVENT_CHANNEL */ 0 /* MIN_DAQ */ OPTIMISATION_TYPE_DEFAULT /* OPTIMISATION_TYPE */ ADDRESS_EXTENSION_FREE /* ADDRESS_EXTENSION */ IDENTIFICATION_FIELD_TYPE_ABSOLUTE /* IDENTIFICATION_FIELD */ GRANULARITY_ODT_ENTRY_SIZE_DAQ_BYTE /* GRANULARITY_ODT_ENTRY_SIZE_DAQ */ 7 /* MAX_ODT_ENTRY_SIZE_DAQ */ OVERLOAD_INDICATION_PID
   /begin STIM GRANULARITY_ODT_ENTRY_SIZE_STIM_BYTE 7 /* MAX_ODT_ENTRY_SIZE_STIM */ /end STIM
   /begin EVENT "IOLOOP_10ms" /* EVENT_CHANNEL_NAME */ "IOLOOP_1" /* EVENT_CHANNEL_SHORT_NAME */ 0 /* EVENT_CHANNEL_NUMBER */ DAQ 1 /* MAX_DAQ_LIST */ 10 /* TIME_CYCLE */ 6 /* TIME_UNIT */ 0 /* PRIORITY */ /end EVENT
   /begin EVENT "IOLOOP_STIM" /* EVENT_CHANNEL_NAME */ "IOLOOP_S" /* EVENT_CHANNEL_SHORT_NAME */ 1 /* EVENT_CHANNEL_NUMBER */ DAQ 1 /* MAX_DAQ_LIST */ 0 /* TIME_CYCLE */ 6 /* TIME_UNIT */ 0 /* PRIORITY */ /end EVENT
  /end DAQ
  /begin PAG 1 /* MAX_SEGMENTS */ FREEZE_SUPPORTED /end PAG
 /end XCP_ON_CAN
/end IF_DATA
/begin IF_DATA VISION DEVICE_SETTING "FlashScript=2" DEVICE_SETTING "UDS_TargetCanID=0x98DA27F9" DEVICE_SETTING "UDS_ToolCanID=0x98DAF927" /end IF_DATA
/begin IF_DATA GENERATOR INFO "Description=Release-AnyCPU, .NET Framework 4.5" INFO "IMSVersion=1.33: DIAG.SW.TOOL.A2LGenerator(BASE)_V03.00.22" INFO "APPVersion=3.0.22.29848" /end IF_DATA
/begin MOD_PAR ""
 /begin MEMORY_SEGMENT NVMPar_ManTruck1 "NVMPar_ManTruck1_" DATA EEPROM INTERN 0x1DAEC 0x05 -1 -1 -1 -1 -1 /end MEMORY_SEGMENT
 /begin MEMORY_SEGMENT NVMPar_EngOnly "NVMPar_EngOnly_" DATA EEPROM INTERN 0x1DAF6 0x01 -1 -1 -1 -1 -1 /end MEMORY_SEGMENT
 /begin MEMORY_SEGMENT Application "Application_" DATA ROM INTERN 0x74000 0x1EC000 -1 -1 -1 -1 -1 /end MEMORY_SEGMENT
 /begin MEMORY_SEGMENT PIFDataset "PIFDataset_" DATA ROM INTERN 0x334000 0x4000 -1 -1 -1 -1 -1 /end MEMORY_SEGMENT
 /begin MEMORY_SEGMENT PIFBSWConsistencyMarker "PIFBSWConsistencyMarker_" DATA ROM INTERN 0x338000 0x60 -1 -1 -1 -1 -1 /end MEMORY_SEGMENT
 SYSTEM_CONSTANT "BOOLEAN_TRUE" "1"
 SYSTEM_CONSTANT "BOOLEAN_FALSE" "0" VERSION "8.17.01.01_3441" ECU_CALIBRATION_OFFSET 0x00 /end MOD_PAR
/begin MOD_COMMON "" BYTE_ORDER MSB_FIRST /end MOD_COMMON
/begin MEASUREMENT OUT_Control.f_CntrlModelHold.Task40ms "" UBYTE IS_BOOLEAN_TRUE 0 0 0 1 ECU_ADDRESS 0x1D2BA READ_WRITE /end MEASUREMENT
/begin MEASUREMENT IN_DigitalInputs.f_TRM15.Task40ms "" UBYTE IS_BOOLEAN_TRUE 0 0 0 1 ECU_ADDRESS 0x1D37C READ_WRITE /end MEASUREMENT
/begin MEASUREMENT IN_DigitalInputs.f_startupScreenActive.Task100ms "" UBYTE IS_BOOLEAN_TRUE 0 0 0 1 ECU_ADDRESS 0x1D1C8 READ_WRITE /end MEASUREMENT
/begin MEASUREMENT IN_DigitalInputs.f_TRM15.Task200ms "" UBYTE IS_BOOLEAN_TRUE 0 0 0 1 ECU_ADDRESS 0x1D0D0 READ_WRITE /end MEASUREMENT
/begin MEASUREMENT OUT_DigitalOutputs.u8_BargraphPwm.Task40ms "ILLU_PWM_TT0 (Pwm of Bargraph leds)" UBYTE COMP_DEFAULT 0 0 0 255 ECU_ADDRESS 0x1D2BB READ_WRITE /end MEASUREMENT
/begin MEASUREMENT OUT_DigitalOutputs.u8_ScalePwm.Task40ms "ILLU_PWM_TT1 (Pwm of  Scale Illumination Leds)" UBYTE COMP_DEFAULT 0 0 0 255 ECU_ADDRESS 0x1D2BC READ_WRITE /end MEASUREMENT
/begin MEASUREMENT OUT_DigitalOutputs.u8_TelltalesPwm.Task40ms "ILLU_PWM_TT2 (Pwm of Telltales Leds)" UBYTE COMP_DEFAULT 0 0 0 255 ECU_ADDRESS 0x1D2BD READ_WRITE /end MEASUREMENT
/begin MEASUREMENT IN_CAN0.f_CAN0busActivityState.Task40ms "" UBYTE IS_BOOLEAN_TRUE 0 0 0 1 ECU_ADDRESS 0x1D432 READ_WRITE /end MEASUREMENT
/begin MEASUREMENT OUT_CAN0.f_CAN0MessageForwardingEnable.Task40ms "" UBYTE IS_BOOLEAN_TRUE 0 0 0 1 ECU_ADDRESS 0x1D308 READ_WRITE /end MEASUREMENT
/begin MEASUREMENT IN_CAN0.RxFrames.VhData50_Menu._State.Task50ms "" UWORD COMP_DEFAULT 0 0 0 65535 ECU_ADDRESS 0x1D280 READ_WRITE /end MEASUREMENT
/begin MEASUREMENT IN_CAN0.RxFrames.VhData50_Menu.DigitalSpeedUnitDt.Task50ms "" UBYTE IS_BOOLEAN_TRUE 0 0 0 1 ECU_ADDRESS 0x1D282 READ_WRITE /end MEASUREMENT
/begin MEASUREMENT IN_CAN0.RxFrames.VhData50_Menu.LanguageDt.Task50ms "" UBYTE COMP_DEFAULT 0 0 0 7 ECU_ADDRESS 0x1D283 READ_WRITE /end MEASUREMENT
/begin MEASUREMENT IN_CAN0.RxFrames.VhData50_Menu._State.Task1000ms "" UWORD COMP_DEFAULT 0 0 0 65535 ECU_ADDRESS 0x1D064 READ_WRITE /end MEASUREMENT
/begin MEASUREMENT IN_CAN0.RxFrames.VhData50_Menu.ConsumptionUnitDt.Task1000ms "" UBYTE COMP_DEFAULT 0 0 0 3 ECU_ADDRESS 0x1D066 READ_WRITE /end MEASUREMENT
/begin MEASUREMENT IN_CAN0.RxFrames.VhData50_Menu.DigitalSpeedUnitDt.Task1000ms "" UBYTE IS_BOOLEAN_TRUE 0 0 0 1 ECU_ADDRESS 0x1D067 READ_WRITE /end MEASUREMENT
/begin MEASUREMENT IN_CAN0.RxFrames.VhData50_Menu.DistanceUnitDt.Task1000ms "" UBYTE IS_BOOLEAN_TRUE 0 0 0 1 ECU_ADDRESS 0x1D068 READ_WRITE /end MEASUREMENT
/begin MEASUREMENT IN_CAN0.RxFrames.VhData50_Menu.PressureUnitDt.Task1000ms "" UBYTE IS_BOOLEAN_TRUE 0 0 0 1 ECU_ADDRESS 0x1D069 READ_WRITE /end MEASUREMENT
/begin MEASUREMENT OUT_CAN0.RxFrames.VhData50_Menu._Ena.Task40ms "" UBYTE IS_BOOLEAN_TRUE 0 0 0 1 ECU_ADDRESS 0x1D2BF READ_WRITE /end MEASUREMENT
/begin MEASUREMENT IN_CAN0.RxFrames.Ctrl50_ScrDA2._State.Task50ms "" UWORD COMP_DEFAULT 0 0 0 65535 ECU_ADDRESS 0x1D284 READ_WRITE /end MEASUREMENT
/begin MEASUREMENT IN_CAN0.RxFrames.Ctrl50_ScrDA2.ICDISScreen_DA_21Ctrl.Task50ms "" UBYTE COMP_DEFAULT 0 0 0 15 ECU_ADDRESS 0x1D286 READ_WRITE /end MEASUREMENT
/begin MEASUREMENT IN_CAN0.RxFrames.Ctrl50_ScrDA2.ICDISScreen_DA_29Ctrl.Task50ms "" UBYTE COMP_DEFAULT 0 0 0 15 ECU_ADDRESS 0x1D287 READ_WRITE /end MEASUREMENT
/begin MEASUREMENT IN_CAN0.RxFrames.Ctrl50_ScrDA2.ICDISScreen_DA_30Ctrl.Task50ms "" UBYTE COMP_DEFAULT 0 0 0 15 ECU_ADDRESS 0x1D288 READ_WRITE /end MEASUREMENT
/begin MEASUREMENT IN_CAN0.RxFrames.Ctrl50_ScrDA2._State.Task100ms "" UWORD COMP_DEFAULT 0 0 0 65535 ECU_ADDRESS 0x1D1CE READ_WRITE /end MEASUREMENT
/begin MEASUREMENT IN_CAN0.RxFrames.Ctrl50_ScrDA2.ICDISScreen_DA_29Ctrl.Task100ms "" UBYTE COMP_DEFAULT 0 0 0 15 ECU_ADDRESS 0x1D1D0 READ_WRITE /end MEASUREMENT
/begin MEASUREMENT IN_CAN0.RxFrames.Ctrl50_ScrDA2.ICDISScreen_DA_30Ctrl.Task100ms "" UBYTE COMP_DEFAULT 0 0 0 15 ECU_ADDRESS 0x1D1D1 READ_WRITE /end MEASUREMENT
/begin MEASUREMENT IN_CAN0.RxFrames.Ctrl50_ScrDA2._State.Task1000ms "" UWORD COMP_DEFAULT 0 0 0 65535 ECU_ADDRESS 0x1D06A READ_WRITE /end MEASUREMENT
/begin MEASUREMENT IN_CAN0.RxFrames.Ctrl50_ScrDA2.ICDISScreen_DA_21Ctrl.Task1000ms "" UBYTE COMP_DEFAULT 0 0 0 15 ECU_ADDRESS 0x1D06C READ_WRITE /end MEASUREMENT
/begin MEASUREMENT OUT_CAN0.RxFrames.Ctrl50_ScrDA2._Ena.Task40ms "" UBYTE IS_BOOLEAN_TRUE 0 0 0 1 ECU_ADDRESS 0x1D2C0 READ_WRITE /end MEASUREMENT
/begin MEASUREMENT IN_CAN0.RxFrames.Ctrl50_ScrDA1._State.Task50ms "" UWORD COMP_DEFAULT 0 0 0 65535 ECU_ADDRESS 0x1D28A READ_WRITE /end MEASUREMENT
/begin MEASUREMENT IN_CAN0.RxFrames.Ctrl50_ScrDA1.ICDISScreen_DA_00Ctrl.Task50ms "" UBYTE COMP_DEFAULT 0 0 0 15 ECU_ADDRESS 0x1D28C READ_WRITE /end MEASUREMENT
/begin MEASUREMENT IN_CAN0.RxFrames.Ctrl50_ScrDA1.ICDISScreen_DA_01Ctrl.Task50ms "" UBYTE COMP_DEFAULT 0 0 0 15 ECU_ADDRESS 0x1D28D READ_WRITE /end MEASUREMENT
/begin MEASUREMENT IN_CAN0.RxFrames.Ctrl50_ScrDA1.ICDISScreen_DA_02Ctrl.Task50ms "" UBYTE COMP_DEFAULT 0 0 0 15 ECU_ADDRESS 0x1D28E READ_WRITE /end MEASUREMENT
/begin MEASUREMENT IN_CAN0.RxFrames.Ctrl50_ScrDA1.ICDISScreen_DA_03Ctrl.Task50ms "" UBYTE COMP_DEFAULT 0 0 0 15 ECU_ADDRESS 0x1D28F READ_WRITE /end MEASUREMENT
/begin MEASUREMENT IN_CAN0.RxFrames.Ctrl50_ScrDA1.ICDISScreen_DA_06Ctrl.Task50ms "" UBYTE COMP_DEFAULT 0 0 0 15 ECU_ADDRESS 0x1D290 READ_WRITE /end MEASUREMENT
/begin MEASUREMENT IN_CAN0.RxFrames.Ctrl50_ScrDA1.ICDISScreen_DA_07Ctrl.Task50ms "" UBYTE COMP_DEFAULT 0 0 0 15 ECU_ADDRESS 0x1D291 READ_WRITE /end MEASUREMENT
/begin MEASUREMENT IN_CAN0.RxFrames.Ctrl50_ScrDA1.ICDISScreen_DA_08Ctrl.Task50ms "" UBYTE COMP_DEFAULT 0 0 0 15 ECU_ADDRESS 0x1D292 READ_WRITE /end MEASUREMENT
/begin MEASUREMENT IN_CAN0.RxFrames.Ctrl50_ScrDA1.ICDISScreen_DA_09Ctrl.Task50ms "" UBYTE COMP_DEFAULT 0 0 0 15 ECU_ADDRESS 0x1D293 READ_WRITE /end MEASUREMENT
/begin MEASUREMENT IN_CAN0.RxFrames.Ctrl50_ScrDA1.ICDISScreen_DA_10Ctrl.Task50ms "" UBYTE COMP_DEFAULT 0 0 0 15 ECU_ADDRESS 0x1D294 READ_WRITE /end MEASUREMENT
/begin MEASUREMENT IN_CAN0.RxFrames.Ctrl50_ScrDA1.ICDISScreen_DA_11Ctrl.Task50ms "" UBYTE COMP_DEFAULT 0 0 0 15 ECU_ADDRESS 0x1D295 READ_WRITE /end MEASUREMENT
/begin MEASUREMENT IN_CAN0.RxFrames.Ctrl50_ScrDA1.ICDISScreen_DA_12Ctrl.Task50ms "" UBYTE COMP_DEFAULT 0 0 0 15 ECU_ADDRESS 0x1D296 READ_WRITE /end MEASUREMENT
/begin MEASUREMENT IN_CAN0.RxFrames.Ctrl50_ScrDA1.ICDISScreen_DA_13Ctrl.Task50ms "" UBYTE COMP_DEFAULT 0 0 0 15 ECU_ADDRESS 0x1D297 READ_WRITE /end MEASUREMENT
/begin MEASUREMENT IN_CAN0.RxFrames.Ctrl50_ScrDA1.ICDISScreen_DA_14Ctrl.Task50ms "" UBYTE COMP_DEFAULT 0 0 0 15 ECU_ADDRESS 0x1D298 READ_WRITE /end MEASUREMENT
/begin MEASUREMENT IN_CAN0.RxFrames.Ctrl50_ScrDA1._State.Task100ms "" UWORD COMP_DEFAULT 0 0 0 65535 ECU_ADDRESS 0x1D1D2 READ_WRITE /end MEASUREMENT
/begin MEASUREMENT IN_CAN0.RxFrames.Ctrl50_ScrDA1.ICDISScreen_DA_10Ctrl.Task100ms "" UBYTE COMP_DEFAULT 0 0 0 15 ECU_ADDRESS 0x1D1D4 READ_WRITE /end MEASUREMENT
/begin MEASUREMENT IN_CAN0.RxFrames.Ctrl50_ScrDA1._State.Task1000ms "" UWORD COMP_DEFAULT 0 0 0 65535 ECU_ADDRESS 0x1D06E READ_WRITE /end MEASUREMENT
/begin MEASUREMENT IN_CAN0.RxFrames.Ctrl50_ScrDA1.ICDISScreen_DA_01Ctrl.Task1000ms "" UBYTE COMP_DEFAULT 0 0 0 15 ECU_ADDRESS 0x1D070 READ_WRITE /end MEASUREMENT
/begin MEASUREMENT IN_CAN0.RxFrames.Ctrl50_ScrDA1.ICDISScreen_DA_02Ctrl.Task1000ms "" UBYTE COMP_DEFAULT 0 0 0 15 ECU_ADDRESS 0x1D071 READ_WRITE /end MEASUREMENT
/begin MEASUREMENT IN_CAN0.RxFrames.Ctrl50_ScrDA1.ICDISScreen_DA_03Ctrl.Task1000ms "" UBYTE COMP_DEFAULT 0 0 0 15 ECU_ADDRESS 0x1D072 READ_WRITE /end MEASUREMENT
/begin MEASUREMENT IN_CAN0.RxFrames.Ctrl50_ScrDA1.ICDISScreen_DA_06Ctrl.Task1000ms "" UBYTE COMP_DEFAULT 0 0 0 15 ECU_ADDRESS 0x1D073 READ_WRITE /end MEASUREMENT
/begin MEASUREMENT IN_CAN0.RxFrames.Ctrl50_ScrDA1.ICDISScreen_DA_11Ctrl.Task1000ms "" UBYTE COMP_DEFAULT 0 0 0 15 ECU_ADDRESS 0x1D074 READ_WRITE /end MEASUREMENT
/begin MEASUREMENT IN_CAN0.RxFrames.Ctrl50_ScrDA1.ICDISScreen_DA_12Ctrl.Task1000ms "" UBYTE COMP_DEFAULT 0 0 0 15 ECU_ADDRESS 0x1D075 READ_WRITE /end MEASUREMENT
/begin MEASUREMENT IN_CAN0.RxFrames.Ctrl50_ScrDA1.ICDISScreen_DA_13Ctrl.Task1000ms "" UBYTE COMP_DEFAULT 0 0 0 15 ECU_ADDRESS 0x1D076 READ_WRITE /end MEASUREMENT
/begin MEASUREMENT IN_CAN0.RxFrames.Ctrl50_ScrDA1.ICDISScreen_DA_14Ctrl.Task1000ms "" UBYTE COMP_DEFAULT 0 0 0 15 ECU_ADDRESS 0x1D077 READ_WRITE /end MEASUREMENT
/begin MEASUREMENT OUT_CAN0.RxFrames.Ctrl50_ScrDA1._Ena.Task40ms "" UBYTE IS_BOOLEAN_TRUE 0 0 0 1 ECU_ADDRESS 0x1D2C1 READ_WRITE /end MEASUREMENT
/begin MEASUREMENT IN_CAN0.RxFrames.Ctrl50_FcnDA2._State.Task50ms "" UWORD COMP_DEFAULT 0 0 0 65535 ECU_ADDRESS 0x1D29A READ_WRITE /end MEASUREMENT
/begin MEASUREMENT IN_CAN0.RxFrames.Ctrl50_FcnDA2.ICDISFcn_DA_21Ctrl.Task50ms "" UBYTE COMP_DEFAULT 0 0 0 127 ECU_ADDRESS 0x1D29C READ_WRITE /end MEASUREMENT
/begin MEASUREMENT IN_CAN0.RxFrames.Ctrl50_FcnDA2.ICDISFcn_DA_29Ctrl.Task50ms "" UBYTE COMP_DEFAULT 0 0 0 127 ECU_ADDRESS 0x1D29D READ_WRITE /end MEASUREMENT
/begin MEASUREMENT IN_CAN0.RxFrames.Ctrl50_FcnDA2.ICDISFcn_DA_30Ctrl.Task50ms "" UBYTE COMP_DEFAULT 0 0 0 127 ECU_ADDRESS 0x1D29E READ_WRITE /end MEASUREMENT
/begin MEASUREMENT IN_CAN0.RxFrames.Ctrl50_FcnDA2._State.Task100ms "" UWORD COMP_DEFAULT 0 0 0 65535 ECU_ADDRESS 0x1D1D6 READ_WRITE /end MEASUREMENT
/begin MEASUREMENT IN_CAN0.RxFrames.Ctrl50_FcnDA2.ICDISFcn_DA_29Ctrl.Task100ms "" UBYTE COMP_DEFAULT 0 0 0 127 ECU_ADDRESS 0x1D1D8 READ_WRITE /end MEASUREMENT
/begin MEASUREMENT IN_CAN0.RxFrames.Ctrl50_FcnDA2.ICDISFcn_DA_30Ctrl.Task100ms "" UBYTE COMP_DEFAULT 0 0 0 127 ECU_ADDRESS 0x1D1D9 READ_WRITE /end MEASUREMENT
/begin MEASUREMENT IN_CAN0.RxFrames.Ctrl50_FcnDA2._State.Task1000ms "" UWORD COMP_DEFAULT 0 0 0 65535 ECU_ADDRESS 0x1D078 READ_WRITE /end MEASUREMENT
/begin MEASUREMENT IN_CAN0.RxFrames.Ctrl50_FcnDA2.ICDISFcn_DA_21Ctrl.Task1000ms "" UBYTE COMP_DEFAULT 0 0 0 127 ECU_ADDRESS 0x1D07A READ_WRITE /end MEASUREMENT
/begin MEASUREMENT OUT_CAN0.RxFrames.Ctrl50_FcnDA2._Ena.Task40ms "" UBYTE IS_BOOLEAN_TRUE 0 0 0 1 ECU_ADDRESS 0x1D2C2 READ_WRITE /end MEASUREMENT
/begin MEASUREMENT IN_CAN0.RxFrames.Ctrl50_FcnDA1._State.Task50ms "" UWORD COMP_DEFAULT 0 0 0 65535 ECU_ADDRESS 0x1D2A0 READ_WRITE /end MEASUREMENT
/begin MEASUREMENT IN_CAN0.RxFrames.Ctrl50_FcnDA1.ICDISFcn_DA_01Ctrl.Task50ms "" UBYTE COMP_DEFAULT 0 0 0 127 ECU_ADDRESS 0x1D2A2 READ_WRITE /end MEASUREMENT
/begin MEASUREMENT IN_CAN0.RxFrames.Ctrl50_FcnDA1.ICDISFcn_DA_02Ctrl.Task50ms "" UBYTE COMP_DEFAULT 0 0 0 127 ECU_ADDRESS 0x1D2A3 READ_WRITE /end MEASUREMENT
/begin MEASUREMENT IN_CAN0.RxFrames.Ctrl50_FcnDA1.ICDISFcn_DA_03Ctrl.Task50ms "" UBYTE COMP_DEFAULT 0 0 0 127 ECU_ADDRESS 0x1D2A4 READ_WRITE /end MEASUREMENT
/begin MEASUREMENT IN_CAN0.RxFrames.Ctrl50_FcnDA1.ICDISFcn_DA_06Ctrl.Task50ms "" UBYTE COMP_DEFAULT 0 0 0 127 ECU_ADDRESS 0x1D2A5 READ_WRITE /end MEASUREMENT
/begin MEASUREMENT IN_CAN0.RxFrames.Ctrl50_FcnDA1._State.Task1000ms "" UWORD COMP_DEFAULT 0 0 0 65535 ECU_ADDRESS 0x1D07C READ_WRITE /end MEASUREMENT
/begin MEASUREMENT IN_CAN0.RxFrames.Ctrl50_FcnDA1.ICDISFcn_DA_01Ctrl.Task1000ms "" UBYTE COMP_DEFAULT 0 0 0 127 ECU_ADDRESS 0x1D07E READ_WRITE /end MEASUREMENT
/begin MEASUREMENT IN_CAN0.RxFrames.Ctrl50_FcnDA1.ICDISFcn_DA_02Ctrl.Task1000ms "" UBYTE COMP_DEFAULT 0 0 0 127 ECU_ADDRESS 0x1D07F READ_WRITE /end MEASUREMENT
/begin MEASUREMENT IN_CAN0.RxFrames.Ctrl50_FcnDA1.ICDISFcn_DA_03Ctrl.Task1000ms "" UBYTE COMP_DEFAULT 0 0 0 127 ECU_ADDRESS 0x1D080 READ_WRITE /end MEASUREMENT
/begin MEASUREMENT IN_CAN0.RxFrames.Ctrl50_FcnDA1.ICDISFcn_DA_06Ctrl.Task1000ms "" UBYTE COMP_DEFAULT 0 0 0 127 ECU_ADDRESS 0x1D081 READ_WRITE /end MEASUREMENT
/begin MEASUREMENT OUT_CAN0.RxFrames.Ctrl50_FcnDA1._Ena.Task40ms "" UBYTE IS_BOOLEAN_TRUE 0 0 0 1 ECU_ADDRESS 0x1D2C3 READ_WRITE /end MEASUREMENT
/begin MEASUREMENT IN_CAN0.RxFrames.Ctrl50_SubView._State.Task50ms "" UWORD COMP_DEFAULT 0 0 0 65535 ECU_ADDRESS 0x1D2A6 READ_WRITE /end MEASUREMENT
/begin MEASUREMENT IN_CAN0.RxFrames.Ctrl50_SubView.ICDISSVCtrl.Task50ms "" UBYTE COMP_DEFAULT 0 0 0 63 ECU_ADDRESS 0x1D2A8 READ_WRITE /end MEASUREMENT
/begin MEASUREMENT OUT_CAN0.RxFrames.Ctrl50_SubView._Ena.Task40ms "" UBYTE IS_BOOLEAN_TRUE 0 0 0 1 ECU_ADDRESS 0x1D2C4 READ_WRITE /end MEASUREMENT
/begin MEASUREMENT IN_CAN0.RxFrames.VhData50_Gauges._State.Task50ms "" UWORD COMP_DEFAULT 0 0 0 65535 ECU_ADDRESS 0x1D2AA READ_WRITE /end MEASUREMENT
/begin MEASUREMENT IN_CAN0.RxFrames.VhData50_Gauges.EngineSpeedDt.Task50ms "" UWORD COMP_DEFAULT 0 0 0 8191 ECU_ADDRESS 0x1D2AC READ_WRITE /end MEASUREMENT
/begin MEASUREMENT IN_CAN0.RxFrames.VhData50_Gauges.ESpdGreenRangeDt.Task50ms "" UBYTE COMP_DEFAULT 0 0 0 31 ECU_ADDRESS 0x1D2AE READ_WRITE /end MEASUREMENT
/begin MEASUREMENT IN_CAN0.RxFrames.VhData50_Gauges.ESpdRedRangeDt.Task50ms "" UBYTE COMP_DEFAULT 0 0 0 31 ECU_ADDRESS 0x1D2AF READ_WRITE /end MEASUREMENT
/begin MEASUREMENT IN_CAN0.RxFrames.VhData50_Gauges.ESpdYellowRangeDt.Task50ms "" UBYTE COMP_DEFAULT 0 0 0 31 ECU_ADDRESS 0x1D2B0 READ_WRITE /end MEASUREMENT
/begin MEASUREMENT IN_CAN0.RxFrames.VhData50_Gauges.VehicleSpeedDt.Task50ms "" UBYTE COMP_DEFAULT 0 0 0 255 ECU_ADDRESS 0x1D2B1 READ_WRITE /end MEASUREMENT
/begin MEASUREMENT IN_CAN0.RxFrames.VhData50_Gauges._State.Task1000ms "" UWORD COMP_DEFAULT 0 0 0 65535 ECU_ADDRESS 0x1D082 READ_WRITE /end MEASUREMENT
/begin MEASUREMENT IN_CAN0.RxFrames.VhData50_Gauges.VehicleSpeedDt.Task1000ms "" UBYTE COMP_DEFAULT 0 0 0 255 ECU_ADDRESS 0x1D084 READ_WRITE /end MEASUREMENT
/begin MEASUREMENT OUT_CAN0.RxFrames.VhData50_Gauges._Ena.Task40ms "" UBYTE IS_BOOLEAN_TRUE 0 0 0 1 ECU_ADDRESS 0x1D2C5 READ_WRITE /end MEASUREMENT
/begin MEASUREMENT IN_CAN0.RxFrames.GRA_UHRe_01._State.Task40ms "" UWORD COMP_DEFAULT 0 0 0 65535 ECU_ADDRESS 0x1D39E READ_WRITE /end MEASUREMENT
/begin MEASUREMENT IN_CAN0.RxFrames.GRA_UHRe_01.UHREbyte1.Task40ms "" UBYTE COMP_DEFAULT 0 0 0 255 ECU_ADDRESS 0x1D3A0 READ_WRITE /end MEASUREMENT
/begin MEASUREMENT IN_CAN0.RxFrames.GRA_UHRe_01.UHREbyte2.Task40ms "" UBYTE COMP_DEFAULT 0 0 0 255 ECU_ADDRESS 0x1D3A1 READ_WRITE /end MEASUREMENT
/begin MEASUREMENT IN_CAN0.RxFrames.GRA_UHRe_01.UHREbyte3.Task40ms "" UBYTE COMP_DEFAULT 0 0 0 255 ECU_ADDRESS 0x1D3A2 READ_WRITE /end MEASUREMENT
/begin MEASUREMENT IN_CAN0.RxFrames.GRA_UHRe_01.UHREbyte4.Task40ms "" UBYTE COMP_DEFAULT 0 0 0 255 ECU_ADDRESS 0x1D3A3 READ_WRITE /end MEASUREMENT
/begin MEASUREMENT IN_CAN0.RxFrames.GRA_UHRe_01.UHREbyte5.Task40ms "" UBYTE COMP_DEFAULT 0 0 0 255 ECU_ADDRESS 0x1D3A4 READ_WRITE /end MEASUREMENT
/begin MEASUREMENT IN_CAN0.RxFrames.GRA_UHRe_01.UHREbyte6.Task40ms "" UBYTE COMP_DEFAULT 0 0 0 255 ECU_ADDRESS 0x1D3A5 READ_WRITE /end MEASUREMENT
/begin MEASUREMENT IN_CAN0.RxFrames.GRA_UHRe_01.UHREbyte7.Task40ms "" UBYTE COMP_DEFAULT 0 0 0 255 ECU_ADDRESS 0x1D3A6 READ_WRITE /end MEASUREMENT
/begin MEASUREMENT IN_CAN0.RxFrames.GRA_UHRe_01.UHREbyte8.Task40ms "" UBYTE COMP_DEFAULT 0 0 0 255 ECU_ADDRESS 0x1D3A7 READ_WRITE /end MEASUREMENT
/begin MEASUREMENT OUT_CAN0.RxFrames.GRA_UHRe_01._Ena.Task40ms "" UBYTE IS_BOOLEAN_TRUE 0 0 0 1 ECU_ADDRESS 0x1D2C6 READ_WRITE /end MEASUREMENT
/begin MEASUREMENT IN_CAN0.RxFrames.GRA_MFLe_01._State.Task40ms "" UWORD COMP_DEFAULT 0 0 0 65535 ECU_ADDRESS 0x1D3A8 READ_WRITE /end MEASUREMENT
/begin MEASUREMENT IN_CAN0.RxFrames.GRA_MFLe_01.MFLEbyte1.Task40ms "" UBYTE COMP_DEFAULT 0 0 0 255 ECU_ADDRESS 0x1D3AA READ_WRITE /end MEASUREMENT
/begin MEASUREMENT IN_CAN0.RxFrames.GRA_MFLe_01.MFLEbyte2.Task40ms "" UBYTE COMP_DEFAULT 0 0 0 255 ECU_ADDRESS 0x1D3AB READ_WRITE /end MEASUREMENT
/begin MEASUREMENT IN_CAN0.RxFrames.GRA_MFLe_01.MFLEbyte3.Task40ms "" UBYTE COMP_DEFAULT 0 0 0 255 ECU_ADDRESS 0x1D3AC READ_WRITE /end MEASUREMENT
/begin MEASUREMENT IN_CAN0.RxFrames.GRA_MFLe_01.MFLEbyte4.Task40ms "" UBYTE COMP_DEFAULT 0 0 0 255 ECU_ADDRESS 0x1D3AD READ_WRITE /end MEASUREMENT
/begin MEASUREMENT IN_CAN0.RxFrames.GRA_MFLe_01.MFLEbyte5.Task40ms "" UBYTE COMP_DEFAULT 0 0 0 255 ECU_ADDRESS 0x1D3AE READ_WRITE /end MEASUREMENT
/begin MEASUREMENT IN_CAN0.RxFrames.GRA_MFLe_01.MFLEbyte6.Task40ms "" UBYTE COMP_DEFAULT 0 0 0 255 ECU_ADDRESS 0x1D3AF READ_WRITE /end MEASUREMENT
/begin MEASUREMENT IN_CAN0.RxFrames.GRA_MFLe_01.MFLEbyte7.Task40ms "" UBYTE COMP_DEFAULT 0 0 0 255 ECU_ADDRESS 0x1D3B0 READ_WRITE /end MEASUREMENT
/begin MEASUREMENT IN_CAN0.RxFrames.GRA_MFLe_01.MFLEbyte8.Task40ms "" UBYTE COMP_DEFAULT 0 0 0 255 ECU_ADDRESS 0x1D3B1 READ_WRITE /end MEASUREMENT
/begin MEASUREMENT OUT_CAN0.RxFrames.GRA_MFLe_01._Ena.Task40ms "" UBYTE IS_BOOLEAN_TRUE 0 0 0 1 ECU_ADDRESS 0x1D2C7 READ_WRITE /end MEASUREMENT
/begin MEASUREMENT IN_CAN0.RxFrames.VhData100_2._State.Task1000ms "" UWORD COMP_DEFAULT 0 0 0 65535 ECU_ADDRESS 0x1D086 READ_WRITE /end MEASUREMENT
/begin MEASUREMENT IN_CAN0.RxFrames.VhData100_2.CoolantTempDt.Task1000ms "" UWORD COMP_DEFAULT 0 0 0 1023 ECU_ADDRESS 0x1D088 READ_WRITE /end MEASUREMENT
/begin MEASUREMENT IN_CAN0.RxFrames.VhData100_2.CoolantTempBargraphDt.Task1000ms "" UBYTE COMP_DEFAULT 0 0 0 255 ECU_ADDRESS 0x1D08A READ_WRITE /end MEASUREMENT
/begin MEASUREMENT OUT_CAN0.RxFrames.VhData100_2._Ena.Task40ms "" UBYTE IS_BOOLEAN_TRUE 0 0 0 1 ECU_ADDRESS 0x1D2C8 READ_WRITE /end MEASUREMENT
/begin MEASUREMENT IN_CAN0.RxFrames.VhData100_1._State.Task1000ms "" UWORD COMP_DEFAULT 0 0 0 65535 ECU_ADDRESS 0x1D08C READ_WRITE /end MEASUREMENT
/begin MEASUREMENT IN_CAN0.RxFrames.VhData100_1.InstantConsumpDt.Task1000ms "" UWORD COMP_DEFAULT 0 0 0 1023 ECU_ADDRESS 0x1D08E READ_WRITE /end MEASUREMENT
/begin MEASUREMENT IN_CAN0.RxFrames.VhData100_1.InstConsumpUnitDt.Task1000ms "" UBYTE COMP_DEFAULT 0 0 0 3 ECU_ADDRESS 0x1D090 READ_WRITE /end MEASUREMENT
/begin MEASUREMENT OUT_CAN0.RxFrames.VhData100_1._Ena.Task40ms "" UBYTE IS_BOOLEAN_TRUE 0 0 0 1 ECU_ADDRESS 0x1D2C9 READ_WRITE /end MEASUREMENT
/begin MEASUREMENT IN_CAN0.RxFrames.VhData100_3._State.Task100ms "" UWORD COMP_DEFAULT 0 0 0 65535 ECU_ADDRESS 0x1D1DA READ_WRITE /end MEASUREMENT
/begin MEASUREMENT IN_CAN0.RxFrames.VhData100_3.GearCurrentIndicationDt.Task100ms "" UBYTE COMP_DEFAULT 0 0 0 127 ECU_ADDRESS 0x1D1DC READ_WRITE /end MEASUREMENT
/begin MEASUREMENT IN_CAN0.RxFrames.VhData100_3.GearModeDt.Task100ms "" UBYTE COMP_DEFAULT 0 0 0 15 ECU_ADDRESS 0x1D1DD READ_WRITE /end MEASUREMENT
/begin MEASUREMENT IN_CAN0.RxFrames.VhData100_3.GearRecommendedGearDt.Task100ms "" UBYTE COMP_DEFAULT 0 0 0 127 ECU_ADDRESS 0x1D1DE READ_WRITE /end MEASUREMENT
/begin MEASUREMENT OUT_CAN0.RxFrames.VhData100_3._Ena.Task40ms "" UBYTE IS_BOOLEAN_TRUE 0 0 0 1 ECU_ADDRESS 0x1D2CA READ_WRITE /end MEASUREMENT
/begin MEASUREMENT IN_CAN0.RxFrames.ICOM1CTRL._State.Task40ms "" UWORD COMP_DEFAULT 0 0 0 65535 ECU_ADDRESS 0x1D3B2 READ_WRITE /end MEASUREMENT
/begin MEASUREMENT IN_CAN0.RxFrames.ICOM1CTRL.ICOMCtrl.Task40ms "" UBYTE COMP_DEFAULT 0 0 0 15 ECU_ADDRESS 0x1D3B4 READ_WRITE /end MEASUREMENT
/begin MEASUREMENT OUT_CAN0.RxFrames.ICOM1CTRL._Ena.Task40ms "" UBYTE IS_BOOLEAN_TRUE 0 0 0 1 ECU_ADDRESS 0x1D2CB READ_WRITE /end MEASUREMENT
/begin MEASUREMENT IN_CAN0.RxFrames.VhData200_1._State.Task50ms "" UWORD COMP_DEFAULT 0 0 0 65535 ECU_ADDRESS 0x1D2B2 READ_WRITE /end MEASUREMENT
/begin MEASUREMENT IN_CAN0.RxFrames.VhData200_1.ICDISBackGlowColorDt.Task50ms "" UBYTE COMP_DEFAULT 0 0 0 7 ECU_ADDRESS 0x1D2B4 READ_WRITE /end MEASUREMENT
/begin MEASUREMENT IN_CAN0.RxFrames.VhData200_1._State.Task200ms "" UWORD COMP_DEFAULT 0 0 0 65535 ECU_ADDRESS 0x1D0D2 READ_WRITE /end MEASUREMENT
/begin MEASUREMENT IN_CAN0.RxFrames.VhData200_1.ICDISDayNightDt.Task200ms "" UBYTE IS_BOOLEAN_TRUE 0 0 0 1 ECU_ADDRESS 0x1D0D4 READ_WRITE /end MEASUREMENT
/begin MEASUREMENT IN_CAN0.RxFrames.VhData200_1._State.Task1000ms "" UWORD COMP_DEFAULT 0 0 0 65535 ECU_ADDRESS 0x1D092 READ_WRITE /end MEASUREMENT
/begin MEASUREMENT IN_CAN0.RxFrames.VhData200_1.OilPressureDt.Task1000ms "" UBYTE COMP_DEFAULT 0 0 0 255 ECU_ADDRESS 0x1D094 READ_WRITE /end MEASUREMENT
/begin MEASUREMENT OUT_CAN0.RxFrames.VhData200_1._Ena.Task40ms "" UBYTE IS_BOOLEAN_TRUE 0 0 0 1 ECU_ADDRESS 0x1D2CC READ_WRITE /end MEASUREMENT
/begin MEASUREMENT IN_CAN0.RxFrames.VhData200_2._State.Task1000ms "" UWORD COMP_DEFAULT 0 0 0 65535 ECU_ADDRESS 0x1D096 READ_WRITE /end MEASUREMENT
/begin MEASUREMENT IN_CAN0.RxFrames.VhData200_2.BrakePressure1Dt.Task1000ms "" UWORD COMP_DEFAULT 0 0 0 65535 ECU_ADDRESS 0x1D098 READ_WRITE /end MEASUREMENT
/begin MEASUREMENT IN_CAN0.RxFrames.VhData200_2.BrakePressure2Dt.Task1000ms "" UWORD COMP_DEFAULT 0 0 0 65535 ECU_ADDRESS 0x1D09A READ_WRITE /end MEASUREMENT
/begin MEASUREMENT IN_CAN0.RxFrames.VhData200_2.BrakePressure3Dt.Task1000ms "" UWORD COMP_DEFAULT 0 0 0 65535 ECU_ADDRESS 0x1D09C READ_WRITE /end MEASUREMENT
/begin MEASUREMENT IN_CAN0.RxFrames.VhData200_2.BrakePressure1BargraphDt.Task1000ms "" UBYTE COMP_DEFAULT 0 0 0 255 ECU_ADDRESS 0x1D09E READ_WRITE /end MEASUREMENT
/begin MEASUREMENT IN_CAN0.RxFrames.VhData200_2.BrakePressure2BargraphDt.Task1000ms "" UBYTE COMP_DEFAULT 0 0 0 255 ECU_ADDRESS 0x1D09F READ_WRITE /end MEASUREMENT
/begin MEASUREMENT IN_CAN0.RxFrames.VhData200_2.BrakePressure3BargraphDt.Task1000ms "" UBYTE COMP_DEFAULT 0 0 0 255 ECU_ADDRESS 0x1D0A0 READ_WRITE /end MEASUREMENT
/begin MEASUREMENT OUT_CAN0.RxFrames.VhData200_2._Ena.Task40ms "" UBYTE IS_BOOLEAN_TRUE 0 0 0 1 ECU_ADDRESS 0x1D2CD READ_WRITE /end MEASUREMENT
/begin MEASUREMENT IN_CAN0.RxFrames.VhData200_VTT8._State.Task40ms "" UWORD COMP_DEFAULT 0 0 0 65535 ECU_ADDRESS 0x1D3B6 READ_WRITE /end MEASUREMENT
/begin MEASUREMENT IN_CAN0.RxFrames.VhData200_VTT8.State_DA_V43Dt.Task40ms "" UBYTE COMP_DEFAULT 0 0 0 3 ECU_ADDRESS 0x1D3B8 READ_WRITE /end MEASUREMENT
/begin MEASUREMENT IN_CAN0.RxFrames.VhData200_VTT8.State_DA_V44Dt.Task40ms "" UBYTE COMP_DEFAULT 0 0 0 3 ECU_ADDRESS 0x1D3B9 READ_WRITE /end MEASUREMENT
/begin MEASUREMENT IN_CAN0.RxFrames.VhData200_VTT8.State_DA_V45Dt.Task40ms "" UBYTE COMP_DEFAULT 0 0 0 3 ECU_ADDRESS 0x1D3BA READ_WRITE /end MEASUREMENT
/begin MEASUREMENT IN_CAN0.RxFrames.VhData200_VTT8.State_DA_V46Dt.Task40ms "" UBYTE COMP_DEFAULT 0 0 0 3 ECU_ADDRESS 0x1D3BB READ_WRITE /end MEASUREMENT
/begin MEASUREMENT IN_CAN0.RxFrames.VhData200_VTT8.State_DA_V47Dt.Task40ms "" UBYTE COMP_DEFAULT 0 0 0 3 ECU_ADDRESS 0x1D3BC READ_WRITE /end MEASUREMENT
/begin MEASUREMENT IN_CAN0.RxFrames.VhData200_VTT8.SymbolID_DA_V43Dt.Task40ms "" UBYTE COMP_DEFAULT 0 0 0 255 ECU_ADDRESS 0x1D3BD READ_WRITE /end MEASUREMENT
/begin MEASUREMENT IN_CAN0.RxFrames.VhData200_VTT8.SymbolID_DA_V44Dt.Task40ms "" UBYTE COMP_DEFAULT 0 0 0 255 ECU_ADDRESS 0x1D3BE READ_WRITE /end MEASUREMENT
/begin MEASUREMENT IN_CAN0.RxFrames.VhData200_VTT8.SymbolID_DA_V45Dt.Task40ms "" UBYTE COMP_DEFAULT 0 0 0 255 ECU_ADDRESS 0x1D3BF READ_WRITE /end MEASUREMENT
/begin MEASUREMENT IN_CAN0.RxFrames.VhData200_VTT8.SymbolID_DA_V46Dt.Task40ms "" UBYTE COMP_DEFAULT 0 0 0 255 ECU_ADDRESS 0x1D3C0 READ_WRITE /end MEASUREMENT
/begin MEASUREMENT IN_CAN0.RxFrames.VhData200_VTT8.SymbolID_DA_V47Dt.Task40ms "" UBYTE COMP_DEFAULT 0 0 0 255 ECU_ADDRESS 0x1D3C1 READ_WRITE /end MEASUREMENT
/begin MEASUREMENT OUT_CAN0.RxFrames.VhData200_VTT8._Ena.Task40ms "" UBYTE IS_BOOLEAN_TRUE 0 0 0 1 ECU_ADDRESS 0x1D2CE READ_WRITE /end MEASUREMENT
/begin MEASUREMENT IN_CAN0.RxFrames.ICILL1CTRL._State.Task40ms "" UWORD COMP_DEFAULT 0 0 0 65535 ECU_ADDRESS 0x1D3C2 READ_WRITE /end MEASUREMENT
/begin MEASUREMENT IN_CAN0.RxFrames.ICILL1CTRL.ICILLBargraphLdLvlCtrl.Task40ms "" UBYTE COMP_DEFAULT 0 0 0 255 ECU_ADDRESS 0x1D3C4 READ_WRITE /end MEASUREMENT
/begin MEASUREMENT IN_CAN0.RxFrames.ICILL1CTRL.ICILLBargraphLdTransCtrl.Task40ms "" UBYTE COMP_DEFAULT 0 0 0 1 ECU_ADDRESS 0x1D3C5 READ_WRITE /end MEASUREMENT
/begin MEASUREMENT IN_CAN0.RxFrames.ICILL1CTRL.ICILLBargraphSclsLvlCtrl.Task40ms "" UBYTE COMP_DEFAULT 0 0 0 255 ECU_ADDRESS 0x1D3C6 READ_WRITE /end MEASUREMENT
/begin MEASUREMENT IN_CAN0.RxFrames.ICILL1CTRL.ICILLBargraphSclsTransCtrl.Task40ms "" UBYTE COMP_DEFAULT 0 0 0 1 ECU_ADDRESS 0x1D3C7 READ_WRITE /end MEASUREMENT
/begin MEASUREMENT IN_CAN0.RxFrames.ICILL1CTRL.ICILLDispLvlCtrl.Task40ms "" UBYTE COMP_DEFAULT 0 0 0 255 ECU_ADDRESS 0x1D3C8 READ_WRITE /end MEASUREMENT
/begin MEASUREMENT IN_CAN0.RxFrames.ICILL1CTRL.ICILLDispTransCtrl.Task40ms "" UBYTE COMP_DEFAULT 0 0 0 1 ECU_ADDRESS 0x1D3C9 READ_WRITE /end MEASUREMENT
/begin MEASUREMENT IN_CAN0.RxFrames.ICILL1CTRL.ICILLTelltaleLvlCtrl.Task40ms "" UBYTE COMP_DEFAULT 0 0 0 255 ECU_ADDRESS 0x1D3CA READ_WRITE /end MEASUREMENT
/begin MEASUREMENT IN_CAN0.RxFrames.ICILL1CTRL.ICILLTelltaleTransCtrl.Task40ms "" UBYTE COMP_DEFAULT 0 0 0 1 ECU_ADDRESS 0x1D3CB READ_WRITE /end MEASUREMENT
/begin MEASUREMENT OUT_CAN0.RxFrames.ICILL1CTRL._Ena.Task40ms "" UBYTE IS_BOOLEAN_TRUE 0 0 0 1 ECU_ADDRESS 0x1D2CF READ_WRITE /end MEASUREMENT
/begin MEASUREMENT IN_CAN0.RxFrames.VhData200_VTT7._State.Task40ms "" UWORD COMP_DEFAULT 0 0 0 65535 ECU_ADDRESS 0x1D3CC READ_WRITE /end MEASUREMENT
/begin MEASUREMENT IN_CAN0.RxFrames.VhData200_VTT7.State_DA_V37Dt.Task40ms "" UBYTE COMP_DEFAULT 0 0 0 3 ECU_ADDRESS 0x1D3CE READ_WRITE /end MEASUREMENT
/begin MEASUREMENT IN_CAN0.RxFrames.VhData200_VTT7.State_DA_V38Dt.Task40ms "" UBYTE COMP_DEFAULT 0 0 0 3 ECU_ADDRESS 0x1D3CF READ_WRITE /end MEASUREMENT
/begin MEASUREMENT IN_CAN0.RxFrames.VhData200_VTT7.State_DA_V39Dt.Task40ms "" UBYTE COMP_DEFAULT 0 0 0 3 ECU_ADDRESS 0x1D3D0 READ_WRITE /end MEASUREMENT
/begin MEASUREMENT IN_CAN0.RxFrames.VhData200_VTT7.State_DA_V40Dt.Task40ms "" UBYTE COMP_DEFAULT 0 0 0 3 ECU_ADDRESS 0x1D3D1 READ_WRITE /end MEASUREMENT
/begin MEASUREMENT IN_CAN0.RxFrames.VhData200_VTT7.State_DA_V41Dt.Task40ms "" UBYTE COMP_DEFAULT 0 0 0 3 ECU_ADDRESS 0x1D3D2 READ_WRITE /end MEASUREMENT
/begin MEASUREMENT IN_CAN0.RxFrames.VhData200_VTT7.State_DA_V42Dt.Task40ms "" UBYTE COMP_DEFAULT 0 0 0 3 ECU_ADDRESS 0x1D3D3 READ_WRITE /end MEASUREMENT
/begin MEASUREMENT IN_CAN0.RxFrames.VhData200_VTT7.SymbolID_DA_V37Dt.Task40ms "" UBYTE COMP_DEFAULT 0 0 0 255 ECU_ADDRESS 0x1D3D4 READ_WRITE /end MEASUREMENT
/begin MEASUREMENT IN_CAN0.RxFrames.VhData200_VTT7.SymbolID_DA_V38Dt.Task40ms "" UBYTE COMP_DEFAULT 0 0 0 255 ECU_ADDRESS 0x1D3D5 READ_WRITE /end MEASUREMENT
/begin MEASUREMENT IN_CAN0.RxFrames.VhData200_VTT7.SymbolID_DA_V39Dt.Task40ms "" UBYTE COMP_DEFAULT 0 0 0 255 ECU_ADDRESS 0x1D3D6 READ_WRITE /end MEASUREMENT
/begin MEASUREMENT IN_CAN0.RxFrames.VhData200_VTT7.SymbolID_DA_V40Dt.Task40ms "" UBYTE COMP_DEFAULT 0 0 0 255 ECU_ADDRESS 0x1D3D7 READ_WRITE /end MEASUREMENT
/begin MEASUREMENT IN_CAN0.RxFrames.VhData200_VTT7.SymbolID_DA_V41Dt.Task40ms "" UBYTE COMP_DEFAULT 0 0 0 255 ECU_ADDRESS 0x1D3D8 READ_WRITE /end MEASUREMENT
/begin MEASUREMENT IN_CAN0.RxFrames.VhData200_VTT7.SymbolID_DA_V42Dt.Task40ms "" UBYTE COMP_DEFAULT 0 0 0 255 ECU_ADDRESS 0x1D3D9 READ_WRITE /end MEASUREMENT
/begin MEASUREMENT OUT_CAN0.RxFrames.VhData200_VTT7._Ena.Task40ms "" UBYTE IS_BOOLEAN_TRUE 0 0 0 1 ECU_ADDRESS 0x1D2D0 READ_WRITE /end MEASUREMENT
/begin MEASUREMENT IN_CAN0.RxFrames.VhData200_VTT6._State.Task40ms "" UWORD COMP_DEFAULT 0 0 0 65535 ECU_ADDRESS 0x1D3DA READ_WRITE /end MEASUREMENT
/begin MEASUREMENT IN_CAN0.RxFrames.VhData200_VTT6.State_DA_V31Dt.Task40ms "" UBYTE COMP_DEFAULT 0 0 0 3 ECU_ADDRESS 0x1D3DC READ_WRITE /end MEASUREMENT
/begin MEASUREMENT IN_CAN0.RxFrames.VhData200_VTT6.State_DA_V32Dt.Task40ms "" UBYTE COMP_DEFAULT 0 0 0 3 ECU_ADDRESS 0x1D3DD READ_WRITE /end MEASUREMENT
/begin MEASUREMENT IN_CAN0.RxFrames.VhData200_VTT6.State_DA_V33Dt.Task40ms "" UBYTE COMP_DEFAULT 0 0 0 3 ECU_ADDRESS 0x1D3DE READ_WRITE /end MEASUREMENT
/begin MEASUREMENT IN_CAN0.RxFrames.VhData200_VTT6.State_DA_V34Dt.Task40ms "" UBYTE COMP_DEFAULT 0 0 0 3 ECU_ADDRESS 0x1D3DF READ_WRITE /end MEASUREMENT
/begin MEASUREMENT IN_CAN0.RxFrames.VhData200_VTT6.State_DA_V35Dt.Task40ms "" UBYTE COMP_DEFAULT 0 0 0 3 ECU_ADDRESS 0x1D3E0 READ_WRITE /end MEASUREMENT
/begin MEASUREMENT IN_CAN0.RxFrames.VhData200_VTT6.State_DA_V36Dt.Task40ms "" UBYTE COMP_DEFAULT 0 0 0 3 ECU_ADDRESS 0x1D3E1 READ_WRITE /end MEASUREMENT
/begin MEASUREMENT IN_CAN0.RxFrames.VhData200_VTT6.SymbolID_DA_V31Dt.Task40ms "" UBYTE COMP_DEFAULT 0 0 0 255 ECU_ADDRESS 0x1D3E2 READ_WRITE /end MEASUREMENT
/begin MEASUREMENT IN_CAN0.RxFrames.VhData200_VTT6.SymbolID_DA_V32Dt.Task40ms "" UBYTE COMP_DEFAULT 0 0 0 255 ECU_ADDRESS 0x1D3E3 READ_WRITE /end MEASUREMENT
/begin MEASUREMENT IN_CAN0.RxFrames.VhData200_VTT6.SymbolID_DA_V33Dt.Task40ms "" UBYTE COMP_DEFAULT 0 0 0 255 ECU_ADDRESS 0x1D3E4 READ_WRITE /end MEASUREMENT
/begin MEASUREMENT IN_CAN0.RxFrames.VhData200_VTT6.SymbolID_DA_V34Dt.Task40ms "" UBYTE COMP_DEFAULT 0 0 0 255 ECU_ADDRESS 0x1D3E5 READ_WRITE /end MEASUREMENT
/begin MEASUREMENT IN_CAN0.RxFrames.VhData200_VTT6.SymbolID_DA_V35Dt.Task40ms "" UBYTE COMP_DEFAULT 0 0 0 255 ECU_ADDRESS 0x1D3E6 READ_WRITE /end MEASUREMENT
/begin MEASUREMENT IN_CAN0.RxFrames.VhData200_VTT6.SymbolID_DA_V36Dt.Task40ms "" UBYTE COMP_DEFAULT 0 0 0 255 ECU_ADDRESS 0x1D3E7 READ_WRITE /end MEASUREMENT
/begin MEASUREMENT OUT_CAN0.RxFrames.VhData200_VTT6._Ena.Task40ms "" UBYTE IS_BOOLEAN_TRUE 0 0 0 1 ECU_ADDRESS 0x1D2D1 READ_WRITE /end MEASUREMENT
/begin MEASUREMENT IN_CAN0.RxFrames.VhData200_VTT5._State.Task40ms "" UWORD COMP_DEFAULT 0 0 0 65535 ECU_ADDRESS 0x1D3E8 READ_WRITE /end MEASUREMENT
/begin MEASUREMENT IN_CAN0.RxFrames.VhData200_VTT5.State_DA_V25Dt.Task40ms "" UBYTE COMP_DEFAULT 0 0 0 3 ECU_ADDRESS 0x1D3EA READ_WRITE /end MEASUREMENT
/begin MEASUREMENT IN_CAN0.RxFrames.VhData200_VTT5.State_DA_V26Dt.Task40ms "" UBYTE COMP_DEFAULT 0 0 0 3 ECU_ADDRESS 0x1D3EB READ_WRITE /end MEASUREMENT
/begin MEASUREMENT IN_CAN0.RxFrames.VhData200_VTT5.State_DA_V27Dt.Task40ms "" UBYTE COMP_DEFAULT 0 0 0 3 ECU_ADDRESS 0x1D3EC READ_WRITE /end MEASUREMENT
/begin MEASUREMENT IN_CAN0.RxFrames.VhData200_VTT5.State_DA_V28Dt.Task40ms "" UBYTE COMP_DEFAULT 0 0 0 3 ECU_ADDRESS 0x1D3ED READ_WRITE /end MEASUREMENT
/begin MEASUREMENT IN_CAN0.RxFrames.VhData200_VTT5.State_DA_V29Dt.Task40ms "" UBYTE COMP_DEFAULT 0 0 0 3 ECU_ADDRESS 0x1D3EE READ_WRITE /end MEASUREMENT
/begin MEASUREMENT IN_CAN0.RxFrames.VhData200_VTT5.State_DA_V30Dt.Task40ms "" UBYTE COMP_DEFAULT 0 0 0 3 ECU_ADDRESS 0x1D3EF READ_WRITE /end MEASUREMENT
/begin MEASUREMENT IN_CAN0.RxFrames.VhData200_VTT5.SymbolID_DA_V25Dt.Task40ms "" UBYTE COMP_DEFAULT 0 0 0 255 ECU_ADDRESS 0x1D3F0 READ_WRITE /end MEASUREMENT
/begin MEASUREMENT IN_CAN0.RxFrames.VhData200_VTT5.SymbolID_DA_V26Dt.Task40ms "" UBYTE COMP_DEFAULT 0 0 0 255 ECU_ADDRESS 0x1D3F1 READ_WRITE /end MEASUREMENT
/begin MEASUREMENT IN_CAN0.RxFrames.VhData200_VTT5.SymbolID_DA_V27Dt.Task40ms "" UBYTE COMP_DEFAULT 0 0 0 255 ECU_ADDRESS 0x1D3F2 READ_WRITE /end MEASUREMENT
/begin MEASUREMENT IN_CAN0.RxFrames.VhData200_VTT5.SymbolID_DA_V28Dt.Task40ms "" UBYTE COMP_DEFAULT 0 0 0 255 ECU_ADDRESS 0x1D3F3 READ_WRITE /end MEASUREMENT
/begin MEASUREMENT IN_CAN0.RxFrames.VhData200_VTT5.SymbolID_DA_V29Dt.Task40ms "" UBYTE COMP_DEFAULT 0 0 0 255 ECU_ADDRESS 0x1D3F4 READ_WRITE /end MEASUREMENT
/begin MEASUREMENT IN_CAN0.RxFrames.VhData200_VTT5.SymbolID_DA_V30Dt.Task40ms "" UBYTE COMP_DEFAULT 0 0 0 255 ECU_ADDRESS 0x1D3F5 READ_WRITE /end MEASUREMENT
/begin MEASUREMENT OUT_CAN0.RxFrames.VhData200_VTT5._Ena.Task40ms "" UBYTE IS_BOOLEAN_TRUE 0 0 0 1 ECU_ADDRESS 0x1D2D2 READ_WRITE /end MEASUREMENT
/begin MEASUREMENT IN_CAN0.RxFrames.VhData200_VTT4._State.Task40ms "" UWORD COMP_DEFAULT 0 0 0 65535 ECU_ADDRESS 0x1D3F6 READ_WRITE /end MEASUREMENT
/begin MEASUREMENT IN_CAN0.RxFrames.VhData200_VTT4.State_DA_V19Dt.Task40ms "" UBYTE COMP_DEFAULT 0 0 0 3 ECU_ADDRESS 0x1D3F8 READ_WRITE /end MEASUREMENT
/begin MEASUREMENT IN_CAN0.RxFrames.VhData200_VTT4.State_DA_V20Dt.Task40ms "" UBYTE COMP_DEFAULT 0 0 0 3 ECU_ADDRESS 0x1D3F9 READ_WRITE /end MEASUREMENT
/begin MEASUREMENT IN_CAN0.RxFrames.VhData200_VTT4.State_DA_V21Dt.Task40ms "" UBYTE COMP_DEFAULT 0 0 0 3 ECU_ADDRESS 0x1D3FA READ_WRITE /end MEASUREMENT
/begin MEASUREMENT IN_CAN0.RxFrames.VhData200_VTT4.State_DA_V22Dt.Task40ms "" UBYTE COMP_DEFAULT 0 0 0 3 ECU_ADDRESS 0x1D3FB READ_WRITE /end MEASUREMENT
/begin MEASUREMENT IN_CAN0.RxFrames.VhData200_VTT4.State_DA_V23Dt.Task40ms "" UBYTE COMP_DEFAULT 0 0 0 3 ECU_ADDRESS 0x1D3FC READ_WRITE /end MEASUREMENT
/begin MEASUREMENT IN_CAN0.RxFrames.VhData200_VTT4.State_DA_V24Dt.Task40ms "" UBYTE COMP_DEFAULT 0 0 0 3 ECU_ADDRESS 0x1D3FD READ_WRITE /end MEASUREMENT
/begin MEASUREMENT IN_CAN0.RxFrames.VhData200_VTT4.SymbolID_DA_V19Dt.Task40ms "" UBYTE COMP_DEFAULT 0 0 0 255 ECU_ADDRESS 0x1D3FE READ_WRITE /end MEASUREMENT
/begin MEASUREMENT IN_CAN0.RxFrames.VhData200_VTT4.SymbolID_DA_V20Dt.Task40ms "" UBYTE COMP_DEFAULT 0 0 0 255 ECU_ADDRESS 0x1D3FF READ_WRITE /end MEASUREMENT
/begin MEASUREMENT IN_CAN0.RxFrames.VhData200_VTT4.SymbolID_DA_V21Dt.Task40ms "" UBYTE COMP_DEFAULT 0 0 0 255 ECU_ADDRESS 0x1D400 READ_WRITE /end MEASUREMENT
/begin MEASUREMENT IN_CAN0.RxFrames.VhData200_VTT4.SymbolID_DA_V22Dt.Task40ms "" UBYTE COMP_DEFAULT 0 0 0 255 ECU_ADDRESS 0x1D401 READ_WRITE /end MEASUREMENT
/begin MEASUREMENT IN_CAN0.RxFrames.VhData200_VTT4.SymbolID_DA_V23Dt.Task40ms "" UBYTE COMP_DEFAULT 0 0 0 255 ECU_ADDRESS 0x1D402 READ_WRITE /end MEASUREMENT
/begin MEASUREMENT IN_CAN0.RxFrames.VhData200_VTT4.SymbolID_DA_V24Dt.Task40ms "" UBYTE COMP_DEFAULT 0 0 0 255 ECU_ADDRESS 0x1D403 READ_WRITE /end MEASUREMENT
/begin MEASUREMENT OUT_CAN0.RxFrames.VhData200_VTT4._Ena.Task40ms "" UBYTE IS_BOOLEAN_TRUE 0 0 0 1 ECU_ADDRESS 0x1D2D3 READ_WRITE /end MEASUREMENT
/begin MEASUREMENT IN_CAN0.RxFrames.VhData200_VTT3._State.Task40ms "" UWORD COMP_DEFAULT 0 0 0 65535 ECU_ADDRESS 0x1D404 READ_WRITE /end MEASUREMENT
/begin MEASUREMENT IN_CAN0.RxFrames.VhData200_VTT3.State_DA_V13Dt.Task40ms "" UBYTE COMP_DEFAULT 0 0 0 3 ECU_ADDRESS 0x1D406 READ_WRITE /end MEASUREMENT
/begin MEASUREMENT IN_CAN0.RxFrames.VhData200_VTT3.State_DA_V14Dt.Task40ms "" UBYTE COMP_DEFAULT 0 0 0 3 ECU_ADDRESS 0x1D407 READ_WRITE /end MEASUREMENT
/begin MEASUREMENT IN_CAN0.RxFrames.VhData200_VTT3.State_DA_V15Dt.Task40ms "" UBYTE COMP_DEFAULT 0 0 0 3 ECU_ADDRESS 0x1D408 READ_WRITE /end MEASUREMENT
/begin MEASUREMENT IN_CAN0.RxFrames.VhData200_VTT3.State_DA_V16Dt.Task40ms "" UBYTE COMP_DEFAULT 0 0 0 3 ECU_ADDRESS 0x1D409 READ_WRITE /end MEASUREMENT
/begin MEASUREMENT IN_CAN0.RxFrames.VhData200_VTT3.State_DA_V17Dt.Task40ms "" UBYTE COMP_DEFAULT 0 0 0 3 ECU_ADDRESS 0x1D40A READ_WRITE /end MEASUREMENT
/begin MEASUREMENT IN_CAN0.RxFrames.VhData200_VTT3.State_DA_V18Dt.Task40ms "" UBYTE COMP_DEFAULT 0 0 0 3 ECU_ADDRESS 0x1D40B READ_WRITE /end MEASUREMENT
/begin MEASUREMENT IN_CAN0.RxFrames.VhData200_VTT3.SymbolID_DA_V13Dt.Task40ms "" UBYTE COMP_DEFAULT 0 0 0 255 ECU_ADDRESS 0x1D40C READ_WRITE /end MEASUREMENT
/begin MEASUREMENT IN_CAN0.RxFrames.VhData200_VTT3.SymbolID_DA_V14Dt.Task40ms "" UBYTE COMP_DEFAULT 0 0 0 255 ECU_ADDRESS 0x1D40D READ_WRITE /end MEASUREMENT
/begin MEASUREMENT IN_CAN0.RxFrames.VhData200_VTT3.SymbolID_DA_V15Dt.Task40ms "" UBYTE COMP_DEFAULT 0 0 0 255 ECU_ADDRESS 0x1D40E READ_WRITE /end MEASUREMENT
/begin MEASUREMENT IN_CAN0.RxFrames.VhData200_VTT3.SymbolID_DA_V16Dt.Task40ms "" UBYTE COMP_DEFAULT 0 0 0 255 ECU_ADDRESS 0x1D40F READ_WRITE /end MEASUREMENT
/begin MEASUREMENT IN_CAN0.RxFrames.VhData200_VTT3.SymbolID_DA_V17Dt.Task40ms "" UBYTE COMP_DEFAULT 0 0 0 255 ECU_ADDRESS 0x1D410 READ_WRITE /end MEASUREMENT
/begin MEASUREMENT IN_CAN0.RxFrames.VhData200_VTT3.SymbolID_DA_V18Dt.Task40ms "" UBYTE COMP_DEFAULT 0 0 0 255 ECU_ADDRESS 0x1D411 READ_WRITE /end MEASUREMENT
/begin MEASUREMENT OUT_CAN0.RxFrames.VhData200_VTT3._Ena.Task40ms "" UBYTE IS_BOOLEAN_TRUE 0 0 0 1 ECU_ADDRESS 0x1D2D4 READ_WRITE /end MEASUREMENT
/begin MEASUREMENT IN_CAN0.RxFrames.VhData200_VTT2._State.Task40ms "" UWORD COMP_DEFAULT 0 0 0 65535 ECU_ADDRESS 0x1D412 READ_WRITE /end MEASUREMENT
/begin MEASUREMENT IN_CAN0.RxFrames.VhData200_VTT2.State_DA_V07Dt.Task40ms "" UBYTE COMP_DEFAULT 0 0 0 3 ECU_ADDRESS 0x1D414 READ_WRITE /end MEASUREMENT
/begin MEASUREMENT IN_CAN0.RxFrames.VhData200_VTT2.State_DA_V08Dt.Task40ms "" UBYTE COMP_DEFAULT 0 0 0 3 ECU_ADDRESS 0x1D415 READ_WRITE /end MEASUREMENT
/begin MEASUREMENT IN_CAN0.RxFrames.VhData200_VTT2.State_DA_V09Dt.Task40ms "" UBYTE COMP_DEFAULT 0 0 0 3 ECU_ADDRESS 0x1D416 READ_WRITE /end MEASUREMENT
/begin MEASUREMENT IN_CAN0.RxFrames.VhData200_VTT2.State_DA_V10Dt.Task40ms "" UBYTE COMP_DEFAULT 0 0 0 3 ECU_ADDRESS 0x1D417 READ_WRITE /end MEASUREMENT
/begin MEASUREMENT IN_CAN0.RxFrames.VhData200_VTT2.State_DA_V11Dt.Task40ms "" UBYTE COMP_DEFAULT 0 0 0 3 ECU_ADDRESS 0x1D418 READ_WRITE /end MEASUREMENT
/begin MEASUREMENT IN_CAN0.RxFrames.VhData200_VTT2.State_DA_V12Dt.Task40ms "" UBYTE COMP_DEFAULT 0 0 0 3 ECU_ADDRESS 0x1D419 READ_WRITE /end MEASUREMENT
/begin MEASUREMENT IN_CAN0.RxFrames.VhData200_VTT2.SymbolID_DA_V07Dt.Task40ms "" UBYTE COMP_DEFAULT 0 0 0 255 ECU_ADDRESS 0x1D41A READ_WRITE /end MEASUREMENT
/begin MEASUREMENT IN_CAN0.RxFrames.VhData200_VTT2.SymbolID_DA_V08Dt.Task40ms "" UBYTE COMP_DEFAULT 0 0 0 255 ECU_ADDRESS 0x1D41B READ_WRITE /end MEASUREMENT
/begin MEASUREMENT IN_CAN0.RxFrames.VhData200_VTT2.SymbolID_DA_V09Dt.Task40ms "" UBYTE COMP_DEFAULT 0 0 0 255 ECU_ADDRESS 0x1D41C READ_WRITE /end MEASUREMENT
/begin MEASUREMENT IN_CAN0.RxFrames.VhData200_VTT2.SymbolID_DA_V10Dt.Task40ms "" UBYTE COMP_DEFAULT 0 0 0 255 ECU_ADDRESS 0x1D41D READ_WRITE /end MEASUREMENT
/begin MEASUREMENT IN_CAN0.RxFrames.VhData200_VTT2.SymbolID_DA_V11Dt.Task40ms "" UBYTE COMP_DEFAULT 0 0 0 255 ECU_ADDRESS 0x1D41E READ_WRITE /end MEASUREMENT
/begin MEASUREMENT IN_CAN0.RxFrames.VhData200_VTT2.SymbolID_DA_V12Dt.Task40ms "" UBYTE COMP_DEFAULT 0 0 0 255 ECU_ADDRESS 0x1D41F READ_WRITE /end MEASUREMENT
/begin MEASUREMENT OUT_CAN0.RxFrames.VhData200_VTT2._Ena.Task40ms "" UBYTE IS_BOOLEAN_TRUE 0 0 0 1 ECU_ADDRESS 0x1D2D5 READ_WRITE /end MEASUREMENT
/begin MEASUREMENT IN_CAN0.RxFrames.VhData200_VTT1._State.Task40ms "" UWORD COMP_DEFAULT 0 0 0 65535 ECU_ADDRESS 0x1D420 READ_WRITE /end MEASUREMENT
/begin MEASUREMENT IN_CAN0.RxFrames.VhData200_VTT1.State_DA_V01Dt.Task40ms "" UBYTE COMP_DEFAULT 0 0 0 3 ECU_ADDRESS 0x1D422 READ_WRITE /end MEASUREMENT
/begin MEASUREMENT IN_CAN0.RxFrames.VhData200_VTT1.State_DA_V02Dt.Task40ms "" UBYTE COMP_DEFAULT 0 0 0 3 ECU_ADDRESS 0x1D423 READ_WRITE /end MEASUREMENT
/begin MEASUREMENT IN_CAN0.RxFrames.VhData200_VTT1.State_DA_V03Dt.Task40ms "" UBYTE COMP_DEFAULT 0 0 0 3 ECU_ADDRESS 0x1D424 READ_WRITE /end MEASUREMENT
/begin MEASUREMENT IN_CAN0.RxFrames.VhData200_VTT1.State_DA_V04Dt.Task40ms "" UBYTE COMP_DEFAULT 0 0 0 3 ECU_ADDRESS 0x1D425 READ_WRITE /end MEASUREMENT
/begin MEASUREMENT IN_CAN0.RxFrames.VhData200_VTT1.State_DA_V05Dt.Task40ms "" UBYTE COMP_DEFAULT 0 0 0 3 ECU_ADDRESS 0x1D426 READ_WRITE /end MEASUREMENT
/begin MEASUREMENT IN_CAN0.RxFrames.VhData200_VTT1.State_DA_V06Dt.Task40ms "" UBYTE COMP_DEFAULT 0 0 0 3 ECU_ADDRESS 0x1D427 READ_WRITE /end MEASUREMENT
/begin MEASUREMENT IN_CAN0.RxFrames.VhData200_VTT1.SymbolID_DA_V01Dt.Task40ms "" UBYTE COMP_DEFAULT 0 0 0 255 ECU_ADDRESS 0x1D428 READ_WRITE /end MEASUREMENT
/begin MEASUREMENT IN_CAN0.RxFrames.VhData200_VTT1.SymbolID_DA_V02Dt.Task40ms "" UBYTE COMP_DEFAULT 0 0 0 255 ECU_ADDRESS 0x1D429 READ_WRITE /end MEASUREMENT
/begin MEASUREMENT IN_CAN0.RxFrames.VhData200_VTT1.SymbolID_DA_V03Dt.Task40ms "" UBYTE COMP_DEFAULT 0 0 0 255 ECU_ADDRESS 0x1D42A READ_WRITE /end MEASUREMENT
/begin MEASUREMENT IN_CAN0.RxFrames.VhData200_VTT1.SymbolID_DA_V04Dt.Task40ms "" UBYTE COMP_DEFAULT 0 0 0 255 ECU_ADDRESS 0x1D42B READ_WRITE /end MEASUREMENT
/begin MEASUREMENT IN_CAN0.RxFrames.VhData200_VTT1.SymbolID_DA_V05Dt.Task40ms "" UBYTE COMP_DEFAULT 0 0 0 255 ECU_ADDRESS 0x1D42C READ_WRITE /end MEASUREMENT
/begin MEASUREMENT IN_CAN0.RxFrames.VhData200_VTT1.SymbolID_DA_V06Dt.Task40ms "" UBYTE COMP_DEFAULT 0 0 0 255 ECU_ADDRESS 0x1D42D READ_WRITE /end MEASUREMENT
/begin MEASUREMENT OUT_CAN0.RxFrames.VhData200_VTT1._Ena.Task40ms "" UBYTE IS_BOOLEAN_TRUE 0 0 0 1 ECU_ADDRESS 0x1D2D6 READ_WRITE /end MEASUREMENT
/begin MEASUREMENT IN_CAN0.RxFrames.VhData200_3._State.Task100ms "" UWORD COMP_DEFAULT 0 0 0 65535 ECU_ADDRESS 0x1D1E0 READ_WRITE /end MEASUREMENT
/begin MEASUREMENT IN_CAN0.RxFrames.VhData200_3.NotificationLeftTextDt.Task100ms "" UWORD COMP_DEFAULT 0 0 0 2047 ECU_ADDRESS 0x1D1E2 READ_WRITE /end MEASUREMENT
/begin MEASUREMENT IN_CAN0.RxFrames.VhData200_3.NotificationRightTextDt.Task100ms "" UWORD COMP_DEFAULT 0 0 0 2047 ECU_ADDRESS 0x1D1E4 READ_WRITE /end MEASUREMENT
/begin MEASUREMENT IN_CAN0.RxFrames.VhData200_3.NotificationLeftColorDt.Task100ms "" UBYTE COMP_DEFAULT 0 0 0 3 ECU_ADDRESS 0x1D1E6 READ_WRITE /end MEASUREMENT
/begin MEASUREMENT IN_CAN0.RxFrames.VhData200_3.NotificationLeftStopSymbolDt.Task100ms "" UBYTE IS_BOOLEAN_TRUE 0 0 0 1 ECU_ADDRESS 0x1D1E7 READ_WRITE /end MEASUREMENT
/begin MEASUREMENT IN_CAN0.RxFrames.VhData200_3.NotificationLeftSymbolDt.Task100ms "" UBYTE COMP_DEFAULT 0 0 0 127 ECU_ADDRESS 0x1D1E8 READ_WRITE /end MEASUREMENT
/begin MEASUREMENT IN_CAN0.RxFrames.VhData200_3.NotificationRightColorDt.Task100ms "" UBYTE COMP_DEFAULT 0 0 0 3 ECU_ADDRESS 0x1D1E9 READ_WRITE /end MEASUREMENT
/begin MEASUREMENT IN_CAN0.RxFrames.VhData200_3.NotificationRightStopSymbolDt.Task100ms "" UBYTE IS_BOOLEAN_TRUE 0 0 0 1 ECU_ADDRESS 0x1D1EA READ_WRITE /end MEASUREMENT
/begin MEASUREMENT IN_CAN0.RxFrames.VhData200_3.NotificationRightSymbolDt.Task100ms "" UBYTE COMP_DEFAULT 0 0 0 127 ECU_ADDRESS 0x1D1EB READ_WRITE /end MEASUREMENT
/begin MEASUREMENT OUT_CAN0.RxFrames.VhData200_3._Ena.Task40ms "" UBYTE IS_BOOLEAN_TRUE 0 0 0 1 ECU_ADDRESS 0x1D2D7 READ_WRITE /end MEASUREMENT
/begin MEASUREMENT IN_CAN0.RxFrames.VhData500._State.Task1000ms "" UWORD COMP_DEFAULT 0 0 0 65535 ECU_ADDRESS 0x1D0A2 READ_WRITE /end MEASUREMENT
/begin MEASUREMENT IN_CAN0.RxFrames.VhData500.AvgConsumpDt.Task1000ms "" UWORD COMP_DEFAULT 0 0 0 1023 ECU_ADDRESS 0x1D0A4 READ_WRITE /end MEASUREMENT
/begin MEASUREMENT IN_CAN0.RxFrames.VhData500.FuelLitersDt.Task1000ms "" UWORD COMP_DEFAULT 0 0 0 1023 ECU_ADDRESS 0x1D0A6 READ_WRITE /end MEASUREMENT
/begin MEASUREMENT IN_CAN0.RxFrames.VhData500.OilLevelBargraphDt.Task1000ms "" UBYTE COMP_DEFAULT 0 0 0 255 ECU_ADDRESS 0x1D0A8 READ_WRITE /end MEASUREMENT
/begin MEASUREMENT IN_CAN0.RxFrames.VhData500.OilLevelDt.Task1000ms "" UBYTE COMP_DEFAULT 0 0 0 127 ECU_ADDRESS 0x1D0A9 READ_WRITE /end MEASUREMENT
/begin MEASUREMENT OUT_CAN0.RxFrames.VhData500._Ena.Task40ms "" UBYTE IS_BOOLEAN_TRUE 0 0 0 1 ECU_ADDRESS 0x1D2D8 READ_WRITE /end MEASUREMENT
/begin MEASUREMENT IN_CAN0.RxFrames.VhData52_Diagnostic._State.Task1000ms "" UWORD COMP_DEFAULT 0 0 0 65535 ECU_ADDRESS 0x1D0AA READ_WRITE /end MEASUREMENT
/begin MEASUREMENT IN_CAN0.RxFrames.VhData52_Diagnostic.DiagnosticSPNDt.Task1000ms "" UWORD COMP_DEFAULT 0 0 0 65535 ECU_ADDRESS 0x1D0AC READ_WRITE /end MEASUREMENT
/begin MEASUREMENT IN_CAN0.RxFrames.VhData52_Diagnostic.DiagnosticTextIDDt.Task1000ms "" UWORD COMP_DEFAULT 0 0 0 2047 ECU_ADDRESS 0x1D0AE READ_WRITE /end MEASUREMENT
/begin MEASUREMENT IN_CAN0.RxFrames.VhData52_Diagnostic.DiagnosticCurrentFailureDt.Task1000ms "" UBYTE COMP_DEFAULT 0 0 0 31 ECU_ADDRESS 0x1D0B0 READ_WRITE /end MEASUREMENT
/begin MEASUREMENT IN_CAN0.RxFrames.VhData52_Diagnostic.DiagnosticFMIDt.Task1000ms "" UBYTE COMP_DEFAULT 0 0 0 127 ECU_ADDRESS 0x1D0B1 READ_WRITE /end MEASUREMENT
/begin MEASUREMENT IN_CAN0.RxFrames.VhData52_Diagnostic.DiagnosticNumberFailuresDt.Task1000ms "" UBYTE COMP_DEFAULT 0 0 0 31 ECU_ADDRESS 0x1D0B2 READ_WRITE /end MEASUREMENT
/begin MEASUREMENT OUT_CAN0.RxFrames.VhData52_Diagnostic._Ena.Task40ms "" UBYTE IS_BOOLEAN_TRUE 0 0 0 1 ECU_ADDRESS 0x1D2D9 READ_WRITE /end MEASUREMENT
/begin MEASUREMENT IN_CAN0.RxFrames.VhData1000_1.TotalOdometerDt.Task1000ms "" ULONG COMP_DEFAULT 0 0 0 16777215 ECU_ADDRESS 0x1D0B4 READ_WRITE /end MEASUREMENT
/begin MEASUREMENT IN_CAN0.RxFrames.VhData1000_1.TripmeterDt.Task1000ms "" ULONG COMP_DEFAULT 0 0 0 131071 ECU_ADDRESS 0x1D0B8 READ_WRITE /end MEASUREMENT
/begin MEASUREMENT IN_CAN0.RxFrames.VhData1000_1._State.Task1000ms "" UWORD COMP_DEFAULT 0 0 0 65535 ECU_ADDRESS 0x1D0BC READ_WRITE /end MEASUREMENT
/begin MEASUREMENT OUT_CAN0.RxFrames.VhData1000_1._Ena.Task40ms "" UBYTE IS_BOOLEAN_TRUE 0 0 0 1 ECU_ADDRESS 0x1D2DA READ_WRITE /end MEASUREMENT
/begin MEASUREMENT IN_CAN0.RxFrames.ICHMI1CTRL._State.Task40ms "" UWORD COMP_DEFAULT 0 0 0 65535 ECU_ADDRESS 0x1D37E READ_WRITE /end MEASUREMENT
/begin MEASUREMENT IN_CAN0.RxFrames.ICHMI1CTRL.ICBargraphLftBhvrCtrl.Task40ms "" UBYTE COMP_DEFAULT 0 0 0 3 ECU_ADDRESS 0x1D380 READ_WRITE /end MEASUREMENT
/begin MEASUREMENT IN_CAN0.RxFrames.ICHMI1CTRL.ICBargraphLftLed1Ctrl.Task40ms "" UBYTE IS_BOOLEAN_TRUE 0 0 0 1 ECU_ADDRESS 0x1D381 READ_WRITE /end MEASUREMENT
/begin MEASUREMENT IN_CAN0.RxFrames.ICHMI1CTRL.ICBargraphLftLed2Ctrl.Task40ms "" UBYTE IS_BOOLEAN_TRUE 0 0 0 1 ECU_ADDRESS 0x1D382 READ_WRITE /end MEASUREMENT
/begin MEASUREMENT IN_CAN0.RxFrames.ICHMI1CTRL.ICBargraphLftLed3Ctrl.Task40ms "" UBYTE IS_BOOLEAN_TRUE 0 0 0 1 ECU_ADDRESS 0x1D383 READ_WRITE /end MEASUREMENT
/begin MEASUREMENT IN_CAN0.RxFrames.ICHMI1CTRL.ICBargraphLftLed4Ctrl.Task40ms "" UBYTE IS_BOOLEAN_TRUE 0 0 0 1 ECU_ADDRESS 0x1D384 READ_WRITE /end MEASUREMENT
/begin MEASUREMENT IN_CAN0.RxFrames.ICHMI1CTRL.ICBargraphLftLed5Ctrl.Task40ms "" UBYTE IS_BOOLEAN_TRUE 0 0 0 1 ECU_ADDRESS 0x1D385 READ_WRITE /end MEASUREMENT
/begin MEASUREMENT IN_CAN0.RxFrames.ICHMI1CTRL.ICBargraphLftLed6Ctrl.Task40ms "" UBYTE IS_BOOLEAN_TRUE 0 0 0 1 ECU_ADDRESS 0x1D386 READ_WRITE /end MEASUREMENT
/begin MEASUREMENT IN_CAN0.RxFrames.ICHMI1CTRL.ICBargraphLftLed7Ctrl.Task40ms "" UBYTE IS_BOOLEAN_TRUE 0 0 0 1 ECU_ADDRESS 0x1D387 READ_WRITE /end MEASUREMENT
/begin MEASUREMENT IN_CAN0.RxFrames.ICHMI1CTRL.ICBargraphLftLed8Ctrl.Task40ms "" UBYTE IS_BOOLEAN_TRUE 0 0 0 1 ECU_ADDRESS 0x1D388 READ_WRITE /end MEASUREMENT
/begin MEASUREMENT IN_CAN0.RxFrames.ICHMI1CTRL.ICBargraphRghtBhvrCtrl.Task40ms "" UBYTE COMP_DEFAULT 0 0 0 3 ECU_ADDRESS 0x1D389 READ_WRITE /end MEASUREMENT
/begin MEASUREMENT IN_CAN0.RxFrames.ICHMI1CTRL.ICBargraphRghtLed1Ctrl.Task40ms "" UBYTE IS_BOOLEAN_TRUE 0 0 0 1 ECU_ADDRESS 0x1D38A READ_WRITE /end MEASUREMENT
/begin MEASUREMENT IN_CAN0.RxFrames.ICHMI1CTRL.ICBargraphRghtLed2Ctrl.Task40ms "" UBYTE IS_BOOLEAN_TRUE 0 0 0 1 ECU_ADDRESS 0x1D38B READ_WRITE /end MEASUREMENT
/begin MEASUREMENT IN_CAN0.RxFrames.ICHMI1CTRL.ICBargraphRghtLed3Ctrl.Task40ms "" UBYTE IS_BOOLEAN_TRUE 0 0 0 1 ECU_ADDRESS 0x1D38C READ_WRITE /end MEASUREMENT
/begin MEASUREMENT IN_CAN0.RxFrames.ICHMI1CTRL.ICBargraphRghtLed4Ctrl.Task40ms "" UBYTE IS_BOOLEAN_TRUE 0 0 0 1 ECU_ADDRESS 0x1D38D READ_WRITE /end MEASUREMENT
/begin MEASUREMENT IN_CAN0.RxFrames.ICHMI1CTRL.ICBargraphRghtLed5Ctrl.Task40ms "" UBYTE IS_BOOLEAN_TRUE 0 0 0 1 ECU_ADDRESS 0x1D38E READ_WRITE /end MEASUREMENT
/begin MEASUREMENT IN_CAN0.RxFrames.ICHMI1CTRL.ICBargraphRghtLed6Ctrl.Task40ms "" UBYTE IS_BOOLEAN_TRUE 0 0 0 1 ECU_ADDRESS 0x1D38F READ_WRITE /end MEASUREMENT
/begin MEASUREMENT IN_CAN0.RxFrames.ICHMI1CTRL.ICBargraphRghtLed7Ctrl.Task40ms "" UBYTE IS_BOOLEAN_TRUE 0 0 0 1 ECU_ADDRESS 0x1D390 READ_WRITE /end MEASUREMENT
/begin MEASUREMENT IN_CAN0.RxFrames.ICHMI1CTRL.ICBargraphRghtLed8Ctrl.Task40ms "" UBYTE IS_BOOLEAN_TRUE 0 0 0 1 ECU_ADDRESS 0x1D391 READ_WRITE /end MEASUREMENT
/begin MEASUREMENT IN_CAN0.RxFrames.ICHMI1CTRL.ICTelltale01Ctrl.Task40ms "" UBYTE COMP_DEFAULT 0 0 0 3 ECU_ADDRESS 0x1D392 READ_WRITE /end MEASUREMENT
/begin MEASUREMENT IN_CAN0.RxFrames.ICHMI1CTRL.ICTelltale02Ctrl.Task40ms "" UBYTE COMP_DEFAULT 0 0 0 3 ECU_ADDRESS 0x1D393 READ_WRITE /end MEASUREMENT
/begin MEASUREMENT IN_CAN0.RxFrames.ICHMI1CTRL.ICTelltale03Ctrl.Task40ms "" UBYTE COMP_DEFAULT 0 0 0 3 ECU_ADDRESS 0x1D394 READ_WRITE /end MEASUREMENT
/begin MEASUREMENT IN_CAN0.RxFrames.ICHMI1CTRL.ICTelltale04Ctrl.Task40ms "" UBYTE COMP_DEFAULT 0 0 0 3 ECU_ADDRESS 0x1D395 READ_WRITE /end MEASUREMENT
/begin MEASUREMENT IN_CAN0.RxFrames.ICHMI1CTRL.ICTelltale05Ctrl.Task40ms "" UBYTE COMP_DEFAULT 0 0 0 3 ECU_ADDRESS 0x1D396 READ_WRITE /end MEASUREMENT
/begin MEASUREMENT IN_CAN0.RxFrames.ICHMI1CTRL.ICTelltale06Ctrl.Task40ms "" UBYTE COMP_DEFAULT 0 0 0 3 ECU_ADDRESS 0x1D397 READ_WRITE /end MEASUREMENT
/begin MEASUREMENT IN_CAN0.RxFrames.ICHMI1CTRL.ICTelltale07Ctrl.Task40ms "" UBYTE COMP_DEFAULT 0 0 0 3 ECU_ADDRESS 0x1D398 READ_WRITE /end MEASUREMENT
/begin MEASUREMENT IN_CAN0.RxFrames.ICHMI1CTRL.ICTelltale08Ctrl.Task40ms "" UBYTE COMP_DEFAULT 0 0 0 3 ECU_ADDRESS 0x1D399 READ_WRITE /end MEASUREMENT
/begin MEASUREMENT IN_CAN0.RxFrames.ICHMI1CTRL.ICTelltale09Ctrl.Task40ms "" UBYTE COMP_DEFAULT 0 0 0 3 ECU_ADDRESS 0x1D39A READ_WRITE /end MEASUREMENT
/begin MEASUREMENT IN_CAN0.RxFrames.ICHMI1CTRL.ICTelltale10Ctrl.Task40ms "" UBYTE COMP_DEFAULT 0 0 0 3 ECU_ADDRESS 0x1D39B READ_WRITE /end MEASUREMENT
/begin MEASUREMENT IN_CAN0.RxFrames.ICHMI1CTRL.ICTelltale11Ctrl.Task40ms "" UBYTE COMP_DEFAULT 0 0 0 3 ECU_ADDRESS 0x1D39C READ_WRITE /end MEASUREMENT
/begin MEASUREMENT IN_CAN0.RxFrames.ICHMI1CTRL.ICTelltale12Ctrl.Task40ms "" UBYTE COMP_DEFAULT 0 0 0 255 ECU_ADDRESS 0x1D39D READ_WRITE /end MEASUREMENT
/begin MEASUREMENT IN_CAN0.RxFrames.ICHMI1CTRL._State.Task100ms "" UWORD COMP_DEFAULT 0 0 0 65535 ECU_ADDRESS 0x1D1CA READ_WRITE /end MEASUREMENT
/begin MEASUREMENT IN_CAN0.RxFrames.ICHMI1CTRL.ICSoundCtrl.Task100ms "" UBYTE COMP_DEFAULT 0 0 0 63 ECU_ADDRESS 0x1D1CC READ_WRITE /end MEASUREMENT
/begin MEASUREMENT IN_CAN0.RxFrames.ICHMI1CTRL.ICSoundVlmCtrl.Task100ms "" UBYTE COMP_DEFAULT 0 0 0 255 ECU_ADDRESS 0x1D1CD READ_WRITE /end MEASUREMENT
/begin MEASUREMENT OUT_CAN0.RxFrames.ICHMI1CTRL._Ena.Task40ms "" UBYTE IS_BOOLEAN_TRUE 0 0 0 1 ECU_ADDRESS 0x1D2BE READ_WRITE /end MEASUREMENT
/begin MEASUREMENT OUT_CAN0.TxFrames.ICDATA1._Cycle.Task40ms "" UWORD COMP_DEFAULT 0 0 0 65535 ECU_ADDRESS 0x1D2E2 READ_WRITE /end MEASUREMENT
/begin MEASUREMENT OUT_CAN0.TxFrames.ICDATA1._Ena.Task40ms "" UBYTE IS_BOOLEAN_TRUE 0 0 0 1 ECU_ADDRESS 0x1D2E4 READ_WRITE /end MEASUREMENT
/begin MEASUREMENT OUT_CAN0.TxFrames.ICDATA1.ICIntPhotosensorSts.Task200ms "" UWORD COMP_DEFAULT 0 0 0 1023 ECU_ADDRESS 0x1D0E0 READ_WRITE /end MEASUREMENT
/begin MEASUREMENT OUT_CAN0.TxFrames.ICDATA1.ICInTr15Sts.Task200ms "" UBYTE COMP_DEFAULT 0 0 0 255 ECU_ADDRESS 0x1D0E2 READ_WRITE /end MEASUREMENT
/begin MEASUREMENT OUT_CAN0.TxFrames.ICOM1STS._Cycle.Task40ms "" UWORD COMP_DEFAULT 0 0 0 65535 ECU_ADDRESS 0x1D2E6 READ_WRITE /end MEASUREMENT
/begin MEASUREMENT OUT_CAN0.TxFrames.ICOM1STS._Ena.Task40ms "" UBYTE IS_BOOLEAN_TRUE 0 0 0 1 ECU_ADDRESS 0x1D2E8 READ_WRITE /end MEASUREMENT
/begin MEASUREMENT OUT_CAN0.TxFrames.ICOM1STS.ICOMSts.Task40ms "" UBYTE COMP_DEFAULT 0 0 0 15 ECU_ADDRESS 0x1D2E9 READ_WRITE /end MEASUREMENT
/begin MEASUREMENT OUT_CAN0.TxFrames.ICOM1STS.ICPMSts.Task40ms "" UBYTE COMP_DEFAULT 0 0 0 15 ECU_ADDRESS 0x1D2EA READ_WRITE /end MEASUREMENT
/begin MEASUREMENT OUT_CAN0.TxFrames.ICOM1STS.ICAssetSts.Task100ms "" UBYTE COMP_DEFAULT 0 0 0 15 ECU_ADDRESS 0x1D0E8 READ_WRITE /end MEASUREMENT
/begin MEASUREMENT OUT_CAN0.TxFrames.ICOM1STS.ICSoundSts.Task100ms "" UBYTE COMP_DEFAULT 0 0 0 15 ECU_ADDRESS 0x1D0E9 READ_WRITE /end MEASUREMENT
/begin MEASUREMENT IN_CAN0.TxFrames.MFLs_01._State.Task40ms "" UWORD COMP_DEFAULT 0 0 0 65535 ECU_ADDRESS 0x1D42E READ_WRITE /end MEASUREMENT
/begin MEASUREMENT OUT_CAN0.TxFrames.MFLs_01._Cycle.Task40ms "" UWORD COMP_DEFAULT 0 0 0 65535 ECU_ADDRESS 0x1D2EC READ_WRITE /end MEASUREMENT
/begin MEASUREMENT OUT_CAN0.TxFrames.MFLs_01._Ena.Task40ms "" UBYTE IS_BOOLEAN_TRUE 0 0 0 1 ECU_ADDRESS 0x1D2EE READ_WRITE /end MEASUREMENT
/begin MEASUREMENT OUT_CAN0.TxFrames.MFLs_01.MFLSbyte1.Task40ms "" UBYTE COMP_DEFAULT 0 0 0 255 ECU_ADDRESS 0x1D2EF READ_WRITE /end MEASUREMENT
/begin MEASUREMENT OUT_CAN0.TxFrames.MFLs_01.MFLSbyte2.Task40ms "" UBYTE COMP_DEFAULT 0 0 0 255 ECU_ADDRESS 0x1D2F0 READ_WRITE /end MEASUREMENT
/begin MEASUREMENT OUT_CAN0.TxFrames.MFLs_01.MFLSbyte3.Task40ms "" UBYTE COMP_DEFAULT 0 0 0 255 ECU_ADDRESS 0x1D2F1 READ_WRITE /end MEASUREMENT
/begin MEASUREMENT OUT_CAN0.TxFrames.MFLs_01.MFLSbyte4.Task40ms "" UBYTE COMP_DEFAULT 0 0 0 255 ECU_ADDRESS 0x1D2F2 READ_WRITE /end MEASUREMENT
/begin MEASUREMENT OUT_CAN0.TxFrames.MFLs_01.MFLSbyte5.Task40ms "" UBYTE COMP_DEFAULT 0 0 0 255 ECU_ADDRESS 0x1D2F3 READ_WRITE /end MEASUREMENT
/begin MEASUREMENT OUT_CAN0.TxFrames.MFLs_01.MFLSbyte6.Task40ms "" UBYTE COMP_DEFAULT 0 0 0 255 ECU_ADDRESS 0x1D2F4 READ_WRITE /end MEASUREMENT
/begin MEASUREMENT OUT_CAN0.TxFrames.MFLs_01.MFLSbyte7.Task40ms "" UBYTE COMP_DEFAULT 0 0 0 255 ECU_ADDRESS 0x1D2F5 READ_WRITE /end MEASUREMENT
/begin MEASUREMENT OUT_CAN0.TxFrames.MFLs_01.MFLSbyte8.Task40ms "" UBYTE COMP_DEFAULT 0 0 0 255 ECU_ADDRESS 0x1D2F6 READ_WRITE /end MEASUREMENT
/begin MEASUREMENT IN_CAN0.TxFrames.GRA_ACCs_01._State.Task40ms "" UWORD COMP_DEFAULT 0 0 0 65535 ECU_ADDRESS 0x1D430 READ_WRITE /end MEASUREMENT
/begin MEASUREMENT OUT_CAN0.TxFrames.GRA_ACCs_01._Cycle.Task40ms "" UWORD COMP_DEFAULT 0 0 0 65535 ECU_ADDRESS 0x1D2F8 READ_WRITE /end MEASUREMENT
/begin MEASUREMENT OUT_CAN0.TxFrames.GRA_ACCs_01._Ena.Task40ms "" UBYTE IS_BOOLEAN_TRUE 0 0 0 1 ECU_ADDRESS 0x1D2FA READ_WRITE /end MEASUREMENT
/begin MEASUREMENT OUT_CAN0.TxFrames.GRA_ACCs_01.GRAbyte1.Task40ms "" UBYTE COMP_DEFAULT 0 0 0 255 ECU_ADDRESS 0x1D2FB READ_WRITE /end MEASUREMENT
/begin MEASUREMENT OUT_CAN0.TxFrames.GRA_ACCs_01.GRAbyte2.Task40ms "" UBYTE COMP_DEFAULT 0 0 0 255 ECU_ADDRESS 0x1D2FC READ_WRITE /end MEASUREMENT
/begin MEASUREMENT OUT_CAN0.TxFrames.GRA_ACCs_01.GRAbyte3.Task40ms "" UBYTE COMP_DEFAULT 0 0 0 255 ECU_ADDRESS 0x1D2FD READ_WRITE /end MEASUREMENT
/begin MEASUREMENT OUT_CAN0.TxFrames.GRA_ACCs_01.GRAbyte4.Task40ms "" UBYTE COMP_DEFAULT 0 0 0 255 ECU_ADDRESS 0x1D2FE READ_WRITE /end MEASUREMENT
/begin MEASUREMENT OUT_CAN0.TxFrames.GRA_ACCs_01.GRAbyte5.Task40ms "" UBYTE COMP_DEFAULT 0 0 0 255 ECU_ADDRESS 0x1D2FF READ_WRITE /end MEASUREMENT
/begin MEASUREMENT OUT_CAN0.TxFrames.GRA_ACCs_01.GRAbyte6.Task40ms "" UBYTE COMP_DEFAULT 0 0 0 255 ECU_ADDRESS 0x1D300 READ_WRITE /end MEASUREMENT
/begin MEASUREMENT OUT_CAN0.TxFrames.GRA_ACCs_01.GRAbyte7.Task40ms "" UBYTE COMP_DEFAULT 0 0 0 255 ECU_ADDRESS 0x1D301 READ_WRITE /end MEASUREMENT
/begin MEASUREMENT OUT_CAN0.TxFrames.GRA_ACCs_01.GRAbyte8.Task40ms "" UBYTE COMP_DEFAULT 0 0 0 255 ECU_ADDRESS 0x1D302 READ_WRITE /end MEASUREMENT
/begin MEASUREMENT OUT_CAN0.TxFrames.Sts50._Cycle.Task40ms "" UWORD COMP_DEFAULT 0 0 0 65535 ECU_ADDRESS 0x1D304 READ_WRITE /end MEASUREMENT
/begin MEASUREMENT OUT_CAN0.TxFrames.Sts50._Ena.Task40ms "" UBYTE IS_BOOLEAN_TRUE 0 0 0 1 ECU_ADDRESS 0x1D306 READ_WRITE /end MEASUREMENT
/begin MEASUREMENT OUT_CAN0.TxFrames.Sts50.ICDISSVSts.Task50ms "" UBYTE COMP_DEFAULT 0 0 0 63 ECU_ADDRESS 0x1D208 READ_WRITE /end MEASUREMENT
/begin MEASUREMENT OUT_CAN0.TxFrames.Sts50.ICDISSVTransitionSts.Task50ms "" UBYTE IS_BOOLEAN_TRUE 0 0 0 1 ECU_ADDRESS 0x1D209 READ_WRITE /end MEASUREMENT
/begin MEASUREMENT OUT_CAN0.TxFrames.ICILL1STS._Cycle.Task40ms "" UWORD COMP_DEFAULT 0 0 0 65535 ECU_ADDRESS 0x1D2DC READ_WRITE /end MEASUREMENT
/begin MEASUREMENT OUT_CAN0.TxFrames.ICILL1STS._Ena.Task40ms "" UBYTE IS_BOOLEAN_TRUE 0 0 0 1 ECU_ADDRESS 0x1D2DE READ_WRITE /end MEASUREMENT
/begin MEASUREMENT OUT_CAN0.TxFrames.ICILL1STS.ICILLDispPWMSts.Task40ms "" UBYTE COMP_DEFAULT 0 0 0 255 ECU_ADDRESS 0x1D2DF READ_WRITE /end MEASUREMENT
/begin MEASUREMENT OUT_CAN0.TxFrames.ICILL1STS.ICILLDispSts.Task40ms "" UBYTE COMP_DEFAULT 0 0 0 3 ECU_ADDRESS 0x1D2E0 READ_WRITE /end MEASUREMENT
/begin MEASUREMENT OUT_CAN0.TxFrames.ICILL1STS.ICILLDispTempSnsrSts.Task40ms "" UBYTE COMP_DEFAULT 0 0 0 255 ECU_ADDRESS 0x1D2E1 READ_WRITE /end MEASUREMENT
/begin MEASUREMENT OUT_CAN1.f_CAN1MessageForwardingEnable.Task40ms "" UBYTE IS_BOOLEAN_TRUE 0 0 0 1 ECU_ADDRESS 0x1D312 READ_WRITE /end MEASUREMENT
/begin MEASUREMENT OUT_CAN1.GatewayHRLFC.Enable_TxCAN0.Task40ms "" UBYTE IS_BOOLEAN_TRUE 0 0 0 1 ECU_ADDRESS 0x1D30C READ_WRITE /end MEASUREMENT
/begin MEASUREMENT OUT_CAN1.GatewayHRLFC.MessageEnable.Task40ms "" UBYTE IS_BOOLEAN_TRUE 0 0 0 1 ECU_ADDRESS 0x1D30D READ_WRITE /end MEASUREMENT
/begin MEASUREMENT OUT_CAN1.GatewayDPFC1.Enable_TxCAN0.Task40ms "" UBYTE IS_BOOLEAN_TRUE 0 0 0 1 ECU_ADDRESS 0x1D30E READ_WRITE /end MEASUREMENT
/begin MEASUREMENT OUT_CAN1.GatewayDPFC1.MessageEnable.Task40ms "" UBYTE IS_BOOLEAN_TRUE 0 0 0 1 ECU_ADDRESS 0x1D30F READ_WRITE /end MEASUREMENT
/begin MEASUREMENT OUT_CAN1.GatewaySCR.Enable_TxCAN0.Task40ms "" UBYTE IS_BOOLEAN_TRUE 0 0 0 1 ECU_ADDRESS 0x1D310 READ_WRITE /end MEASUREMENT
/begin MEASUREMENT OUT_CAN1.GatewaySCR.MessageEnable.Task40ms "" UBYTE IS_BOOLEAN_TRUE 0 0 0 1 ECU_ADDRESS 0x1D311 READ_WRITE /end MEASUREMENT
/begin MEASUREMENT OUT_CAN1.GatewayA1SCRDSI1.Enable_TxCAN0.Task40ms "" UBYTE IS_BOOLEAN_TRUE 0 0 0 1 ECU_ADDRESS 0x1D30A READ_WRITE /end MEASUREMENT
/begin MEASUREMENT OUT_CAN1.GatewayA1SCRDSI1.MessageEnable.Task40ms "" UBYTE IS_BOOLEAN_TRUE 0 0 0 1 ECU_ADDRESS 0x1D30B READ_WRITE /end MEASUREMENT
/begin MEASUREMENT OUT_HMI.HMICtrlGeneral2.SceneEnBackground.Task50ms "" UBYTE IS_BOOLEAN_TRUE 0 0 0 1 ECU_ADDRESS 0x1D20B READ_WRITE /end MEASUREMENT
/begin MEASUREMENT OUT_HMI.HMICtrlGeneral2.SceneEnBrakePressureLeft.Task50ms "" UBYTE IS_BOOLEAN_TRUE 0 0 0 1 ECU_ADDRESS 0x1D20C READ_WRITE /end MEASUREMENT
/begin MEASUREMENT OUT_HMI.HMICtrlGeneral2.SceneEnBrakePressureRight.Task50ms "" UBYTE IS_BOOLEAN_TRUE 0 0 0 1 ECU_ADDRESS 0x1D20D READ_WRITE /end MEASUREMENT
/begin MEASUREMENT OUT_HMI.HMICtrlGeneral2.SceneEnConsumptionLeft.Task50ms "" UBYTE IS_BOOLEAN_TRUE 0 0 0 1 ECU_ADDRESS 0x1D20E READ_WRITE /end MEASUREMENT
/begin MEASUREMENT OUT_HMI.HMICtrlGeneral2.SceneEnConsumptionRight.Task50ms "" UBYTE IS_BOOLEAN_TRUE 0 0 0 1 ECU_ADDRESS 0x1D20F READ_WRITE /end MEASUREMENT
/begin MEASUREMENT OUT_HMI.HMICtrlGeneral2.SceneEnCoolantTemperature.Task50ms "" UBYTE IS_BOOLEAN_TRUE 0 0 0 1 ECU_ADDRESS 0x1D210 READ_WRITE /end MEASUREMENT
/begin MEASUREMENT OUT_HMI.HMICtrlGeneral2.SceneEnDiagnostics.Task50ms "" UBYTE IS_BOOLEAN_TRUE 0 0 0 1 ECU_ADDRESS 0x1D211 READ_WRITE /end MEASUREMENT
/begin MEASUREMENT OUT_HMI.HMICtrlGeneral2.SceneEnDigitalSpdBottom.Task50ms "" UBYTE IS_BOOLEAN_TRUE 0 0 0 1 ECU_ADDRESS 0x1D212 READ_WRITE /end MEASUREMENT
/begin MEASUREMENT OUT_HMI.HMICtrlGeneral2.SceneEnDigitalSpdCenterMenu.Task50ms "" UBYTE IS_BOOLEAN_TRUE 0 0 0 1 ECU_ADDRESS 0x1D213 READ_WRITE /end MEASUREMENT
/begin MEASUREMENT OUT_HMI.HMICtrlGeneral2.SceneEnDigitalSpdSingleGauge.Task50ms "" UBYTE IS_BOOLEAN_TRUE 0 0 0 1 ECU_ADDRESS 0x1D214 READ_WRITE /end MEASUREMENT
/begin MEASUREMENT OUT_HMI.HMICtrlGeneral2.SceneEnDigitalSpdTop.Task50ms "" UBYTE IS_BOOLEAN_TRUE 0 0 0 1 ECU_ADDRESS 0x1D215 READ_WRITE /end MEASUREMENT
/begin MEASUREMENT OUT_HMI.HMICtrlGeneral2.SceneEnDriversGrade.Task50ms "" UBYTE IS_BOOLEAN_TRUE 0 0 0 1 ECU_ADDRESS 0x1D216 READ_WRITE /end MEASUREMENT
/begin MEASUREMENT OUT_HMI.HMICtrlGeneral2.SceneEnGear.Task50ms "" UBYTE IS_BOOLEAN_TRUE 0 0 0 1 ECU_ADDRESS 0x1D217 READ_WRITE /end MEASUREMENT
/begin MEASUREMENT OUT_HMI.HMICtrlGeneral2.SceneEnNotificationLeft.Task50ms "" UBYTE IS_BOOLEAN_TRUE 0 0 0 1 ECU_ADDRESS 0x1D218 READ_WRITE /end MEASUREMENT
/begin MEASUREMENT OUT_HMI.HMICtrlGeneral2.SceneEnNotificationRight.Task50ms "" UBYTE IS_BOOLEAN_TRUE 0 0 0 1 ECU_ADDRESS 0x1D219 READ_WRITE /end MEASUREMENT
/begin MEASUREMENT OUT_HMI.HMICtrlGeneral2.SceneEnOdometer.Task50ms "" UBYTE IS_BOOLEAN_TRUE 0 0 0 1 ECU_ADDRESS 0x1D21A READ_WRITE /end MEASUREMENT
/begin MEASUREMENT OUT_HMI.HMICtrlGeneral2.SceneEnOilInfoLeft.Task50ms "" UBYTE IS_BOOLEAN_TRUE 0 0 0 1 ECU_ADDRESS 0x1D21B READ_WRITE /end MEASUREMENT
/begin MEASUREMENT OUT_HMI.HMICtrlGeneral2.SceneEnOilInfoRight.Task50ms "" UBYTE IS_BOOLEAN_TRUE 0 0 0 1 ECU_ADDRESS 0x1D21C READ_WRITE /end MEASUREMENT
/begin MEASUREMENT OUT_HMI.HMICtrlGeneral2.SceneEnRpmGaugeBig.Task50ms "" UBYTE IS_BOOLEAN_TRUE 0 0 0 1 ECU_ADDRESS 0x1D21D READ_WRITE /end MEASUREMENT
/begin MEASUREMENT OUT_HMI.HMICtrlGeneral2.SceneEnRpmGaugeSmall.Task50ms "" UBYTE IS_BOOLEAN_TRUE 0 0 0 1 ECU_ADDRESS 0x1D21E READ_WRITE /end MEASUREMENT
/begin MEASUREMENT OUT_HMI.HMICtrlGeneral2.SceneEnTripmeter.Task50ms "" UBYTE IS_BOOLEAN_TRUE 0 0 0 1 ECU_ADDRESS 0x1D21F READ_WRITE /end MEASUREMENT
/begin MEASUREMENT OUT_HMI.HMICtrlGeneral2.SceneEnVhSpdGauge.Task50ms "" UBYTE IS_BOOLEAN_TRUE 0 0 0 1 ECU_ADDRESS 0x1D220 READ_WRITE /end MEASUREMENT
/begin MEASUREMENT OUT_HMI.HMICtrlGeneral2.SceneEnVTTG1.Task50ms "" UBYTE IS_BOOLEAN_TRUE 0 0 0 1 ECU_ADDRESS 0x1D221 READ_WRITE /end MEASUREMENT
/begin MEASUREMENT OUT_HMI.HMICtrlGeneral2.SceneEnVTTG2.Task50ms "" UBYTE IS_BOOLEAN_TRUE 0 0 0 1 ECU_ADDRESS 0x1D222 READ_WRITE /end MEASUREMENT
/begin MEASUREMENT OUT_HMI.HMICtrlGeneral2.SceneEnVTTG3.Task50ms "" UBYTE IS_BOOLEAN_TRUE 0 0 0 1 ECU_ADDRESS 0x1D223 READ_WRITE /end MEASUREMENT
/begin MEASUREMENT OUT_HMI.HMICtrlGeneral2.SceneEnVTTG4.Task50ms "" UBYTE IS_BOOLEAN_TRUE 0 0 0 1 ECU_ADDRESS 0x1D224 READ_WRITE /end MEASUREMENT
/begin MEASUREMENT OUT_HMI.HMICtrlGeneral2.SceneEnVTTG5.Task50ms "" UBYTE IS_BOOLEAN_TRUE 0 0 0 1 ECU_ADDRESS 0x1D225 READ_WRITE /end MEASUREMENT
/begin MEASUREMENT OUT_HMI.HMICtrlGeneral2.SceneEnVTTG6.Task50ms "" UBYTE IS_BOOLEAN_TRUE 0 0 0 1 ECU_ADDRESS 0x1D226 READ_WRITE /end MEASUREMENT
/begin MEASUREMENT OUT_HMI.HMICtrlGeneral2._Ena.Task100ms "" UBYTE IS_BOOLEAN_TRUE 0 0 0 1 ECU_ADDRESS 0x1D0F1 READ_WRITE /end MEASUREMENT
/begin MEASUREMENT OUT_HMI.HMIDataFcnBackground._Ena.Task50ms "" UBYTE IS_BOOLEAN_TRUE 0 0 0 1 ECU_ADDRESS 0x1D227 READ_WRITE /end MEASUREMENT
/begin MEASUREMENT OUT_HMI.HMIDataFcnBackground.BackgroundGlowColor.Task50ms "" UBYTE COMP_DEFAULT 0 0 0 255 ECU_ADDRESS 0x1D228 READ_WRITE /end MEASUREMENT
/begin MEASUREMENT OUT_HMI.HMIDataFcnBackground.BackgroundGoodbyeRqst.Task50ms "" UBYTE IS_BOOLEAN_TRUE 0 0 0 1 ECU_ADDRESS 0x1D229 READ_WRITE /end MEASUREMENT
/begin MEASUREMENT OUT_HMI.HMIDataFcnBackground.BackgroundWelcomeRqst.Task50ms "" UBYTE IS_BOOLEAN_TRUE 0 0 0 1 ECU_ADDRESS 0x1D22A READ_WRITE /end MEASUREMENT
/begin MEASUREMENT OUT_HMI.HMIDataFcnBrakePressure._Ena.Task50ms "" UBYTE IS_BOOLEAN_TRUE 0 0 0 1 ECU_ADDRESS 0x1D22B READ_WRITE /end MEASUREMENT
/begin MEASUREMENT OUT_HMI.HMIDataFcnBrakePressure.BrakePressureVal1.Task1000ms "" UWORD COMP_DEFAULT 0 0 0 65535 ECU_ADDRESS 0x1D000 READ_WRITE /end MEASUREMENT
/begin MEASUREMENT OUT_HMI.HMIDataFcnBrakePressure.BrakePressureVal2.Task1000ms "" UWORD COMP_DEFAULT 0 0 0 65535 ECU_ADDRESS 0x1D002 READ_WRITE /end MEASUREMENT
/begin MEASUREMENT OUT_HMI.HMIDataFcnBrakePressure.BrakePressureVal3.Task1000ms "" UWORD COMP_DEFAULT 0 0 0 65535 ECU_ADDRESS 0x1D004 READ_WRITE /end MEASUREMENT
/begin MEASUREMENT OUT_HMI.HMIDataFcnBrakePressure.BrakePressureBarVal1.Task1000ms "" UBYTE COMP_DEFAULT 0 0 0 255 ECU_ADDRESS 0x1D006 READ_WRITE /end MEASUREMENT
/begin MEASUREMENT OUT_HMI.HMIDataFcnBrakePressure.BrakePressureBarVal2.Task1000ms "" UBYTE COMP_DEFAULT 0 0 0 255 ECU_ADDRESS 0x1D007 READ_WRITE /end MEASUREMENT
/begin MEASUREMENT OUT_HMI.HMIDataFcnBrakePressure.BrakePressureBarVal3.Task1000ms "" UBYTE COMP_DEFAULT 0 0 0 255 ECU_ADDRESS 0x1D008 READ_WRITE /end MEASUREMENT
/begin MEASUREMENT OUT_HMI.HMIDataFcnBrakePressure.HMIElm01Ok.Task1000ms "" UBYTE IS_BOOLEAN_TRUE 0 0 0 1 ECU_ADDRESS 0x1D009 READ_WRITE /end MEASUREMENT
/begin MEASUREMENT OUT_HMI.HMIDataFcnBrakePressure.HMIElm02Ok.Task1000ms "" UBYTE IS_BOOLEAN_TRUE 0 0 0 1 ECU_ADDRESS 0x1D00A READ_WRITE /end MEASUREMENT
/begin MEASUREMENT OUT_HMI.HMIDataFcnBrakePressure.HMIElm04Ok.Task1000ms "" UBYTE IS_BOOLEAN_TRUE 0 0 0 1 ECU_ADDRESS 0x1D00B READ_WRITE /end MEASUREMENT
/begin MEASUREMENT OUT_HMI.HMIDataFcnBrakePressure.HMIElm05Ok.Task1000ms "" UBYTE IS_BOOLEAN_TRUE 0 0 0 1 ECU_ADDRESS 0x1D00C READ_WRITE /end MEASUREMENT
/begin MEASUREMENT OUT_HMI.HMIDataFcnBrakePressure.HMIElm07Ok.Task1000ms "" UBYTE IS_BOOLEAN_TRUE 0 0 0 1 ECU_ADDRESS 0x1D00D READ_WRITE /end MEASUREMENT
/begin MEASUREMENT OUT_HMI.HMIDataFcnBrakePressure.HMIElm08Ok.Task1000ms "" UBYTE IS_BOOLEAN_TRUE 0 0 0 1 ECU_ADDRESS 0x1D00E READ_WRITE /end MEASUREMENT
/begin MEASUREMENT OUT_HMI.HMIDataFcnBrakePressure.PressureUnit.Task1000ms "" UBYTE IS_BOOLEAN_TRUE 0 0 0 1 ECU_ADDRESS 0x1D00F READ_WRITE /end MEASUREMENT
/begin MEASUREMENT OUT_HMI.HMIDataFcnConsumption._Ena.Task50ms "" UBYTE IS_BOOLEAN_TRUE 0 0 0 1 ECU_ADDRESS 0x1D22C READ_WRITE /end MEASUREMENT
/begin MEASUREMENT OUT_HMI.HMIDataFcnConsumption.AvgConsumpVal.Task1000ms "" UWORD COMP_DEFAULT 0 0 0 65535 ECU_ADDRESS 0x1D010 READ_WRITE /end MEASUREMENT
/begin MEASUREMENT OUT_HMI.HMIDataFcnConsumption.FuelLitersVal.Task1000ms "" UWORD COMP_DEFAULT 0 0 0 65535 ECU_ADDRESS 0x1D012 READ_WRITE /end MEASUREMENT
/begin MEASUREMENT OUT_HMI.HMIDataFcnConsumption.InstantConsumpVal.Task1000ms "" UWORD COMP_DEFAULT 0 0 0 65535 ECU_ADDRESS 0x1D014 READ_WRITE /end MEASUREMENT
/begin MEASUREMENT OUT_HMI.HMIDataFcnConsumption.AvgConsumpUnitVal.Task1000ms "" UBYTE COMP_DEFAULT 0 0 0 255 ECU_ADDRESS 0x1D016 READ_WRITE /end MEASUREMENT
/begin MEASUREMENT OUT_HMI.HMIDataFcnConsumption.HMIElm01Ok.Task1000ms "" UBYTE IS_BOOLEAN_TRUE 0 0 0 1 ECU_ADDRESS 0x1D017 READ_WRITE /end MEASUREMENT
/begin MEASUREMENT OUT_HMI.HMIDataFcnConsumption.HMIElm03Ok.Task1000ms "" UBYTE IS_BOOLEAN_TRUE 0 0 0 1 ECU_ADDRESS 0x1D018 READ_WRITE /end MEASUREMENT
/begin MEASUREMENT OUT_HMI.HMIDataFcnConsumption.HMIElm05Ok.Task1000ms "" UBYTE IS_BOOLEAN_TRUE 0 0 0 1 ECU_ADDRESS 0x1D019 READ_WRITE /end MEASUREMENT
/begin MEASUREMENT OUT_HMI.HMIDataFcnConsumption.InstConsumpUnitVal.Task1000ms "" UBYTE COMP_DEFAULT 0 0 0 255 ECU_ADDRESS 0x1D01A READ_WRITE /end MEASUREMENT
/begin MEASUREMENT OUT_HMI.HMIDataFcnCoolantTemp._Ena.Task50ms "" UBYTE IS_BOOLEAN_TRUE 0 0 0 1 ECU_ADDRESS 0x1D22D READ_WRITE /end MEASUREMENT
/begin MEASUREMENT OUT_HMI.HMIDataFcnCoolantTemp.CoolantTemp.Task1000ms "" UWORD COMP_DEFAULT 0 0 0 65535 ECU_ADDRESS 0x1D01C READ_WRITE /end MEASUREMENT
/begin MEASUREMENT OUT_HMI.HMIDataFcnCoolantTemp.CoolantTempBargraphVal.Task1000ms "" UBYTE COMP_DEFAULT 0 0 0 255 ECU_ADDRESS 0x1D01E READ_WRITE /end MEASUREMENT
/begin MEASUREMENT OUT_HMI.HMIDataFcnCoolantTemp.HMIElm01Ok.Task1000ms "" UBYTE IS_BOOLEAN_TRUE 0 0 0 1 ECU_ADDRESS 0x1D01F READ_WRITE /end MEASUREMENT
/begin MEASUREMENT OUT_HMI.HMIDataFcnCoolantTemp.HMIElm02Ok.Task1000ms "" UBYTE IS_BOOLEAN_TRUE 0 0 0 1 ECU_ADDRESS 0x1D020 READ_WRITE /end MEASUREMENT
/begin MEASUREMENT OUT_HMI.HMIDataFcnDiagnostics._Ena.Task50ms "" UBYTE IS_BOOLEAN_TRUE 0 0 0 1 ECU_ADDRESS 0x1D22E READ_WRITE /end MEASUREMENT
/begin MEASUREMENT OUT_HMI.HMIDataFcnDiagnostics.DiagnosticSPNDtVal.Task1000ms "" UWORD COMP_DEFAULT 0 0 0 65535 ECU_ADDRESS 0x1D022 READ_WRITE /end MEASUREMENT
/begin MEASUREMENT OUT_HMI.HMIDataFcnDiagnostics.DiagnosticTextIDVal.Task1000ms "" UWORD COMP_DEFAULT 0 0 0 65535 ECU_ADDRESS 0x1D024 READ_WRITE /end MEASUREMENT
/begin MEASUREMENT OUT_HMI.HMIDataFcnDiagnostics.DiagnosticCurrentFailureVal.Task1000ms "" UBYTE COMP_DEFAULT 0 0 0 255 ECU_ADDRESS 0x1D026 READ_WRITE /end MEASUREMENT
/begin MEASUREMENT OUT_HMI.HMIDataFcnDiagnostics.DiagnosticFMIDtVal.Task1000ms "" UBYTE COMP_DEFAULT 0 0 0 255 ECU_ADDRESS 0x1D027 READ_WRITE /end MEASUREMENT
/begin MEASUREMENT OUT_HMI.HMIDataFcnDiagnostics.DiagnosticNumberFailuresVal.Task1000ms "" UBYTE COMP_DEFAULT 0 0 0 255 ECU_ADDRESS 0x1D028 READ_WRITE /end MEASUREMENT
/begin MEASUREMENT OUT_HMI.HMIDataFcnDriversGrade._Ena.Task50ms "" UBYTE IS_BOOLEAN_TRUE 0 0 0 1 ECU_ADDRESS 0x1D22F READ_WRITE /end MEASUREMENT
/begin MEASUREMENT OUT_HMI.HMIDataFcnESpdGauge.EngineSpdRpm.Task50ms "" UWORD COMP_DEFAULT 0 0 0 65535 ECU_ADDRESS 0x1D230 READ_WRITE /end MEASUREMENT
/begin MEASUREMENT OUT_HMI.HMIDataFcnEngSpdGauge._Ena.Task50ms "" UBYTE IS_BOOLEAN_TRUE 0 0 0 1 ECU_ADDRESS 0x1D232 READ_WRITE /end MEASUREMENT
/begin MEASUREMENT OUT_HMI.HMIDataFcnESpdGauge.EngineSpdGreenZone.Task50ms "" UBYTE COMP_DEFAULT 0 0 0 255 ECU_ADDRESS 0x1D233 READ_WRITE /end MEASUREMENT
/begin MEASUREMENT OUT_HMI.HMIDataFcnESpdGauge.EngineSpdRedZone.Task50ms "" UBYTE COMP_DEFAULT 0 0 0 255 ECU_ADDRESS 0x1D234 READ_WRITE /end MEASUREMENT
/begin MEASUREMENT OUT_HMI.HMIDataFcnESpdGauge.EngineSpdYellowZone.Task50ms "" UBYTE COMP_DEFAULT 0 0 0 255 ECU_ADDRESS 0x1D235 READ_WRITE /end MEASUREMENT
/begin MEASUREMENT OUT_HMI.HMIDataFcnGear._Ena.Task50ms "" UBYTE IS_BOOLEAN_TRUE 0 0 0 1 ECU_ADDRESS 0x1D236 READ_WRITE /end MEASUREMENT
/begin MEASUREMENT OUT_HMI.HMIDataFcnGear.CurrentGear.Task100ms "" UBYTE COMP_DEFAULT 0 0 0 255 ECU_ADDRESS 0x1D0F2 READ_WRITE /end MEASUREMENT
/begin MEASUREMENT OUT_HMI.HMIDataFcnGear.GearMode.Task100ms "" UBYTE COMP_DEFAULT 0 0 0 255 ECU_ADDRESS 0x1D0F3 READ_WRITE /end MEASUREMENT
/begin MEASUREMENT OUT_HMI.HMIDataFcnGear.RecommendedGear.Task100ms "" UBYTE COMP_DEFAULT 0 0 0 255 ECU_ADDRESS 0x1D0F4 READ_WRITE /end MEASUREMENT
/begin MEASUREMENT OUT_HMI.HMIDataFcnNotificationLeft._Ena.Task50ms "" UBYTE IS_BOOLEAN_TRUE 0 0 0 1 ECU_ADDRESS 0x1D237 READ_WRITE /end MEASUREMENT
/begin MEASUREMENT OUT_HMI.HMIDataFcnNotificationLeft.NotificationLeftTextVal.Task100ms "" UWORD COMP_DEFAULT 0 0 0 65535 ECU_ADDRESS 0x1D0F6 READ_WRITE /end MEASUREMENT
/begin MEASUREMENT OUT_HMI.HMIDataFcnNotificationLeft.NotificationLeftColorVal.Task100ms "" UBYTE COMP_DEFAULT 0 0 0 255 ECU_ADDRESS 0x1D0F8 READ_WRITE /end MEASUREMENT
/begin MEASUREMENT OUT_HMI.HMIDataFcnNotificationLeft.NotificationLeftStopSymbolVal.Task100ms "" UBYTE IS_BOOLEAN_TRUE 0 0 0 1 ECU_ADDRESS 0x1D0F9 READ_WRITE /end MEASUREMENT
/begin MEASUREMENT OUT_HMI.HMIDataFcnNotificationLeft.NotificationLeftSymbolVal.Task100ms "" UBYTE COMP_DEFAULT 0 0 0 255 ECU_ADDRESS 0x1D0FA READ_WRITE /end MEASUREMENT
/begin MEASUREMENT OUT_HMI.HMIDataFcnNotificationRight._Ena.Task50ms "" UBYTE IS_BOOLEAN_TRUE 0 0 0 1 ECU_ADDRESS 0x1D238 READ_WRITE /end MEASUREMENT
/begin MEASUREMENT OUT_HMI.HMIDataFcnNotificationRight.NotificationRightTextVal.Task100ms "" UWORD COMP_DEFAULT 0 0 0 65535 ECU_ADDRESS 0x1D0FC READ_WRITE /end MEASUREMENT
/begin MEASUREMENT OUT_HMI.HMIDataFcnNotificationRight.NotificationRightColorVal.Task100ms "" UBYTE COMP_DEFAULT 0 0 0 255 ECU_ADDRESS 0x1D0FE READ_WRITE /end MEASUREMENT
/begin MEASUREMENT OUT_HMI.HMIDataFcnNotificationRight.NotificationRightStopSymbolVal.Task100ms "" UBYTE IS_BOOLEAN_TRUE 0 0 0 1 ECU_ADDRESS 0x1D0FF READ_WRITE /end MEASUREMENT
/begin MEASUREMENT OUT_HMI.HMIDataFcnNotificationRight.NotificationRightSymbolVal.Task100ms "" UBYTE COMP_DEFAULT 0 0 0 255 ECU_ADDRESS 0x1D100 READ_WRITE /end MEASUREMENT
/begin MEASUREMENT OUT_HMI.HMIDataFcnOdometer._Ena.Task50ms "" UBYTE IS_BOOLEAN_TRUE 0 0 0 1 ECU_ADDRESS 0x1D239 READ_WRITE /end MEASUREMENT
/begin MEASUREMENT OUT_HMI.HMIDataFcnOdometer.TotalOdometer.Task1000ms "" ULONG COMP_DEFAULT 0 0 0 999999 ECU_ADDRESS 0x1D02C READ_WRITE /end MEASUREMENT
/begin MEASUREMENT OUT_HMI.HMIDataFcnOdometer.DistanceUnit.Task1000ms "" UBYTE IS_BOOLEAN_TRUE 0 0 0 1 ECU_ADDRESS 0x1D030 READ_WRITE /end MEASUREMENT
/begin MEASUREMENT OUT_HMI.HMIDataFcnOilInfo._Ena.Task50ms "" UBYTE IS_BOOLEAN_TRUE 0 0 0 1 ECU_ADDRESS 0x1D23A READ_WRITE /end MEASUREMENT
/begin MEASUREMENT OUT_HMI.HMIDataFcnOilInfo.HMIElm01Ok.Task1000ms "" UBYTE IS_BOOLEAN_TRUE 0 0 0 1 ECU_ADDRESS 0x1D034 READ_WRITE /end MEASUREMENT
/begin MEASUREMENT OUT_HMI.HMIDataFcnOilInfo.HMIElm03Ok.Task1000ms "" UBYTE IS_BOOLEAN_TRUE 0 0 0 1 ECU_ADDRESS 0x1D035 READ_WRITE /end MEASUREMENT
/begin MEASUREMENT OUT_HMI.HMIDataFcnOilInfo.HMIElm04Ok.Task1000ms "" UBYTE IS_BOOLEAN_TRUE 0 0 0 1 ECU_ADDRESS 0x1D036 READ_WRITE /end MEASUREMENT
/begin MEASUREMENT OUT_HMI.HMIDataFcnOilInfo.OilLevelBargraphVal.Task1000ms "" UBYTE COMP_DEFAULT 0 0 0 255 ECU_ADDRESS 0x1D037 READ_WRITE /end MEASUREMENT
/begin MEASUREMENT OUT_HMI.HMIDataFcnOilInfo.OilLevelVal.Task1000ms "" UBYTE COMP_DEFAULT 0 0 0 255 ECU_ADDRESS 0x1D038 READ_WRITE /end MEASUREMENT
/begin MEASUREMENT OUT_HMI.HMIDataFcnOilInfo.OilPressureBargraphVal.Task1000ms "" UBYTE COMP_DEFAULT 0 0 0 255 ECU_ADDRESS 0x1D039 READ_WRITE /end MEASUREMENT
/begin MEASUREMENT OUT_HMI.HMIDataFcnTripmeter._Ena.Task50ms "" UBYTE IS_BOOLEAN_TRUE 0 0 0 1 ECU_ADDRESS 0x1D23B READ_WRITE /end MEASUREMENT
/begin MEASUREMENT OUT_HMI.HMIDataFcnTripmeter.Tripmeter.Task1000ms "" ULONG COMP_DEFAULT 0 0 0 4294967295 ECU_ADDRESS 0x1D03C READ_WRITE /end MEASUREMENT
/begin MEASUREMENT OUT_HMI.HMIDataFcnTripmeter.DistanceUnit.Task1000ms "" UBYTE IS_BOOLEAN_TRUE 0 0 0 1 ECU_ADDRESS 0x1D040 READ_WRITE /end MEASUREMENT
/begin MEASUREMENT OUT_HMI.HMIDataFcnVhSpdDigital._Ena.Task50ms "" UBYTE IS_BOOLEAN_TRUE 0 0 0 1 ECU_ADDRESS 0x1D23C READ_WRITE /end MEASUREMENT
/begin MEASUREMENT OUT_HMI.HMIDataFcnVhSpdDigital.SpeedUnit.Task1000ms "" UBYTE IS_BOOLEAN_TRUE 0 0 0 1 ECU_ADDRESS 0x1D044 READ_WRITE /end MEASUREMENT
/begin MEASUREMENT OUT_HMI.HMIDataFcnVhSpdDigital.VhSpeedDigital.Task1000ms "" UBYTE COMP_DEFAULT 0 0 0 255 ECU_ADDRESS 0x1D045 READ_WRITE /end MEASUREMENT
/begin MEASUREMENT OUT_HMI.HMIDataFcnVhSpdGauge.VhSpeed.Task50ms "" UWORD COMP_DEFAULT 0 0 0 65535 ECU_ADDRESS 0x1D23E READ_WRITE /end MEASUREMENT
/begin MEASUREMENT OUT_HMI.HMIDataFcnVhSpdGauge._Ena.Task50ms "" UBYTE IS_BOOLEAN_TRUE 0 0 0 1 ECU_ADDRESS 0x1D240 READ_WRITE /end MEASUREMENT
/begin MEASUREMENT OUT_HMI.HMIDataFcnVhSpdGauge.SpeedUnit.Task50ms "" UBYTE IS_BOOLEAN_TRUE 0 0 0 1 ECU_ADDRESS 0x1D241 READ_WRITE /end MEASUREMENT
/begin GROUP SYSTEM.Control "Control"
 /begin ANNOTATION ANNOTATION_LABEL "Instance" ANNOTATION_ORIGIN "Group" /begin ANNOTATION_TEXT "0" /end ANNOTATION_TEXT /end ANNOTATION
 /begin ANNOTATION ANNOTATION_LABEL "TaskCycleTime" ANNOTATION_ORIGIN "Group" /begin ANNOTATION_TEXT "0" /end ANNOTATION_TEXT /end ANNOTATION
 /begin ANNOTATION ANNOTATION_LABEL "TimeResolution" ANNOTATION_ORIGIN "Group" /begin ANNOTATION_TEXT "0" /end ANNOTATION_TEXT /end ANNOTATION
 /begin REF_MEASUREMENT OUT_Control.f_CntrlModelHold.Task40ms /end REF_MEASUREMENT
/end GROUP
/begin GROUP SYSTEM.Digital_Inputs "Digital Inputs"
 /begin ANNOTATION ANNOTATION_LABEL "Instance" ANNOTATION_ORIGIN "Group" /begin ANNOTATION_TEXT "0" /end ANNOTATION_TEXT /end ANNOTATION
 /begin ANNOTATION ANNOTATION_LABEL "TaskCycleTime" ANNOTATION_ORIGIN "Group" /begin ANNOTATION_TEXT "0" /end ANNOTATION_TEXT /end ANNOTATION
 /begin ANNOTATION ANNOTATION_LABEL "TimeResolution" ANNOTATION_ORIGIN "Group" /begin ANNOTATION_TEXT "0" /end ANNOTATION_TEXT /end ANNOTATION
 /begin REF_MEASUREMENT IN_DigitalInputs.f_TRM15.Task40ms IN_DigitalInputs.f_startupScreenActive.Task100ms IN_DigitalInputs.f_TRM15.Task200ms /end REF_MEASUREMENT
/end GROUP
/begin GROUP SYSTEM.Digital_Outputs "Digital Outputs"
 /begin ANNOTATION ANNOTATION_LABEL "Instance" ANNOTATION_ORIGIN "Group" /begin ANNOTATION_TEXT "0" /end ANNOTATION_TEXT /end ANNOTATION
 /begin ANNOTATION ANNOTATION_LABEL "TaskCycleTime" ANNOTATION_ORIGIN "Group" /begin ANNOTATION_TEXT "0" /end ANNOTATION_TEXT /end ANNOTATION
 /begin ANNOTATION ANNOTATION_LABEL "TimeResolution" ANNOTATION_ORIGIN "Group" /begin ANNOTATION_TEXT "0" /end ANNOTATION_TEXT /end ANNOTATION
 /begin REF_MEASUREMENT OUT_DigitalOutputs.u8_BargraphPwm.Task40ms OUT_DigitalOutputs.u8_ScalePwm.Task40ms OUT_DigitalOutputs.u8_TelltalesPwm.Task40ms /end REF_MEASUREMENT
/end GROUP
/begin GROUP SYSTEM.CAN0.VhData50_Menu "VhData50_Menu"
 /begin ANNOTATION ANNOTATION_LABEL "Instance" ANNOTATION_ORIGIN "Group" /begin ANNOTATION_TEXT "1" /end ANNOTATION_TEXT /end ANNOTATION
 /begin ANNOTATION ANNOTATION_LABEL "TaskCycleTime" ANNOTATION_ORIGIN "Group" /begin ANNOTATION_TEXT "0" /end ANNOTATION_TEXT /end ANNOTATION
 /begin ANNOTATION ANNOTATION_LABEL "TimeResolution" ANNOTATION_ORIGIN "Group" /begin ANNOTATION_TEXT "0" /end ANNOTATION_TEXT /end ANNOTATION
 /begin REF_MEASUREMENT IN_CAN0.RxFrames.VhData50_Menu._State.Task50ms IN_CAN0.RxFrames.VhData50_Menu.DigitalSpeedUnitDt.Task50ms IN_CAN0.RxFrames.VhData50_Menu.LanguageDt.Task50ms IN_CAN0.RxFrames.VhData50_Menu._State.Task1000ms IN_CAN0.RxFrames.VhData50_Menu.ConsumptionUnitDt.Task1000ms IN_CAN0.RxFrames.VhData50_Menu.DigitalSpeedUnitDt.Task1000ms IN_CAN0.RxFrames.VhData50_Menu.DistanceUnitDt.Task1000ms IN_CAN0.RxFrames.VhData50_Menu.PressureUnitDt.Task1000ms OUT_CAN0.RxFrames.VhData50_Menu._Ena.Task40ms /end REF_MEASUREMENT
/end GROUP
/begin GROUP SYSTEM.CAN0.Ctrl50_ScrDA2 "Ctrl50_ScrDA2"
 /begin ANNOTATION ANNOTATION_LABEL "Instance" ANNOTATION_ORIGIN "Group" /begin ANNOTATION_TEXT "2" /end ANNOTATION_TEXT /end ANNOTATION
 /begin ANNOTATION ANNOTATION_LABEL "TaskCycleTime" ANNOTATION_ORIGIN "Group" /begin ANNOTATION_TEXT "0" /end ANNOTATION_TEXT /end ANNOTATION
 /begin ANNOTATION ANNOTATION_LABEL "TimeResolution" ANNOTATION_ORIGIN "Group" /begin ANNOTATION_TEXT "0" /end ANNOTATION_TEXT /end ANNOTATION
 /begin REF_MEASUREMENT IN_CAN0.RxFrames.Ctrl50_ScrDA2._State.Task50ms IN_CAN0.RxFrames.Ctrl50_ScrDA2.ICDISScreen_DA_21Ctrl.Task50ms IN_CAN0.RxFrames.Ctrl50_ScrDA2.ICDISScreen_DA_29Ctrl.Task50ms IN_CAN0.RxFrames.Ctrl50_ScrDA2.ICDISScreen_DA_30Ctrl.Task50ms IN_CAN0.RxFrames.Ctrl50_ScrDA2._State.Task100ms IN_CAN0.RxFrames.Ctrl50_ScrDA2.ICDISScreen_DA_29Ctrl.Task100ms IN_CAN0.RxFrames.Ctrl50_ScrDA2.ICDISScreen_DA_30Ctrl.Task100ms IN_CAN0.RxFrames.Ctrl50_ScrDA2._State.Task1000ms IN_CAN0.RxFrames.Ctrl50_ScrDA2.ICDISScreen_DA_21Ctrl.Task1000ms OUT_CAN0.RxFrames.Ctrl50_ScrDA2._Ena.Task40ms /end REF_MEASUREMENT
/end GROUP
/begin GROUP SYSTEM.CAN0.Ctrl50_ScrDA1 "Ctrl50_ScrDA1"
 /begin ANNOTATION ANNOTATION_LABEL "Instance" ANNOTATION_ORIGIN "Group" /begin ANNOTATION_TEXT "3" /end ANNOTATION_TEXT /end ANNOTATION
 /begin ANNOTATION ANNOTATION_LABEL "TaskCycleTime" ANNOTATION_ORIGIN "Group" /begin ANNOTATION_TEXT "0" /end ANNOTATION_TEXT /end ANNOTATION
 /begin ANNOTATION ANNOTATION_LABEL "TimeResolution" ANNOTATION_ORIGIN "Group" /begin ANNOTATION_TEXT "0" /end ANNOTATION_TEXT /end ANNOTATION
 /begin REF_MEASUREMENT IN_CAN0.RxFrames.Ctrl50_ScrDA1._State.Task50ms IN_CAN0.RxFrames.Ctrl50_ScrDA1.ICDISScreen_DA_00Ctrl.Task50ms IN_CAN0.RxFrames.Ctrl50_ScrDA1.ICDISScreen_DA_01Ctrl.Task50ms IN_CAN0.RxFrames.Ctrl50_ScrDA1.ICDISScreen_DA_02Ctrl.Task50ms IN_CAN0.RxFrames.Ctrl50_ScrDA1.ICDISScreen_DA_03Ctrl.Task50ms IN_CAN0.RxFrames.Ctrl50_ScrDA1.ICDISScreen_DA_06Ctrl.Task50ms IN_CAN0.RxFrames.Ctrl50_ScrDA1.ICDISScreen_DA_07Ctrl.Task50ms IN_CAN0.RxFrames.Ctrl50_ScrDA1.ICDISScreen_DA_08Ctrl.Task50ms IN_CAN0.RxFrames.Ctrl50_ScrDA1.ICDISScreen_DA_09Ctrl.Task50ms IN_CAN0.RxFrames.Ctrl50_ScrDA1.ICDISScreen_DA_10Ctrl.Task50ms IN_CAN0.RxFrames.Ctrl50_ScrDA1.ICDISScreen_DA_11Ctrl.Task50ms IN_CAN0.RxFrames.Ctrl50_ScrDA1.ICDISScreen_DA_12Ctrl.Task50ms IN_CAN0.RxFrames.Ctrl50_ScrDA1.ICDISScreen_DA_13Ctrl.Task50ms IN_CAN0.RxFrames.Ctrl50_ScrDA1.ICDISScreen_DA_14Ctrl.Task50ms IN_CAN0.RxFrames.Ctrl50_ScrDA1._State.Task100ms IN_CAN0.RxFrames.Ctrl50_ScrDA1.ICDISScreen_DA_10Ctrl.Task100ms IN_CAN0.RxFrames.Ctrl50_ScrDA1._State.Task1000ms IN_CAN0.RxFrames.Ctrl50_ScrDA1.ICDISScreen_DA_01Ctrl.Task1000ms IN_CAN0.RxFrames.Ctrl50_ScrDA1.ICDISScreen_DA_02Ctrl.Task1000ms IN_CAN0.RxFrames.Ctrl50_ScrDA1.ICDISScreen_DA_03Ctrl.Task1000ms IN_CAN0.RxFrames.Ctrl50_ScrDA1.ICDISScreen_DA_06Ctrl.Task1000ms IN_CAN0.RxFrames.Ctrl50_ScrDA1.ICDISScreen_DA_11Ctrl.Task1000ms IN_CAN0.RxFrames.Ctrl50_ScrDA1.ICDISScreen_DA_12Ctrl.Task1000ms IN_CAN0.RxFrames.Ctrl50_ScrDA1.ICDISScreen_DA_13Ctrl.Task1000ms IN_CAN0.RxFrames.Ctrl50_ScrDA1.ICDISScreen_DA_14Ctrl.Task1000ms OUT_CAN0.RxFrames.Ctrl50_ScrDA1._Ena.Task40ms /end REF_MEASUREMENT
/end GROUP
/begin GROUP SYSTEM.CAN0.Ctrl50_FcnDA2 "Ctrl50_FcnDA2"
 /begin ANNOTATION ANNOTATION_LABEL "Instance" ANNOTATION_ORIGIN "Group" /begin ANNOTATION_TEXT "4" /end ANNOTATION_TEXT /end ANNOTATION
 /begin ANNOTATION ANNOTATION_LABEL "TaskCycleTime" ANNOTATION_ORIGIN "Group" /begin ANNOTATION_TEXT "0" /end ANNOTATION_TEXT /end ANNOTATION
 /begin ANNOTATION ANNOTATION_LABEL "TimeResolution" ANNOTATION_ORIGIN "Group" /begin ANNOTATION_TEXT "0" /end ANNOTATION_TEXT /end ANNOTATION
 /begin REF_MEASUREMENT IN_CAN0.RxFrames.Ctrl50_FcnDA2._State.Task50ms IN_CAN0.RxFrames.Ctrl50_FcnDA2.ICDISFcn_DA_21Ctrl.Task50ms IN_CAN0.RxFrames.Ctrl50_FcnDA2.ICDISFcn_DA_29Ctrl.Task50ms IN_CAN0.RxFrames.Ctrl50_FcnDA2.ICDISFcn_DA_30Ctrl.Task50ms IN_CAN0.RxFrames.Ctrl50_FcnDA2._State.Task100ms IN_CAN0.RxFrames.Ctrl50_FcnDA2.ICDISFcn_DA_29Ctrl.Task100ms IN_CAN0.RxFrames.Ctrl50_FcnDA2.ICDISFcn_DA_30Ctrl.Task100ms IN_CAN0.RxFrames.Ctrl50_FcnDA2._State.Task1000ms IN_CAN0.RxFrames.Ctrl50_FcnDA2.ICDISFcn_DA_21Ctrl.Task1000ms OUT_CAN0.RxFrames.Ctrl50_FcnDA2._Ena.Task40ms /end REF_MEASUREMENT
/end GROUP
/begin GROUP SYSTEM.CAN0.Ctrl50_FcnDA1 "Ctrl50_FcnDA1"
 /begin ANNOTATION ANNOTATION_LABEL "Instance" ANNOTATION_ORIGIN "Group" /begin ANNOTATION_TEXT "5" /end ANNOTATION_TEXT /end ANNOTATION
 /begin ANNOTATION ANNOTATION_LABEL "TaskCycleTime" ANNOTATION_ORIGIN "Group" /begin ANNOTATION_TEXT "0" /end ANNOTATION_TEXT /end ANNOTATION
 /begin ANNOTATION ANNOTATION_LABEL "TimeResolution" ANNOTATION_ORIGIN "Group" /begin ANNOTATION_TEXT "0" /end ANNOTATION_TEXT /end ANNOTATION
 /begin REF_MEASUREMENT IN_CAN0.RxFrames.Ctrl50_FcnDA1._State.Task50ms IN_CAN0.RxFrames.Ctrl50_FcnDA1.ICDISFcn_DA_01Ctrl.Task50ms IN_CAN0.RxFrames.Ctrl50_FcnDA1.ICDISFcn_DA_02Ctrl.Task50ms IN_CAN0.RxFrames.Ctrl50_FcnDA1.ICDISFcn_DA_03Ctrl.Task50ms IN_CAN0.RxFrames.Ctrl50_FcnDA1.ICDISFcn_DA_06Ctrl.Task50ms IN_CAN0.RxFrames.Ctrl50_FcnDA1._State.Task1000ms IN_CAN0.RxFrames.Ctrl50_FcnDA1.ICDISFcn_DA_01Ctrl.Task1000ms IN_CAN0.RxFrames.Ctrl50_FcnDA1.ICDISFcn_DA_02Ctrl.Task1000ms IN_CAN0.RxFrames.Ctrl50_FcnDA1.ICDISFcn_DA_03Ctrl.Task1000ms IN_CAN0.RxFrames.Ctrl50_FcnDA1.ICDISFcn_DA_06Ctrl.Task1000ms OUT_CAN0.RxFrames.Ctrl50_FcnDA1._Ena.Task40ms /end REF_MEASUREMENT
/end GROUP
/begin GROUP SYSTEM.CAN0.Ctrl50_SubView "Ctrl50_SubView"
 /begin ANNOTATION ANNOTATION_LABEL "Instance" ANNOTATION_ORIGIN "Group" /begin ANNOTATION_TEXT "6" /end ANNOTATION_TEXT /end ANNOTATION
 /begin ANNOTATION ANNOTATION_LABEL "TaskCycleTime" ANNOTATION_ORIGIN "Group" /begin ANNOTATION_TEXT "0" /end ANNOTATION_TEXT /end ANNOTATION
 /begin ANNOTATION ANNOTATION_LABEL "TimeResolution" ANNOTATION_ORIGIN "Group" /begin ANNOTATION_TEXT "0" /end ANNOTATION_TEXT /end ANNOTATION
 /begin REF_MEASUREMENT IN_CAN0.RxFrames.Ctrl50_SubView._State.Task50ms IN_CAN0.RxFrames.Ctrl50_SubView.ICDISSVCtrl.Task50ms OUT_CAN0.RxFrames.Ctrl50_SubView._Ena.Task40ms /end REF_MEASUREMENT
/end GROUP
/begin GROUP SYSTEM.CAN0.VhData50_Gauges "VhData50_Gauges"
 /begin ANNOTATION ANNOTATION_LABEL "Instance" ANNOTATION_ORIGIN "Group" /begin ANNOTATION_TEXT "7" /end ANNOTATION_TEXT /end ANNOTATION
 /begin ANNOTATION ANNOTATION_LABEL "TaskCycleTime" ANNOTATION_ORIGIN "Group" /begin ANNOTATION_TEXT "0" /end ANNOTATION_TEXT /end ANNOTATION
 /begin ANNOTATION ANNOTATION_LABEL "TimeResolution" ANNOTATION_ORIGIN "Group" /begin ANNOTATION_TEXT "0" /end ANNOTATION_TEXT /end ANNOTATION
 /begin REF_MEASUREMENT IN_CAN0.RxFrames.VhData50_Gauges._State.Task50ms IN_CAN0.RxFrames.VhData50_Gauges.EngineSpeedDt.Task50ms IN_CAN0.RxFrames.VhData50_Gauges.ESpdGreenRangeDt.Task50ms IN_CAN0.RxFrames.VhData50_Gauges.ESpdRedRangeDt.Task50ms IN_CAN0.RxFrames.VhData50_Gauges.ESpdYellowRangeDt.Task50ms IN_CAN0.RxFrames.VhData50_Gauges.VehicleSpeedDt.Task50ms IN_CAN0.RxFrames.VhData50_Gauges._State.Task1000ms IN_CAN0.RxFrames.VhData50_Gauges.VehicleSpeedDt.Task1000ms OUT_CAN0.RxFrames.VhData50_Gauges._Ena.Task40ms /end REF_MEASUREMENT
/end GROUP
/begin GROUP SYSTEM.CAN0.GRA_UHRe_01 "GRA_UHRe_01"
 /begin ANNOTATION ANNOTATION_LABEL "Instance" ANNOTATION_ORIGIN "Group" /begin ANNOTATION_TEXT "8" /end ANNOTATION_TEXT /end ANNOTATION
 /begin ANNOTATION ANNOTATION_LABEL "TaskCycleTime" ANNOTATION_ORIGIN "Group" /begin ANNOTATION_TEXT "0" /end ANNOTATION_TEXT /end ANNOTATION
 /begin ANNOTATION ANNOTATION_LABEL "TimeResolution" ANNOTATION_ORIGIN "Group" /begin ANNOTATION_TEXT "0" /end ANNOTATION_TEXT /end ANNOTATION
 /begin REF_MEASUREMENT IN_CAN0.RxFrames.GRA_UHRe_01._State.Task40ms IN_CAN0.RxFrames.GRA_UHRe_01.UHREbyte1.Task40ms IN_CAN0.RxFrames.GRA_UHRe_01.UHREbyte2.Task40ms IN_CAN0.RxFrames.GRA_UHRe_01.UHREbyte3.Task40ms IN_CAN0.RxFrames.GRA_UHRe_01.UHREbyte4.Task40ms IN_CAN0.RxFrames.GRA_UHRe_01.UHREbyte5.Task40ms IN_CAN0.RxFrames.GRA_UHRe_01.UHREbyte6.Task40ms IN_CAN0.RxFrames.GRA_UHRe_01.UHREbyte7.Task40ms IN_CAN0.RxFrames.GRA_UHRe_01.UHREbyte8.Task40ms OUT_CAN0.RxFrames.GRA_UHRe_01._Ena.Task40ms /end REF_MEASUREMENT
/end GROUP
/begin GROUP SYSTEM.CAN0.GRA_MFLe_01 "GRA_MFLe_01"
 /begin ANNOTATION ANNOTATION_LABEL "Instance" ANNOTATION_ORIGIN "Group" /begin ANNOTATION_TEXT "9" /end ANNOTATION_TEXT /end ANNOTATION
 /begin ANNOTATION ANNOTATION_LABEL "TaskCycleTime" ANNOTATION_ORIGIN "Group" /begin ANNOTATION_TEXT "0" /end ANNOTATION_TEXT /end ANNOTATION
 /begin ANNOTATION ANNOTATION_LABEL "TimeResolution" ANNOTATION_ORIGIN "Group" /begin ANNOTATION_TEXT "0" /end ANNOTATION_TEXT /end ANNOTATION
 /begin REF_MEASUREMENT IN_CAN0.RxFrames.GRA_MFLe_01._State.Task40ms IN_CAN0.RxFrames.GRA_MFLe_01.MFLEbyte1.Task40ms IN_CAN0.RxFrames.GRA_MFLe_01.MFLEbyte2.Task40ms IN_CAN0.RxFrames.GRA_MFLe_01.MFLEbyte3.Task40ms IN_CAN0.RxFrames.GRA_MFLe_01.MFLEbyte4.Task40ms IN_CAN0.RxFrames.GRA_MFLe_01.MFLEbyte5.Task40ms IN_CAN0.RxFrames.GRA_MFLe_01.MFLEbyte6.Task40ms IN_CAN0.RxFrames.GRA_MFLe_01.MFLEbyte7.Task40ms IN_CAN0.RxFrames.GRA_MFLe_01.MFLEbyte8.Task40ms OUT_CAN0.RxFrames.GRA_MFLe_01._Ena.Task40ms /end REF_MEASUREMENT
/end GROUP
/begin GROUP SYSTEM.CAN0.VhData100_2 "VhData100_2"
 /begin ANNOTATION ANNOTATION_LABEL "Instance" ANNOTATION_ORIGIN "Group" /begin ANNOTATION_TEXT "10" /end ANNOTATION_TEXT /end ANNOTATION
 /begin ANNOTATION ANNOTATION_LABEL "TaskCycleTime" ANNOTATION_ORIGIN "Group" /begin ANNOTATION_TEXT "0" /end ANNOTATION_TEXT /end ANNOTATION
 /begin ANNOTATION ANNOTATION_LABEL "TimeResolution" ANNOTATION_ORIGIN "Group" /begin ANNOTATION_TEXT "0" /end ANNOTATION_TEXT /end ANNOTATION
 /begin REF_MEASUREMENT IN_CAN0.RxFrames.VhData100_2._State.Task1000ms IN_CAN0.RxFrames.VhData100_2.CoolantTempDt.Task1000ms IN_CAN0.RxFrames.VhData100_2.CoolantTempBargraphDt.Task1000ms OUT_CAN0.RxFrames.VhData100_2._Ena.Task40ms /end REF_MEASUREMENT
/end GROUP
/begin GROUP SYSTEM.CAN0.VhData100_1 "VhData100_1"
 /begin ANNOTATION ANNOTATION_LABEL "Instance" ANNOTATION_ORIGIN "Group" /begin ANNOTATION_TEXT "11" /end ANNOTATION_TEXT /end ANNOTATION
 /begin ANNOTATION ANNOTATION_LABEL "TaskCycleTime" ANNOTATION_ORIGIN "Group" /begin ANNOTATION_TEXT "0" /end ANNOTATION_TEXT /end ANNOTATION
 /begin ANNOTATION ANNOTATION_LABEL "TimeResolution" ANNOTATION_ORIGIN "Group" /begin ANNOTATION_TEXT "0" /end ANNOTATION_TEXT /end ANNOTATION
 /begin REF_MEASUREMENT IN_CAN0.RxFrames.VhData100_1._State.Task1000ms IN_CAN0.RxFrames.VhData100_1.InstantConsumpDt.Task1000ms IN_CAN0.RxFrames.VhData100_1.InstConsumpUnitDt.Task1000ms OUT_CAN0.RxFrames.VhData100_1._Ena.Task40ms /end REF_MEASUREMENT
/end GROUP
/begin GROUP SYSTEM.CAN0.VhData100_3 "VhData100_3"
 /begin ANNOTATION ANNOTATION_LABEL "Instance" ANNOTATION_ORIGIN "Group" /begin ANNOTATION_TEXT "12" /end ANNOTATION_TEXT /end ANNOTATION
 /begin ANNOTATION ANNOTATION_LABEL "TaskCycleTime" ANNOTATION_ORIGIN "Group" /begin ANNOTATION_TEXT "0" /end ANNOTATION_TEXT /end ANNOTATION
 /begin ANNOTATION ANNOTATION_LABEL "TimeResolution" ANNOTATION_ORIGIN "Group" /begin ANNOTATION_TEXT "0" /end ANNOTATION_TEXT /end ANNOTATION
 /begin REF_MEASUREMENT IN_CAN0.RxFrames.VhData100_3._State.Task100ms IN_CAN0.RxFrames.VhData100_3.GearCurrentIndicationDt.Task100ms IN_CAN0.RxFrames.VhData100_3.GearModeDt.Task100ms IN_CAN0.RxFrames.VhData100_3.GearRecommendedGearDt.Task100ms OUT_CAN0.RxFrames.VhData100_3._Ena.Task40ms /end REF_MEASUREMENT
/end GROUP
/begin GROUP SYSTEM.CAN0.ICOM1CTRL "ICOM1CTRL"
 /begin ANNOTATION ANNOTATION_LABEL "Instance" ANNOTATION_ORIGIN "Group" /begin ANNOTATION_TEXT "13" /end ANNOTATION_TEXT /end ANNOTATION
 /begin ANNOTATION ANNOTATION_LABEL "TaskCycleTime" ANNOTATION_ORIGIN "Group" /begin ANNOTATION_TEXT "0" /end ANNOTATION_TEXT /end ANNOTATION
 /begin ANNOTATION ANNOTATION_LABEL "TimeResolution" ANNOTATION_ORIGIN "Group" /begin ANNOTATION_TEXT "0" /end ANNOTATION_TEXT /end ANNOTATION
 /begin REF_MEASUREMENT IN_CAN0.RxFrames.ICOM1CTRL._State.Task40ms IN_CAN0.RxFrames.ICOM1CTRL.ICOMCtrl.Task40ms OUT_CAN0.RxFrames.ICOM1CTRL._Ena.Task40ms /end REF_MEASUREMENT
/end GROUP
/begin GROUP SYSTEM.CAN0.VhData200_1 "VhData200_1"
 /begin ANNOTATION ANNOTATION_LABEL "Instance" ANNOTATION_ORIGIN "Group" /begin ANNOTATION_TEXT "14" /end ANNOTATION_TEXT /end ANNOTATION
 /begin ANNOTATION ANNOTATION_LABEL "TaskCycleTime" ANNOTATION_ORIGIN "Group" /begin ANNOTATION_TEXT "0" /end ANNOTATION_TEXT /end ANNOTATION
 /begin ANNOTATION ANNOTATION_LABEL "TimeResolution" ANNOTATION_ORIGIN "Group" /begin ANNOTATION_TEXT "0" /end ANNOTATION_TEXT /end ANNOTATION
 /begin REF_MEASUREMENT IN_CAN0.RxFrames.VhData200_1._State.Task50ms IN_CAN0.RxFrames.VhData200_1.ICDISBackGlowColorDt.Task50ms IN_CAN0.RxFrames.VhData200_1._State.Task200ms IN_CAN0.RxFrames.VhData200_1.ICDISDayNightDt.Task200ms IN_CAN0.RxFrames.VhData200_1._State.Task1000ms IN_CAN0.RxFrames.VhData200_1.OilPressureDt.Task1000ms OUT_CAN0.RxFrames.VhData200_1._Ena.Task40ms /end REF_MEASUREMENT
/end GROUP
/begin GROUP SYSTEM.CAN0.VhData200_2 "VhData200_2"
 /begin ANNOTATION ANNOTATION_LABEL "Instance" ANNOTATION_ORIGIN "Group" /begin ANNOTATION_TEXT "15" /end ANNOTATION_TEXT /end ANNOTATION
 /begin ANNOTATION ANNOTATION_LABEL "TaskCycleTime" ANNOTATION_ORIGIN "Group" /begin ANNOTATION_TEXT "0" /end ANNOTATION_TEXT /end ANNOTATION
 /begin ANNOTATION ANNOTATION_LABEL "TimeResolution" ANNOTATION_ORIGIN "Group" /begin ANNOTATION_TEXT "0" /end ANNOTATION_TEXT /end ANNOTATION
 /begin REF_MEASUREMENT IN_CAN0.RxFrames.VhData200_2._State.Task1000ms IN_CAN0.RxFrames.VhData200_2.BrakePressure1Dt.Task1000ms IN_CAN0.RxFrames.VhData200_2.BrakePressure2Dt.Task1000ms IN_CAN0.RxFrames.VhData200_2.BrakePressure3Dt.Task1000ms IN_CAN0.RxFrames.VhData200_2.BrakePressure1BargraphDt.Task1000ms IN_CAN0.RxFrames.VhData200_2.BrakePressure2BargraphDt.Task1000ms IN_CAN0.RxFrames.VhData200_2.BrakePressure3BargraphDt.Task1000ms OUT_CAN0.RxFrames.VhData200_2._Ena.Task40ms /end REF_MEASUREMENT
/end GROUP
/begin GROUP SYSTEM.CAN0.VhData200_VTT8 "VhData200_VTT8"
 /begin ANNOTATION ANNOTATION_LABEL "Instance" ANNOTATION_ORIGIN "Group" /begin ANNOTATION_TEXT "16" /end ANNOTATION_TEXT /end ANNOTATION
 /begin ANNOTATION ANNOTATION_LABEL "TaskCycleTime" ANNOTATION_ORIGIN "Group" /begin ANNOTATION_TEXT "0" /end ANNOTATION_TEXT /end ANNOTATION
 /begin ANNOTATION ANNOTATION_LABEL "TimeResolution" ANNOTATION_ORIGIN "Group" /begin ANNOTATION_TEXT "0" /end ANNOTATION_TEXT /end ANNOTATION
 /begin REF_MEASUREMENT IN_CAN0.RxFrames.VhData200_VTT8._State.Task40ms IN_CAN0.RxFrames.VhData200_VTT8.State_DA_V43Dt.Task40ms IN_CAN0.RxFrames.VhData200_VTT8.State_DA_V44Dt.Task40ms IN_CAN0.RxFrames.VhData200_VTT8.State_DA_V45Dt.Task40ms IN_CAN0.RxFrames.VhData200_VTT8.State_DA_V46Dt.Task40ms IN_CAN0.RxFrames.VhData200_VTT8.State_DA_V47Dt.Task40ms IN_CAN0.RxFrames.VhData200_VTT8.SymbolID_DA_V43Dt.Task40ms IN_CAN0.RxFrames.VhData200_VTT8.SymbolID_DA_V44Dt.Task40ms IN_CAN0.RxFrames.VhData200_VTT8.SymbolID_DA_V45Dt.Task40ms IN_CAN0.RxFrames.VhData200_VTT8.SymbolID_DA_V46Dt.Task40ms IN_CAN0.RxFrames.VhData200_VTT8.SymbolID_DA_V47Dt.Task40ms OUT_CAN0.RxFrames.VhData200_VTT8._Ena.Task40ms /end REF_MEASUREMENT
/end GROUP
/begin GROUP SYSTEM.CAN0.ICILL1CTRL "ICILL1CTRL"
 /begin ANNOTATION ANNOTATION_LABEL "Instance" ANNOTATION_ORIGIN "Group" /begin ANNOTATION_TEXT "17" /end ANNOTATION_TEXT /end ANNOTATION
 /begin ANNOTATION ANNOTATION_LABEL "TaskCycleTime" ANNOTATION_ORIGIN "Group" /begin ANNOTATION_TEXT "0" /end ANNOTATION_TEXT /end ANNOTATION
 /begin ANNOTATION ANNOTATION_LABEL "TimeResolution" ANNOTATION_ORIGIN "Group" /begin ANNOTATION_TEXT "0" /end ANNOTATION_TEXT /end ANNOTATION
 /begin REF_MEASUREMENT IN_CAN0.RxFrames.ICILL1CTRL._State.Task40ms IN_CAN0.RxFrames.ICILL1CTRL.ICILLBargraphLdLvlCtrl.Task40ms IN_CAN0.RxFrames.ICILL1CTRL.ICILLBargraphLdTransCtrl.Task40ms IN_CAN0.RxFrames.ICILL1CTRL.ICILLBargraphSclsLvlCtrl.Task40ms IN_CAN0.RxFrames.ICILL1CTRL.ICILLBargraphSclsTransCtrl.Task40ms IN_CAN0.RxFrames.ICILL1CTRL.ICILLDispLvlCtrl.Task40ms IN_CAN0.RxFrames.ICILL1CTRL.ICILLDispTransCtrl.Task40ms IN_CAN0.RxFrames.ICILL1CTRL.ICILLTelltaleLvlCtrl.Task40ms IN_CAN0.RxFrames.ICILL1CTRL.ICILLTelltaleTransCtrl.Task40ms OUT_CAN0.RxFrames.ICILL1CTRL._Ena.Task40ms /end REF_MEASUREMENT
/end GROUP
/begin GROUP SYSTEM.CAN0.VhData200_VTT7 "VhData200_VTT7"
 /begin ANNOTATION ANNOTATION_LABEL "Instance" ANNOTATION_ORIGIN "Group" /begin ANNOTATION_TEXT "18" /end ANNOTATION_TEXT /end ANNOTATION
 /begin ANNOTATION ANNOTATION_LABEL "TaskCycleTime" ANNOTATION_ORIGIN "Group" /begin ANNOTATION_TEXT "0" /end ANNOTATION_TEXT /end ANNOTATION
 /begin ANNOTATION ANNOTATION_LABEL "TimeResolution" ANNOTATION_ORIGIN "Group" /begin ANNOTATION_TEXT "0" /end ANNOTATION_TEXT /end ANNOTATION
 /begin REF_MEASUREMENT IN_CAN0.RxFrames.VhData200_VTT7._State.Task40ms IN_CAN0.RxFrames.VhData200_VTT7.State_DA_V37Dt.Task40ms IN_CAN0.RxFrames.VhData200_VTT7.State_DA_V38Dt.Task40ms IN_CAN0.RxFrames.VhData200_VTT7.State_DA_V39Dt.Task40ms IN_CAN0.RxFrames.VhData200_VTT7.State_DA_V40Dt.Task40ms IN_CAN0.RxFrames.VhData200_VTT7.State_DA_V41Dt.Task40ms IN_CAN0.RxFrames.VhData200_VTT7.State_DA_V42Dt.Task40ms IN_CAN0.RxFrames.VhData200_VTT7.SymbolID_DA_V37Dt.Task40ms IN_CAN0.RxFrames.VhData200_VTT7.SymbolID_DA_V38Dt.Task40ms IN_CAN0.RxFrames.VhData200_VTT7.SymbolID_DA_V39Dt.Task40ms IN_CAN0.RxFrames.VhData200_VTT7.SymbolID_DA_V40Dt.Task40ms IN_CAN0.RxFrames.VhData200_VTT7.SymbolID_DA_V41Dt.Task40ms IN_CAN0.RxFrames.VhData200_VTT7.SymbolID_DA_V42Dt.Task40ms OUT_CAN0.RxFrames.VhData200_VTT7._Ena.Task40ms /end REF_MEASUREMENT
/end GROUP
/begin GROUP SYSTEM.CAN0.VhData200_VTT6 "VhData200_VTT6"
 /begin ANNOTATION ANNOTATION_LABEL "Instance" ANNOTATION_ORIGIN "Group" /begin ANNOTATION_TEXT "19" /end ANNOTATION_TEXT /end ANNOTATION
 /begin ANNOTATION ANNOTATION_LABEL "TaskCycleTime" ANNOTATION_ORIGIN "Group" /begin ANNOTATION_TEXT "0" /end ANNOTATION_TEXT /end ANNOTATION
 /begin ANNOTATION ANNOTATION_LABEL "TimeResolution" ANNOTATION_ORIGIN "Group" /begin ANNOTATION_TEXT "0" /end ANNOTATION_TEXT /end ANNOTATION
 /begin REF_MEASUREMENT IN_CAN0.RxFrames.VhData200_VTT6._State.Task40ms IN_CAN0.RxFrames.VhData200_VTT6.State_DA_V31Dt.Task40ms IN_CAN0.RxFrames.VhData200_VTT6.State_DA_V32Dt.Task40ms IN_CAN0.RxFrames.VhData200_VTT6.State_DA_V33Dt.Task40ms IN_CAN0.RxFrames.VhData200_VTT6.State_DA_V34Dt.Task40ms IN_CAN0.RxFrames.VhData200_VTT6.State_DA_V35Dt.Task40ms IN_CAN0.RxFrames.VhData200_VTT6.State_DA_V36Dt.Task40ms IN_CAN0.RxFrames.VhData200_VTT6.SymbolID_DA_V31Dt.Task40ms IN_CAN0.RxFrames.VhData200_VTT6.SymbolID_DA_V32Dt.Task40ms IN_CAN0.RxFrames.VhData200_VTT6.SymbolID_DA_V33Dt.Task40ms IN_CAN0.RxFrames.VhData200_VTT6.SymbolID_DA_V34Dt.Task40ms IN_CAN0.RxFrames.VhData200_VTT6.SymbolID_DA_V35Dt.Task40ms IN_CAN0.RxFrames.VhData200_VTT6.SymbolID_DA_V36Dt.Task40ms OUT_CAN0.RxFrames.VhData200_VTT6._Ena.Task40ms /end REF_MEASUREMENT
/end GROUP
/begin GROUP SYSTEM.CAN0.VhData200_VTT5 "VhData200_VTT5"
 /begin ANNOTATION ANNOTATION_LABEL "Instance" ANNOTATION_ORIGIN "Group" /begin ANNOTATION_TEXT "20" /end ANNOTATION_TEXT /end ANNOTATION
 /begin ANNOTATION ANNOTATION_LABEL "TaskCycleTime" ANNOTATION_ORIGIN "Group" /begin ANNOTATION_TEXT "0" /end ANNOTATION_TEXT /end ANNOTATION
 /begin ANNOTATION ANNOTATION_LABEL "TimeResolution" ANNOTATION_ORIGIN "Group" /begin ANNOTATION_TEXT "0" /end ANNOTATION_TEXT /end ANNOTATION
 /begin REF_MEASUREMENT IN_CAN0.RxFrames.VhData200_VTT5._State.Task40ms IN_CAN0.RxFrames.VhData200_VTT5.State_DA_V25Dt.Task40ms IN_CAN0.RxFrames.VhData200_VTT5.State_DA_V26Dt.Task40ms IN_CAN0.RxFrames.VhData200_VTT5.State_DA_V27Dt.Task40ms IN_CAN0.RxFrames.VhData200_VTT5.State_DA_V28Dt.Task40ms IN_CAN0.RxFrames.VhData200_VTT5.State_DA_V29Dt.Task40ms IN_CAN0.RxFrames.VhData200_VTT5.State_DA_V30Dt.Task40ms IN_CAN0.RxFrames.VhData200_VTT5.SymbolID_DA_V25Dt.Task40ms IN_CAN0.RxFrames.VhData200_VTT5.SymbolID_DA_V26Dt.Task40ms IN_CAN0.RxFrames.VhData200_VTT5.SymbolID_DA_V27Dt.Task40ms IN_CAN0.RxFrames.VhData200_VTT5.SymbolID_DA_V28Dt.Task40ms IN_CAN0.RxFrames.VhData200_VTT5.SymbolID_DA_V29Dt.Task40ms IN_CAN0.RxFrames.VhData200_VTT5.SymbolID_DA_V30Dt.Task40ms OUT_CAN0.RxFrames.VhData200_VTT5._Ena.Task40ms /end REF_MEASUREMENT
/end GROUP
/begin GROUP SYSTEM.CAN0.VhData200_VTT4 "VhData200_VTT4"
 /begin ANNOTATION ANNOTATION_LABEL "Instance" ANNOTATION_ORIGIN "Group" /begin ANNOTATION_TEXT "21" /end ANNOTATION_TEXT /end ANNOTATION
 /begin ANNOTATION ANNOTATION_LABEL "TaskCycleTime" ANNOTATION_ORIGIN "Group" /begin ANNOTATION_TEXT "0" /end ANNOTATION_TEXT /end ANNOTATION
 /begin ANNOTATION ANNOTATION_LABEL "TimeResolution" ANNOTATION_ORIGIN "Group" /begin ANNOTATION_TEXT "0" /end ANNOTATION_TEXT /end ANNOTATION
 /begin REF_MEASUREMENT IN_CAN0.RxFrames.VhData200_VTT4._State.Task40ms IN_CAN0.RxFrames.VhData200_VTT4.State_DA_V19Dt.Task40ms IN_CAN0.RxFrames.VhData200_VTT4.State_DA_V20Dt.Task40ms IN_CAN0.RxFrames.VhData200_VTT4.State_DA_V21Dt.Task40ms IN_CAN0.RxFrames.VhData200_VTT4.State_DA_V22Dt.Task40ms IN_CAN0.RxFrames.VhData200_VTT4.State_DA_V23Dt.Task40ms IN_CAN0.RxFrames.VhData200_VTT4.State_DA_V24Dt.Task40ms IN_CAN0.RxFrames.VhData200_VTT4.SymbolID_DA_V19Dt.Task40ms IN_CAN0.RxFrames.VhData200_VTT4.SymbolID_DA_V20Dt.Task40ms IN_CAN0.RxFrames.VhData200_VTT4.SymbolID_DA_V21Dt.Task40ms IN_CAN0.RxFrames.VhData200_VTT4.SymbolID_DA_V22Dt.Task40ms IN_CAN0.RxFrames.VhData200_VTT4.SymbolID_DA_V23Dt.Task40ms IN_CAN0.RxFrames.VhData200_VTT4.SymbolID_DA_V24Dt.Task40ms OUT_CAN0.RxFrames.VhData200_VTT4._Ena.Task40ms /end REF_MEASUREMENT
/end GROUP
/begin GROUP SYSTEM.CAN0.VhData200_VTT3 "VhData200_VTT3"
 /begin ANNOTATION ANNOTATION_LABEL "Instance" ANNOTATION_ORIGIN "Group" /begin ANNOTATION_TEXT "22" /end ANNOTATION_TEXT /end ANNOTATION
 /begin ANNOTATION ANNOTATION_LABEL "TaskCycleTime" ANNOTATION_ORIGIN "Group" /begin ANNOTATION_TEXT "0" /end ANNOTATION_TEXT /end ANNOTATION
 /begin ANNOTATION ANNOTATION_LABEL "TimeResolution" ANNOTATION_ORIGIN "Group" /begin ANNOTATION_TEXT "0" /end ANNOTATION_TEXT /end ANNOTATION
 /begin REF_MEASUREMENT IN_CAN0.RxFrames.VhData200_VTT3._State.Task40ms IN_CAN0.RxFrames.VhData200_VTT3.State_DA_V13Dt.Task40ms IN_CAN0.RxFrames.VhData200_VTT3.State_DA_V14Dt.Task40ms IN_CAN0.RxFrames.VhData200_VTT3.State_DA_V15Dt.Task40ms IN_CAN0.RxFrames.VhData200_VTT3.State_DA_V16Dt.Task40ms IN_CAN0.RxFrames.VhData200_VTT3.State_DA_V17Dt.Task40ms IN_CAN0.RxFrames.VhData200_VTT3.State_DA_V18Dt.Task40ms IN_CAN0.RxFrames.VhData200_VTT3.SymbolID_DA_V13Dt.Task40ms IN_CAN0.RxFrames.VhData200_VTT3.SymbolID_DA_V14Dt.Task40ms IN_CAN0.RxFrames.VhData200_VTT3.SymbolID_DA_V15Dt.Task40ms IN_CAN0.RxFrames.VhData200_VTT3.SymbolID_DA_V16Dt.Task40ms IN_CAN0.RxFrames.VhData200_VTT3.SymbolID_DA_V17Dt.Task40ms IN_CAN0.RxFrames.VhData200_VTT3.SymbolID_DA_V18Dt.Task40ms OUT_CAN0.RxFrames.VhData200_VTT3._Ena.Task40ms /end REF_MEASUREMENT
/end GROUP
/begin GROUP SYSTEM.CAN0.VhData200_VTT2 "VhData200_VTT2"
 /begin ANNOTATION ANNOTATION_LABEL "Instance" ANNOTATION_ORIGIN "Group" /begin ANNOTATION_TEXT "23" /end ANNOTATION_TEXT /end ANNOTATION
 /begin ANNOTATION ANNOTATION_LABEL "TaskCycleTime" ANNOTATION_ORIGIN "Group" /begin ANNOTATION_TEXT "0" /end ANNOTATION_TEXT /end ANNOTATION
 /begin ANNOTATION ANNOTATION_LABEL "TimeResolution" ANNOTATION_ORIGIN "Group" /begin ANNOTATION_TEXT "0" /end ANNOTATION_TEXT /end ANNOTATION
 /begin REF_MEASUREMENT IN_CAN0.RxFrames.VhData200_VTT2._State.Task40ms IN_CAN0.RxFrames.VhData200_VTT2.State_DA_V07Dt.Task40ms IN_CAN0.RxFrames.VhData200_VTT2.State_DA_V08Dt.Task40ms IN_CAN0.RxFrames.VhData200_VTT2.State_DA_V09Dt.Task40ms IN_CAN0.RxFrames.VhData200_VTT2.State_DA_V10Dt.Task40ms IN_CAN0.RxFrames.VhData200_VTT2.State_DA_V11Dt.Task40ms IN_CAN0.RxFrames.VhData200_VTT2.State_DA_V12Dt.Task40ms IN_CAN0.RxFrames.VhData200_VTT2.SymbolID_DA_V07Dt.Task40ms IN_CAN0.RxFrames.VhData200_VTT2.SymbolID_DA_V08Dt.Task40ms IN_CAN0.RxFrames.VhData200_VTT2.SymbolID_DA_V09Dt.Task40ms IN_CAN0.RxFrames.VhData200_VTT2.SymbolID_DA_V10Dt.Task40ms IN_CAN0.RxFrames.VhData200_VTT2.SymbolID_DA_V11Dt.Task40ms IN_CAN0.RxFrames.VhData200_VTT2.SymbolID_DA_V12Dt.Task40ms OUT_CAN0.RxFrames.VhData200_VTT2._Ena.Task40ms /end REF_MEASUREMENT
/end GROUP
/begin GROUP SYSTEM.CAN0.VhData200_VTT1 "VhData200_VTT1"
 /begin ANNOTATION ANNOTATION_LABEL "Instance" ANNOTATION_ORIGIN "Group" /begin ANNOTATION_TEXT "24" /end ANNOTATION_TEXT /end ANNOTATION
 /begin ANNOTATION ANNOTATION_LABEL "TaskCycleTime" ANNOTATION_ORIGIN "Group" /begin ANNOTATION_TEXT "0" /end ANNOTATION_TEXT /end ANNOTATION
 /begin ANNOTATION ANNOTATION_LABEL "TimeResolution" ANNOTATION_ORIGIN "Group" /begin ANNOTATION_TEXT "0" /end ANNOTATION_TEXT /end ANNOTATION
 /begin REF_MEASUREMENT IN_CAN0.RxFrames.VhData200_VTT1._State.Task40ms IN_CAN0.RxFrames.VhData200_VTT1.State_DA_V01Dt.Task40ms IN_CAN0.RxFrames.VhData200_VTT1.State_DA_V02Dt.Task40ms IN_CAN0.RxFrames.VhData200_VTT1.State_DA_V03Dt.Task40ms IN_CAN0.RxFrames.VhData200_VTT1.State_DA_V04Dt.Task40ms IN_CAN0.RxFrames.VhData200_VTT1.State_DA_V05Dt.Task40ms IN_CAN0.RxFrames.VhData200_VTT1.State_DA_V06Dt.Task40ms IN_CAN0.RxFrames.VhData200_VTT1.SymbolID_DA_V01Dt.Task40ms IN_CAN0.RxFrames.VhData200_VTT1.SymbolID_DA_V02Dt.Task40ms IN_CAN0.RxFrames.VhData200_VTT1.SymbolID_DA_V03Dt.Task40ms IN_CAN0.RxFrames.VhData200_VTT1.SymbolID_DA_V04Dt.Task40ms IN_CAN0.RxFrames.VhData200_VTT1.SymbolID_DA_V05Dt.Task40ms IN_CAN0.RxFrames.VhData200_VTT1.SymbolID_DA_V06Dt.Task40ms OUT_CAN0.RxFrames.VhData200_VTT1._Ena.Task40ms /end REF_MEASUREMENT
/end GROUP
/begin GROUP SYSTEM.CAN0.VhData200_3 "VhData200_3"
 /begin ANNOTATION ANNOTATION_LABEL "Instance" ANNOTATION_ORIGIN "Group" /begin ANNOTATION_TEXT "25" /end ANNOTATION_TEXT /end ANNOTATION
 /begin ANNOTATION ANNOTATION_LABEL "TaskCycleTime" ANNOTATION_ORIGIN "Group" /begin ANNOTATION_TEXT "0" /end ANNOTATION_TEXT /end ANNOTATION
 /begin ANNOTATION ANNOTATION_LABEL "TimeResolution" ANNOTATION_ORIGIN "Group" /begin ANNOTATION_TEXT "0" /end ANNOTATION_TEXT /end ANNOTATION
 /begin REF_MEASUREMENT IN_CAN0.RxFrames.VhData200_3._State.Task100ms IN_CAN0.RxFrames.VhData200_3.NotificationLeftTextDt.Task100ms IN_CAN0.RxFrames.VhData200_3.NotificationRightTextDt.Task100ms IN_CAN0.RxFrames.VhData200_3.NotificationLeftColorDt.Task100ms IN_CAN0.RxFrames.VhData200_3.NotificationLeftStopSymbolDt.Task100ms IN_CAN0.RxFrames.VhData200_3.NotificationLeftSymbolDt.Task100ms IN_CAN0.RxFrames.VhData200_3.NotificationRightColorDt.Task100ms IN_CAN0.RxFrames.VhData200_3.NotificationRightStopSymbolDt.Task100ms IN_CAN0.RxFrames.VhData200_3.NotificationRightSymbolDt.Task100ms OUT_CAN0.RxFrames.VhData200_3._Ena.Task40ms /end REF_MEASUREMENT
/end GROUP
/begin GROUP SYSTEM.CAN0.VhData500 "VhData500"
 /begin ANNOTATION ANNOTATION_LABEL "Instance" ANNOTATION_ORIGIN "Group" /begin ANNOTATION_TEXT "26" /end ANNOTATION_TEXT /end ANNOTATION
 /begin ANNOTATION ANNOTATION_LABEL "TaskCycleTime" ANNOTATION_ORIGIN "Group" /begin ANNOTATION_TEXT "0" /end ANNOTATION_TEXT /end ANNOTATION
 /begin ANNOTATION ANNOTATION_LABEL "TimeResolution" ANNOTATION_ORIGIN "Group" /begin ANNOTATION_TEXT "0" /end ANNOTATION_TEXT /end ANNOTATION
 /begin REF_MEASUREMENT IN_CAN0.RxFrames.VhData500._State.Task1000ms IN_CAN0.RxFrames.VhData500.AvgConsumpDt.Task1000ms IN_CAN0.RxFrames.VhData500.FuelLitersDt.Task1000ms IN_CAN0.RxFrames.VhData500.OilLevelBargraphDt.Task1000ms IN_CAN0.RxFrames.VhData500.OilLevelDt.Task1000ms OUT_CAN0.RxFrames.VhData500._Ena.Task40ms /end REF_MEASUREMENT
/end GROUP
/begin GROUP SYSTEM.CAN0.VhData52_Diagnostic "VhData52_Diagnostic"
 /begin ANNOTATION ANNOTATION_LABEL "Instance" ANNOTATION_ORIGIN "Group" /begin ANNOTATION_TEXT "27" /end ANNOTATION_TEXT /end ANNOTATION
 /begin ANNOTATION ANNOTATION_LABEL "TaskCycleTime" ANNOTATION_ORIGIN "Group" /begin ANNOTATION_TEXT "0" /end ANNOTATION_TEXT /end ANNOTATION
 /begin ANNOTATION ANNOTATION_LABEL "TimeResolution" ANNOTATION_ORIGIN "Group" /begin ANNOTATION_TEXT "0" /end ANNOTATION_TEXT /end ANNOTATION
 /begin REF_MEASUREMENT IN_CAN0.RxFrames.VhData52_Diagnostic._State.Task1000ms IN_CAN0.RxFrames.VhData52_Diagnostic.DiagnosticSPNDt.Task1000ms IN_CAN0.RxFrames.VhData52_Diagnostic.DiagnosticTextIDDt.Task1000ms IN_CAN0.RxFrames.VhData52_Diagnostic.DiagnosticCurrentFailureDt.Task1000ms IN_CAN0.RxFrames.VhData52_Diagnostic.DiagnosticFMIDt.Task1000ms IN_CAN0.RxFrames.VhData52_Diagnostic.DiagnosticNumberFailuresDt.Task1000ms OUT_CAN0.RxFrames.VhData52_Diagnostic._Ena.Task40ms /end REF_MEASUREMENT
/end GROUP
/begin GROUP SYSTEM.CAN0.VhData1000_1 "VhData1000_1"
 /begin ANNOTATION ANNOTATION_LABEL "Instance" ANNOTATION_ORIGIN "Group" /begin ANNOTATION_TEXT "28" /end ANNOTATION_TEXT /end ANNOTATION
 /begin ANNOTATION ANNOTATION_LABEL "TaskCycleTime" ANNOTATION_ORIGIN "Group" /begin ANNOTATION_TEXT "0" /end ANNOTATION_TEXT /end ANNOTATION
 /begin ANNOTATION ANNOTATION_LABEL "TimeResolution" ANNOTATION_ORIGIN "Group" /begin ANNOTATION_TEXT "0" /end ANNOTATION_TEXT /end ANNOTATION
 /begin REF_MEASUREMENT IN_CAN0.RxFrames.VhData1000_1.TotalOdometerDt.Task1000ms IN_CAN0.RxFrames.VhData1000_1.TripmeterDt.Task1000ms IN_CAN0.RxFrames.VhData1000_1._State.Task1000ms OUT_CAN0.RxFrames.VhData1000_1._Ena.Task40ms /end REF_MEASUREMENT
/end GROUP
/begin GROUP SYSTEM.CAN0.ICHMI1CTRL "ICHMI1CTRL"
 /begin ANNOTATION ANNOTATION_LABEL "Instance" ANNOTATION_ORIGIN "Group" /begin ANNOTATION_TEXT "0" /end ANNOTATION_TEXT /end ANNOTATION
 /begin ANNOTATION ANNOTATION_LABEL "TaskCycleTime" ANNOTATION_ORIGIN "Group" /begin ANNOTATION_TEXT "0" /end ANNOTATION_TEXT /end ANNOTATION
 /begin ANNOTATION ANNOTATION_LABEL "TimeResolution" ANNOTATION_ORIGIN "Group" /begin ANNOTATION_TEXT "0" /end ANNOTATION_TEXT /end ANNOTATION
 /begin REF_MEASUREMENT IN_CAN0.RxFrames.ICHMI1CTRL._State.Task40ms IN_CAN0.RxFrames.ICHMI1CTRL.ICBargraphLftBhvrCtrl.Task40ms IN_CAN0.RxFrames.ICHMI1CTRL.ICBargraphLftLed1Ctrl.Task40ms IN_CAN0.RxFrames.ICHMI1CTRL.ICBargraphLftLed2Ctrl.Task40ms IN_CAN0.RxFrames.ICHMI1CTRL.ICBargraphLftLed3Ctrl.Task40ms IN_CAN0.RxFrames.ICHMI1CTRL.ICBargraphLftLed4Ctrl.Task40ms IN_CAN0.RxFrames.ICHMI1CTRL.ICBargraphLftLed5Ctrl.Task40ms IN_CAN0.RxFrames.ICHMI1CTRL.ICBargraphLftLed6Ctrl.Task40ms IN_CAN0.RxFrames.ICHMI1CTRL.ICBargraphLftLed7Ctrl.Task40ms IN_CAN0.RxFrames.ICHMI1CTRL.ICBargraphLftLed8Ctrl.Task40ms IN_CAN0.RxFrames.ICHMI1CTRL.ICBargraphRghtBhvrCtrl.Task40ms IN_CAN0.RxFrames.ICHMI1CTRL.ICBargraphRghtLed1Ctrl.Task40ms IN_CAN0.RxFrames.ICHMI1CTRL.ICBargraphRghtLed2Ctrl.Task40ms IN_CAN0.RxFrames.ICHMI1CTRL.ICBargraphRghtLed3Ctrl.Task40ms IN_CAN0.RxFrames.ICHMI1CTRL.ICBargraphRghtLed4Ctrl.Task40ms IN_CAN0.RxFrames.ICHMI1CTRL.ICBargraphRghtLed5Ctrl.Task40ms IN_CAN0.RxFrames.ICHMI1CTRL.ICBargraphRghtLed6Ctrl.Task40ms IN_CAN0.RxFrames.ICHMI1CTRL.ICBargraphRghtLed7Ctrl.Task40ms IN_CAN0.RxFrames.ICHMI1CTRL.ICBargraphRghtLed8Ctrl.Task40ms IN_CAN0.RxFrames.ICHMI1CTRL.ICTelltale01Ctrl.Task40ms IN_CAN0.RxFrames.ICHMI1CTRL.ICTelltale02Ctrl.Task40ms IN_CAN0.RxFrames.ICHMI1CTRL.ICTelltale03Ctrl.Task40ms IN_CAN0.RxFrames.ICHMI1CTRL.ICTelltale04Ctrl.Task40ms IN_CAN0.RxFrames.ICHMI1CTRL.ICTelltale05Ctrl.Task40ms IN_CAN0.RxFrames.ICHMI1CTRL.ICTelltale06Ctrl.Task40ms IN_CAN0.RxFrames.ICHMI1CTRL.ICTelltale07Ctrl.Task40ms IN_CAN0.RxFrames.ICHMI1CTRL.ICTelltale08Ctrl.Task40ms IN_CAN0.RxFrames.ICHMI1CTRL.ICTelltale09Ctrl.Task40ms IN_CAN0.RxFrames.ICHMI1CTRL.ICTelltale10Ctrl.Task40ms IN_CAN0.RxFrames.ICHMI1CTRL.ICTelltale11Ctrl.Task40ms IN_CAN0.RxFrames.ICHMI1CTRL.ICTelltale12Ctrl.Task40ms IN_CAN0.RxFrames.ICHMI1CTRL._State.Task100ms IN_CAN0.RxFrames.ICHMI1CTRL.ICSoundCtrl.Task100ms IN_CAN0.RxFrames.ICHMI1CTRL.ICSoundVlmCtrl.Task100ms OUT_CAN0.RxFrames.ICHMI1CTRL._Ena.Task40ms /end REF_MEASUREMENT
/end GROUP
/begin GROUP SYSTEM.CAN0.ICDATA1 "ICDATA1"
 /begin ANNOTATION ANNOTATION_LABEL "Instance" ANNOTATION_ORIGIN "Group" /begin ANNOTATION_TEXT "1" /end ANNOTATION_TEXT /end ANNOTATION
 /begin ANNOTATION ANNOTATION_LABEL "TaskCycleTime" ANNOTATION_ORIGIN "Group" /begin ANNOTATION_TEXT "0" /end ANNOTATION_TEXT /end ANNOTATION
 /begin ANNOTATION ANNOTATION_LABEL "TimeResolution" ANNOTATION_ORIGIN "Group" /begin ANNOTATION_TEXT "0" /end ANNOTATION_TEXT /end ANNOTATION
 /begin REF_MEASUREMENT OUT_CAN0.TxFrames.ICDATA1._Cycle.Task40ms OUT_CAN0.TxFrames.ICDATA1._Ena.Task40ms OUT_CAN0.TxFrames.ICDATA1.ICIntPhotosensorSts.Task200ms OUT_CAN0.TxFrames.ICDATA1.ICInTr15Sts.Task200ms /end REF_MEASUREMENT
/end GROUP
/begin GROUP SYSTEM.CAN0.ICOM1STS "ICOM1STS"
 /begin ANNOTATION ANNOTATION_LABEL "Instance" ANNOTATION_ORIGIN "Group" /begin ANNOTATION_TEXT "2" /end ANNOTATION_TEXT /end ANNOTATION
 /begin ANNOTATION ANNOTATION_LABEL "TaskCycleTime" ANNOTATION_ORIGIN "Group" /begin ANNOTATION_TEXT "0" /end ANNOTATION_TEXT /end ANNOTATION
 /begin ANNOTATION ANNOTATION_LABEL "TimeResolution" ANNOTATION_ORIGIN "Group" /begin ANNOTATION_TEXT "0" /end ANNOTATION_TEXT /end ANNOTATION
 /begin REF_MEASUREMENT OUT_CAN0.TxFrames.ICOM1STS._Cycle.Task40ms OUT_CAN0.TxFrames.ICOM1STS._Ena.Task40ms OUT_CAN0.TxFrames.ICOM1STS.ICOMSts.Task40ms OUT_CAN0.TxFrames.ICOM1STS.ICPMSts.Task40ms OUT_CAN0.TxFrames.ICOM1STS.ICAssetSts.Task100ms OUT_CAN0.TxFrames.ICOM1STS.ICSoundSts.Task100ms /end REF_MEASUREMENT
/end GROUP
/begin GROUP SYSTEM.CAN0.MFLs_01 "MFLs_01"
 /begin ANNOTATION ANNOTATION_LABEL "Instance" ANNOTATION_ORIGIN "Group" /begin ANNOTATION_TEXT "3" /end ANNOTATION_TEXT /end ANNOTATION
 /begin ANNOTATION ANNOTATION_LABEL "TaskCycleTime" ANNOTATION_ORIGIN "Group" /begin ANNOTATION_TEXT "0" /end ANNOTATION_TEXT /end ANNOTATION
 /begin ANNOTATION ANNOTATION_LABEL "TimeResolution" ANNOTATION_ORIGIN "Group" /begin ANNOTATION_TEXT "0" /end ANNOTATION_TEXT /end ANNOTATION
 /begin REF_MEASUREMENT IN_CAN0.TxFrames.MFLs_01._State.Task40ms OUT_CAN0.TxFrames.MFLs_01._Cycle.Task40ms OUT_CAN0.TxFrames.MFLs_01._Ena.Task40ms OUT_CAN0.TxFrames.MFLs_01.MFLSbyte1.Task40ms OUT_CAN0.TxFrames.MFLs_01.MFLSbyte2.Task40ms OUT_CAN0.TxFrames.MFLs_01.MFLSbyte3.Task40ms OUT_CAN0.TxFrames.MFLs_01.MFLSbyte4.Task40ms OUT_CAN0.TxFrames.MFLs_01.MFLSbyte5.Task40ms OUT_CAN0.TxFrames.MFLs_01.MFLSbyte6.Task40ms OUT_CAN0.TxFrames.MFLs_01.MFLSbyte7.Task40ms OUT_CAN0.TxFrames.MFLs_01.MFLSbyte8.Task40ms /end REF_MEASUREMENT
/end GROUP
/begin GROUP SYSTEM.CAN0.GRA_ACCs_01 "GRA_ACCs_01"
 /begin ANNOTATION ANNOTATION_LABEL "Instance" ANNOTATION_ORIGIN "Group" /begin ANNOTATION_TEXT "4" /end ANNOTATION_TEXT /end ANNOTATION
 /begin ANNOTATION ANNOTATION_LABEL "TaskCycleTime" ANNOTATION_ORIGIN "Group" /begin ANNOTATION_TEXT "0" /end ANNOTATION_TEXT /end ANNOTATION
 /begin ANNOTATION ANNOTATION_LABEL "TimeResolution" ANNOTATION_ORIGIN "Group" /begin ANNOTATION_TEXT "0" /end ANNOTATION_TEXT /end ANNOTATION
 /begin REF_MEASUREMENT IN_CAN0.TxFrames.GRA_ACCs_01._State.Task40ms OUT_CAN0.TxFrames.GRA_ACCs_01._Cycle.Task40ms OUT_CAN0.TxFrames.GRA_ACCs_01._Ena.Task40ms OUT_CAN0.TxFrames.GRA_ACCs_01.GRAbyte1.Task40ms OUT_CAN0.TxFrames.GRA_ACCs_01.GRAbyte2.Task40ms OUT_CAN0.TxFrames.GRA_ACCs_01.GRAbyte3.Task40ms OUT_CAN0.TxFrames.GRA_ACCs_01.GRAbyte4.Task40ms OUT_CAN0.TxFrames.GRA_ACCs_01.GRAbyte5.Task40ms OUT_CAN0.TxFrames.GRA_ACCs_01.GRAbyte6.Task40ms OUT_CAN0.TxFrames.GRA_ACCs_01.GRAbyte7.Task40ms OUT_CAN0.TxFrames.GRA_ACCs_01.GRAbyte8.Task40ms /end REF_MEASUREMENT
/end GROUP
/begin GROUP SYSTEM.CAN0.Sts50 "Sts50"
 /begin ANNOTATION ANNOTATION_LABEL "Instance" ANNOTATION_ORIGIN "Group" /begin ANNOTATION_TEXT "5" /end ANNOTATION_TEXT /end ANNOTATION
 /begin ANNOTATION ANNOTATION_LABEL "TaskCycleTime" ANNOTATION_ORIGIN "Group" /begin ANNOTATION_TEXT "0" /end ANNOTATION_TEXT /end ANNOTATION
 /begin ANNOTATION ANNOTATION_LABEL "TimeResolution" ANNOTATION_ORIGIN "Group" /begin ANNOTATION_TEXT "0" /end ANNOTATION_TEXT /end ANNOTATION
 /begin REF_MEASUREMENT OUT_CAN0.TxFrames.Sts50._Cycle.Task40ms OUT_CAN0.TxFrames.Sts50._Ena.Task40ms OUT_CAN0.TxFrames.Sts50.ICDISSVSts.Task50ms OUT_CAN0.TxFrames.Sts50.ICDISSVTransitionSts.Task50ms /end REF_MEASUREMENT
/end GROUP
/begin GROUP SYSTEM.CAN0.ICILL1STS "ICILL1STS"
 /begin ANNOTATION ANNOTATION_LABEL "Instance" ANNOTATION_ORIGIN "Group" /begin ANNOTATION_TEXT "0" /end ANNOTATION_TEXT /end ANNOTATION
 /begin ANNOTATION ANNOTATION_LABEL "TaskCycleTime" ANNOTATION_ORIGIN "Group" /begin ANNOTATION_TEXT "0" /end ANNOTATION_TEXT /end ANNOTATION
 /begin ANNOTATION ANNOTATION_LABEL "TimeResolution" ANNOTATION_ORIGIN "Group" /begin ANNOTATION_TEXT "0" /end ANNOTATION_TEXT /end ANNOTATION
 /begin REF_MEASUREMENT OUT_CAN0.TxFrames.ICILL1STS._Cycle.Task40ms OUT_CAN0.TxFrames.ICILL1STS._Ena.Task40ms OUT_CAN0.TxFrames.ICILL1STS.ICILLDispPWMSts.Task40ms OUT_CAN0.TxFrames.ICILL1STS.ICILLDispSts.Task40ms OUT_CAN0.TxFrames.ICILL1STS.ICILLDispTempSnsrSts.Task40ms /end REF_MEASUREMENT
/end GROUP
/begin GROUP SYSTEM.CAN0 "CAN0"
 /begin ANNOTATION ANNOTATION_LABEL "Instance" ANNOTATION_ORIGIN "Group" /begin ANNOTATION_TEXT "0" /end ANNOTATION_TEXT /end ANNOTATION
 /begin ANNOTATION ANNOTATION_LABEL "TaskCycleTime" ANNOTATION_ORIGIN "Group" /begin ANNOTATION_TEXT "0" /end ANNOTATION_TEXT /end ANNOTATION
 /begin ANNOTATION ANNOTATION_LABEL "TimeResolution" ANNOTATION_ORIGIN "Group" /begin ANNOTATION_TEXT "0" /end ANNOTATION_TEXT /end ANNOTATION
 /begin SUB_GROUP SYSTEM.CAN0.VhData50_Menu SYSTEM.CAN0.Ctrl50_ScrDA2 SYSTEM.CAN0.Ctrl50_ScrDA1 SYSTEM.CAN0.Ctrl50_FcnDA2 SYSTEM.CAN0.Ctrl50_FcnDA1 SYSTEM.CAN0.Ctrl50_SubView SYSTEM.CAN0.VhData50_Gauges SYSTEM.CAN0.GRA_UHRe_01 SYSTEM.CAN0.GRA_MFLe_01 SYSTEM.CAN0.VhData100_2 SYSTEM.CAN0.VhData100_1 SYSTEM.CAN0.VhData100_3 SYSTEM.CAN0.ICOM1CTRL SYSTEM.CAN0.VhData200_1 SYSTEM.CAN0.VhData200_2 SYSTEM.CAN0.VhData200_VTT8 SYSTEM.CAN0.ICILL1CTRL SYSTEM.CAN0.VhData200_VTT7 SYSTEM.CAN0.VhData200_VTT6 SYSTEM.CAN0.VhData200_VTT5 SYSTEM.CAN0.VhData200_VTT4 SYSTEM.CAN0.VhData200_VTT3 SYSTEM.CAN0.VhData200_VTT2 SYSTEM.CAN0.VhData200_VTT1 SYSTEM.CAN0.VhData200_3 SYSTEM.CAN0.VhData500 SYSTEM.CAN0.VhData52_Diagnostic SYSTEM.CAN0.VhData1000_1 SYSTEM.CAN0.ICHMI1CTRL SYSTEM.CAN0.ICDATA1 SYSTEM.CAN0.ICOM1STS SYSTEM.CAN0.MFLs_01 SYSTEM.CAN0.GRA_ACCs_01 SYSTEM.CAN0.Sts50 SYSTEM.CAN0.ICILL1STS /end SUB_GROUP
 /begin REF_MEASUREMENT IN_CAN0.f_CAN0busActivityState.Task40ms OUT_CAN0.f_CAN0MessageForwardingEnable.Task40ms /end REF_MEASUREMENT
/end GROUP
/begin GROUP SYSTEM.CAN1.Gateway_HRLFC "Gateway HRLFC"
 /begin ANNOTATION ANNOTATION_LABEL "Instance" ANNOTATION_ORIGIN "Group" /begin ANNOTATION_TEXT "1" /end ANNOTATION_TEXT /end ANNOTATION
 /begin ANNOTATION ANNOTATION_LABEL "TaskCycleTime" ANNOTATION_ORIGIN "Group" /begin ANNOTATION_TEXT "0" /end ANNOTATION_TEXT /end ANNOTATION
 /begin ANNOTATION ANNOTATION_LABEL "TimeResolution" ANNOTATION_ORIGIN "Group" /begin ANNOTATION_TEXT "0" /end ANNOTATION_TEXT /end ANNOTATION
 /begin REF_MEASUREMENT OUT_CAN1.GatewayHRLFC.Enable_TxCAN0.Task40ms OUT_CAN1.GatewayHRLFC.MessageEnable.Task40ms /end REF_MEASUREMENT
/end GROUP
/begin GROUP SYSTEM.CAN1.Gateway_DPFC1 "Gateway DPFC1"
 /begin ANNOTATION ANNOTATION_LABEL "Instance" ANNOTATION_ORIGIN "Group" /begin ANNOTATION_TEXT "2" /end ANNOTATION_TEXT /end ANNOTATION
 /begin ANNOTATION ANNOTATION_LABEL "TaskCycleTime" ANNOTATION_ORIGIN "Group" /begin ANNOTATION_TEXT "0" /end ANNOTATION_TEXT /end ANNOTATION
 /begin ANNOTATION ANNOTATION_LABEL "TimeResolution" ANNOTATION_ORIGIN "Group" /begin ANNOTATION_TEXT "0" /end ANNOTATION_TEXT /end ANNOTATION
 /begin REF_MEASUREMENT OUT_CAN1.GatewayDPFC1.Enable_TxCAN0.Task40ms OUT_CAN1.GatewayDPFC1.MessageEnable.Task40ms /end REF_MEASUREMENT
/end GROUP
/begin GROUP SYSTEM.CAN1.Gateway_SCR "Gateway SCR"
 /begin ANNOTATION ANNOTATION_LABEL "Instance" ANNOTATION_ORIGIN "Group" /begin ANNOTATION_TEXT "3" /end ANNOTATION_TEXT /end ANNOTATION
 /begin ANNOTATION ANNOTATION_LABEL "TaskCycleTime" ANNOTATION_ORIGIN "Group" /begin ANNOTATION_TEXT "0" /end ANNOTATION_TEXT /end ANNOTATION
 /begin ANNOTATION ANNOTATION_LABEL "TimeResolution" ANNOTATION_ORIGIN "Group" /begin ANNOTATION_TEXT "0" /end ANNOTATION_TEXT /end ANNOTATION
 /begin REF_MEASUREMENT OUT_CAN1.GatewaySCR.Enable_TxCAN0.Task40ms OUT_CAN1.GatewaySCR.MessageEnable.Task40ms /end REF_MEASUREMENT
/end GROUP
/begin GROUP SYSTEM.CAN1.Gateway_A1SCRDSI1 "Gateway A1SCRDSI1"
 /begin ANNOTATION ANNOTATION_LABEL "Instance" ANNOTATION_ORIGIN "Group" /begin ANNOTATION_TEXT "0" /end ANNOTATION_TEXT /end ANNOTATION
 /begin ANNOTATION ANNOTATION_LABEL "TaskCycleTime" ANNOTATION_ORIGIN "Group" /begin ANNOTATION_TEXT "0" /end ANNOTATION_TEXT /end ANNOTATION
 /begin ANNOTATION ANNOTATION_LABEL "TimeResolution" ANNOTATION_ORIGIN "Group" /begin ANNOTATION_TEXT "0" /end ANNOTATION_TEXT /end ANNOTATION
 /begin REF_MEASUREMENT OUT_CAN1.GatewayA1SCRDSI1.Enable_TxCAN0.Task40ms OUT_CAN1.GatewayA1SCRDSI1.MessageEnable.Task40ms /end REF_MEASUREMENT
/end GROUP
/begin GROUP SYSTEM.CAN1 "CAN1"
 /begin ANNOTATION ANNOTATION_LABEL "Instance" ANNOTATION_ORIGIN "Group" /begin ANNOTATION_TEXT "0" /end ANNOTATION_TEXT /end ANNOTATION
 /begin ANNOTATION ANNOTATION_LABEL "TaskCycleTime" ANNOTATION_ORIGIN "Group" /begin ANNOTATION_TEXT "0" /end ANNOTATION_TEXT /end ANNOTATION
 /begin ANNOTATION ANNOTATION_LABEL "TimeResolution" ANNOTATION_ORIGIN "Group" /begin ANNOTATION_TEXT "0" /end ANNOTATION_TEXT /end ANNOTATION
 /begin SUB_GROUP SYSTEM.CAN1.Gateway_HRLFC SYSTEM.CAN1.Gateway_DPFC1 SYSTEM.CAN1.Gateway_SCR SYSTEM.CAN1.Gateway_A1SCRDSI1 /end SUB_GROUP
 /begin REF_MEASUREMENT OUT_CAN1.f_CAN1MessageForwardingEnable.Task40ms /end REF_MEASUREMENT
/end GROUP
/begin GROUP SYSTEM.HMI.HMICtrlGeneral2 "HMICtrlGeneral2"
 /begin ANNOTATION ANNOTATION_LABEL "Instance" ANNOTATION_ORIGIN "Group" /begin ANNOTATION_TEXT "1" /end ANNOTATION_TEXT /end ANNOTATION
 /begin ANNOTATION ANNOTATION_LABEL "TaskCycleTime" ANNOTATION_ORIGIN "Group" /begin ANNOTATION_TEXT "0" /end ANNOTATION_TEXT /end ANNOTATION
 /begin ANNOTATION ANNOTATION_LABEL "TimeResolution" ANNOTATION_ORIGIN "Group" /begin ANNOTATION_TEXT "0" /end ANNOTATION_TEXT /end ANNOTATION
 /begin REF_MEASUREMENT OUT_HMI.HMICtrlGeneral2.SceneEnBackground.Task50ms OUT_HMI.HMICtrlGeneral2.SceneEnBrakePressureLeft.Task50ms OUT_HMI.HMICtrlGeneral2.SceneEnBrakePressureRight.Task50ms OUT_HMI.HMICtrlGeneral2.SceneEnConsumptionLeft.Task50ms OUT_HMI.HMICtrlGeneral2.SceneEnConsumptionRight.Task50ms OUT_HMI.HMICtrlGeneral2.SceneEnCoolantTemperature.Task50ms OUT_HMI.HMICtrlGeneral2.SceneEnDiagnostics.Task50ms OUT_HMI.HMICtrlGeneral2.SceneEnDigitalSpdBottom.Task50ms OUT_HMI.HMICtrlGeneral2.SceneEnDigitalSpdCenterMenu.Task50ms OUT_HMI.HMICtrlGeneral2.SceneEnDigitalSpdSingleGauge.Task50ms OUT_HMI.HMICtrlGeneral2.SceneEnDigitalSpdTop.Task50ms OUT_HMI.HMICtrlGeneral2.SceneEnDriversGrade.Task50ms OUT_HMI.HMICtrlGeneral2.SceneEnGear.Task50ms OUT_HMI.HMICtrlGeneral2.SceneEnNotificationLeft.Task50ms OUT_HMI.HMICtrlGeneral2.SceneEnNotificationRight.Task50ms OUT_HMI.HMICtrlGeneral2.SceneEnOdometer.Task50ms OUT_HMI.HMICtrlGeneral2.SceneEnOilInfoLeft.Task50ms OUT_HMI.HMICtrlGeneral2.SceneEnOilInfoRight.Task50ms OUT_HMI.HMICtrlGeneral2.SceneEnRpmGaugeBig.Task50ms OUT_HMI.HMICtrlGeneral2.SceneEnRpmGaugeSmall.Task50ms OUT_HMI.HMICtrlGeneral2.SceneEnTripmeter.Task50ms OUT_HMI.HMICtrlGeneral2.SceneEnVhSpdGauge.Task50ms OUT_HMI.HMICtrlGeneral2.SceneEnVTTG1.Task50ms OUT_HMI.HMICtrlGeneral2.SceneEnVTTG2.Task50ms OUT_HMI.HMICtrlGeneral2.SceneEnVTTG3.Task50ms OUT_HMI.HMICtrlGeneral2.SceneEnVTTG4.Task50ms OUT_HMI.HMICtrlGeneral2.SceneEnVTTG5.Task50ms OUT_HMI.HMICtrlGeneral2.SceneEnVTTG6.Task50ms OUT_HMI.HMICtrlGeneral2._Ena.Task100ms /end REF_MEASUREMENT
/end GROUP
/begin GROUP SYSTEM.HMI.HMIDataFcnBackground "HMIDataFcnBackground"
 /begin ANNOTATION ANNOTATION_LABEL "Instance" ANNOTATION_ORIGIN "Group" /begin ANNOTATION_TEXT "2" /end ANNOTATION_TEXT /end ANNOTATION
 /begin ANNOTATION ANNOTATION_LABEL "TaskCycleTime" ANNOTATION_ORIGIN "Group" /begin ANNOTATION_TEXT "0" /end ANNOTATION_TEXT /end ANNOTATION
 /begin ANNOTATION ANNOTATION_LABEL "TimeResolution" ANNOTATION_ORIGIN "Group" /begin ANNOTATION_TEXT "0" /end ANNOTATION_TEXT /end ANNOTATION
 /begin REF_MEASUREMENT OUT_HMI.HMIDataFcnBackground._Ena.Task50ms OUT_HMI.HMIDataFcnBackground.BackgroundGlowColor.Task50ms OUT_HMI.HMIDataFcnBackground.BackgroundGoodbyeRqst.Task50ms OUT_HMI.HMIDataFcnBackground.BackgroundWelcomeRqst.Task50ms /end REF_MEASUREMENT
/end GROUP
/begin GROUP SYSTEM.HMI.HMIDataFcnBrakePressure "HMIDataFcnBrakePressure"
 /begin ANNOTATION ANNOTATION_LABEL "Instance" ANNOTATION_ORIGIN "Group" /begin ANNOTATION_TEXT "3" /end ANNOTATION_TEXT /end ANNOTATION
 /begin ANNOTATION ANNOTATION_LABEL "TaskCycleTime" ANNOTATION_ORIGIN "Group" /begin ANNOTATION_TEXT "0" /end ANNOTATION_TEXT /end ANNOTATION
 /begin ANNOTATION ANNOTATION_LABEL "TimeResolution" ANNOTATION_ORIGIN "Group" /begin ANNOTATION_TEXT "0" /end ANNOTATION_TEXT /end ANNOTATION
 /begin REF_MEASUREMENT OUT_HMI.HMIDataFcnBrakePressure._Ena.Task50ms OUT_HMI.HMIDataFcnBrakePressure.BrakePressureVal1.Task1000ms OUT_HMI.HMIDataFcnBrakePressure.BrakePressureVal2.Task1000ms OUT_HMI.HMIDataFcnBrakePressure.BrakePressureVal3.Task1000ms OUT_HMI.HMIDataFcnBrakePressure.BrakePressureBarVal1.Task1000ms OUT_HMI.HMIDataFcnBrakePressure.BrakePressureBarVal2.Task1000ms OUT_HMI.HMIDataFcnBrakePressure.BrakePressureBarVal3.Task1000ms OUT_HMI.HMIDataFcnBrakePressure.HMIElm01Ok.Task1000ms OUT_HMI.HMIDataFcnBrakePressure.HMIElm02Ok.Task1000ms OUT_HMI.HMIDataFcnBrakePressure.HMIElm04Ok.Task1000ms OUT_HMI.HMIDataFcnBrakePressure.HMIElm05Ok.Task1000ms OUT_HMI.HMIDataFcnBrakePressure.HMIElm07Ok.Task1000ms OUT_HMI.HMIDataFcnBrakePressure.HMIElm08Ok.Task1000ms OUT_HMI.HMIDataFcnBrakePressure.PressureUnit.Task1000ms /end REF_MEASUREMENT
/end GROUP
/begin GROUP SYSTEM.HMI.HMIDataFcnConsumption "HMIDataFcnConsumption"
 /begin ANNOTATION ANNOTATION_LABEL "Instance" ANNOTATION_ORIGIN "Group" /begin ANNOTATION_TEXT "4" /end ANNOTATION_TEXT /end ANNOTATION
 /begin ANNOTATION ANNOTATION_LABEL "TaskCycleTime" ANNOTATION_ORIGIN "Group" /begin ANNOTATION_TEXT "0" /end ANNOTATION_TEXT /end ANNOTATION
 /begin ANNOTATION ANNOTATION_LABEL "TimeResolution" ANNOTATION_ORIGIN "Group" /begin ANNOTATION_TEXT "0" /end ANNOTATION_TEXT /end ANNOTATION
 /begin REF_MEASUREMENT OUT_HMI.HMIDataFcnConsumption._Ena.Task50ms OUT_HMI.HMIDataFcnConsumption.AvgConsumpVal.Task1000ms OUT_HMI.HMIDataFcnConsumption.FuelLitersVal.Task1000ms OUT_HMI.HMIDataFcnConsumption.InstantConsumpVal.Task1000ms OUT_HMI.HMIDataFcnConsumption.AvgConsumpUnitVal.Task1000ms OUT_HMI.HMIDataFcnConsumption.HMIElm01Ok.Task1000ms OUT_HMI.HMIDataFcnConsumption.HMIElm03Ok.Task1000ms OUT_HMI.HMIDataFcnConsumption.HMIElm05Ok.Task1000ms OUT_HMI.HMIDataFcnConsumption.InstConsumpUnitVal.Task1000ms /end REF_MEASUREMENT
/end GROUP
/begin GROUP SYSTEM.HMI.HMIDataFcnCoolantTemp "HMIDataFcnCoolantTemp"
 /begin ANNOTATION ANNOTATION_LABEL "Instance" ANNOTATION_ORIGIN "Group" /begin ANNOTATION_TEXT "5" /end ANNOTATION_TEXT /end ANNOTATION
 /begin ANNOTATION ANNOTATION_LABEL "TaskCycleTime" ANNOTATION_ORIGIN "Group" /begin ANNOTATION_TEXT "0" /end ANNOTATION_TEXT /end ANNOTATION
 /begin ANNOTATION ANNOTATION_LABEL "TimeResolution" ANNOTATION_ORIGIN "Group" /begin ANNOTATION_TEXT "0" /end ANNOTATION_TEXT /end ANNOTATION
 /begin REF_MEASUREMENT OUT_HMI.HMIDataFcnCoolantTemp._Ena.Task50ms OUT_HMI.HMIDataFcnCoolantTemp.CoolantTemp.Task1000ms OUT_HMI.HMIDataFcnCoolantTemp.CoolantTempBargraphVal.Task1000ms OUT_HMI.HMIDataFcnCoolantTemp.HMIElm01Ok.Task1000ms OUT_HMI.HMIDataFcnCoolantTemp.HMIElm02Ok.Task1000ms /end REF_MEASUREMENT
/end GROUP
/begin GROUP SYSTEM.HMI.HMIDataFcnDiagnostics "HMIDataFcnDiagnostics"
 /begin ANNOTATION ANNOTATION_LABEL "Instance" ANNOTATION_ORIGIN "Group" /begin ANNOTATION_TEXT "6" /end ANNOTATION_TEXT /end ANNOTATION
 /begin ANNOTATION ANNOTATION_LABEL "TaskCycleTime" ANNOTATION_ORIGIN "Group" /begin ANNOTATION_TEXT "0" /end ANNOTATION_TEXT /end ANNOTATION
 /begin ANNOTATION ANNOTATION_LABEL "TimeResolution" ANNOTATION_ORIGIN "Group" /begin ANNOTATION_TEXT "0" /end ANNOTATION_TEXT /end ANNOTATION
 /begin REF_MEASUREMENT OUT_HMI.HMIDataFcnDiagnostics._Ena.Task50ms OUT_HMI.HMIDataFcnDiagnostics.DiagnosticSPNDtVal.Task1000ms OUT_HMI.HMIDataFcnDiagnostics.DiagnosticTextIDVal.Task1000ms OUT_HMI.HMIDataFcnDiagnostics.DiagnosticCurrentFailureVal.Task1000ms OUT_HMI.HMIDataFcnDiagnostics.DiagnosticFMIDtVal.Task1000ms OUT_HMI.HMIDataFcnDiagnostics.DiagnosticNumberFailuresVal.Task1000ms /end REF_MEASUREMENT
/end GROUP
/begin GROUP SYSTEM.HMI.HMIDataFcnDriversGrade "HMIDataFcnDriversGrade"
 /begin ANNOTATION ANNOTATION_LABEL "Instance" ANNOTATION_ORIGIN "Group" /begin ANNOTATION_TEXT "7" /end ANNOTATION_TEXT /end ANNOTATION
 /begin ANNOTATION ANNOTATION_LABEL "TaskCycleTime" ANNOTATION_ORIGIN "Group" /begin ANNOTATION_TEXT "0" /end ANNOTATION_TEXT /end ANNOTATION
 /begin ANNOTATION ANNOTATION_LABEL "TimeResolution" ANNOTATION_ORIGIN "Group" /begin ANNOTATION_TEXT "0" /end ANNOTATION_TEXT /end ANNOTATION
 /begin REF_MEASUREMENT OUT_HMI.HMIDataFcnDriversGrade._Ena.Task50ms /end REF_MEASUREMENT
/end GROUP
/begin GROUP SYSTEM.HMI.HMIDataFcnESpdGauge "HMIDataFcnESpdGauge"
 /begin ANNOTATION ANNOTATION_LABEL "Instance" ANNOTATION_ORIGIN "Group" /begin ANNOTATION_TEXT "8" /end ANNOTATION_TEXT /end ANNOTATION
 /begin ANNOTATION ANNOTATION_LABEL "TaskCycleTime" ANNOTATION_ORIGIN "Group" /begin ANNOTATION_TEXT "0" /end ANNOTATION_TEXT /end ANNOTATION
 /begin ANNOTATION ANNOTATION_LABEL "TimeResolution" ANNOTATION_ORIGIN "Group" /begin ANNOTATION_TEXT "0" /end ANNOTATION_TEXT /end ANNOTATION
 /begin REF_MEASUREMENT OUT_HMI.HMIDataFcnESpdGauge.EngineSpdRpm.Task50ms OUT_HMI.HMIDataFcnEngSpdGauge._Ena.Task50ms OUT_HMI.HMIDataFcnESpdGauge.EngineSpdGreenZone.Task50ms OUT_HMI.HMIDataFcnESpdGauge.EngineSpdRedZone.Task50ms OUT_HMI.HMIDataFcnESpdGauge.EngineSpdYellowZone.Task50ms /end REF_MEASUREMENT
/end GROUP
/begin GROUP SYSTEM.HMI.HMIDataFcnGear "HMIDataFcnGear"
 /begin ANNOTATION ANNOTATION_LABEL "Instance" ANNOTATION_ORIGIN "Group" /begin ANNOTATION_TEXT "9" /end ANNOTATION_TEXT /end ANNOTATION
 /begin ANNOTATION ANNOTATION_LABEL "TaskCycleTime" ANNOTATION_ORIGIN "Group" /begin ANNOTATION_TEXT "0" /end ANNOTATION_TEXT /end ANNOTATION
 /begin ANNOTATION ANNOTATION_LABEL "TimeResolution" ANNOTATION_ORIGIN "Group" /begin ANNOTATION_TEXT "0" /end ANNOTATION_TEXT /end ANNOTATION
 /begin REF_MEASUREMENT OUT_HMI.HMIDataFcnGear._Ena.Task50ms OUT_HMI.HMIDataFcnGear.CurrentGear.Task100ms OUT_HMI.HMIDataFcnGear.GearMode.Task100ms OUT_HMI.HMIDataFcnGear.RecommendedGear.Task100ms /end REF_MEASUREMENT
/end GROUP
/begin GROUP SYSTEM.HMI.HMIDataFcnNotificationLeft "HMIDataFcnNotificationLeft"
 /begin ANNOTATION ANNOTATION_LABEL "Instance" ANNOTATION_ORIGIN "Group" /begin ANNOTATION_TEXT "10" /end ANNOTATION_TEXT /end ANNOTATION
 /begin ANNOTATION ANNOTATION_LABEL "TaskCycleTime" ANNOTATION_ORIGIN "Group" /begin ANNOTATION_TEXT "0" /end ANNOTATION_TEXT /end ANNOTATION
 /begin ANNOTATION ANNOTATION_LABEL "TimeResolution" ANNOTATION_ORIGIN "Group" /begin ANNOTATION_TEXT "0" /end ANNOTATION_TEXT /end ANNOTATION
 /begin REF_MEASUREMENT OUT_HMI.HMIDataFcnNotificationLeft._Ena.Task50ms OUT_HMI.HMIDataFcnNotificationLeft.NotificationLeftTextVal.Task100ms OUT_HMI.HMIDataFcnNotificationLeft.NotificationLeftColorVal.Task100ms OUT_HMI.HMIDataFcnNotificationLeft.NotificationLeftStopSymbolVal.Task100ms OUT_HMI.HMIDataFcnNotificationLeft.NotificationLeftSymbolVal.Task100ms /end REF_MEASUREMENT
/end GROUP
/begin GROUP SYSTEM.HMI.HMIDataFcnNotificationRight "HMIDataFcnNotificationRight"
 /begin ANNOTATION ANNOTATION_LABEL "Instance" ANNOTATION_ORIGIN "Group" /begin ANNOTATION_TEXT "11" /end ANNOTATION_TEXT /end ANNOTATION
 /begin ANNOTATION ANNOTATION_LABEL "TaskCycleTime" ANNOTATION_ORIGIN "Group" /begin ANNOTATION_TEXT "0" /end ANNOTATION_TEXT /end ANNOTATION
 /begin ANNOTATION ANNOTATION_LABEL "TimeResolution" ANNOTATION_ORIGIN "Group" /begin ANNOTATION_TEXT "0" /end ANNOTATION_TEXT /end ANNOTATION
 /begin REF_MEASUREMENT OUT_HMI.HMIDataFcnNotificationRight._Ena.Task50ms OUT_HMI.HMIDataFcnNotificationRight.NotificationRightTextVal.Task100ms OUT_HMI.HMIDataFcnNotificationRight.NotificationRightColorVal.Task100ms OUT_HMI.HMIDataFcnNotificationRight.NotificationRightStopSymbolVal.Task100ms OUT_HMI.HMIDataFcnNotificationRight.NotificationRightSymbolVal.Task100ms /end REF_MEASUREMENT
/end GROUP
/begin GROUP SYSTEM.HMI.HMIDataFcnOdometer "HMIDataFcnOdometer"
 /begin ANNOTATION ANNOTATION_LABEL "Instance" ANNOTATION_ORIGIN "Group" /begin ANNOTATION_TEXT "12" /end ANNOTATION_TEXT /end ANNOTATION
 /begin ANNOTATION ANNOTATION_LABEL "TaskCycleTime" ANNOTATION_ORIGIN "Group" /begin ANNOTATION_TEXT "0" /end ANNOTATION_TEXT /end ANNOTATION
 /begin ANNOTATION ANNOTATION_LABEL "TimeResolution" ANNOTATION_ORIGIN "Group" /begin ANNOTATION_TEXT "0" /end ANNOTATION_TEXT /end ANNOTATION
 /begin REF_MEASUREMENT OUT_HMI.HMIDataFcnOdometer._Ena.Task50ms OUT_HMI.HMIDataFcnOdometer.TotalOdometer.Task1000ms OUT_HMI.HMIDataFcnOdometer.DistanceUnit.Task1000ms /end REF_MEASUREMENT
/end GROUP
/begin GROUP SYSTEM.HMI.HMIDataFcnOilInfo "HMIDataFcnOilInfo"
 /begin ANNOTATION ANNOTATION_LABEL "Instance" ANNOTATION_ORIGIN "Group" /begin ANNOTATION_TEXT "13" /end ANNOTATION_TEXT /end ANNOTATION
 /begin ANNOTATION ANNOTATION_LABEL "TaskCycleTime" ANNOTATION_ORIGIN "Group" /begin ANNOTATION_TEXT "0" /end ANNOTATION_TEXT /end ANNOTATION
 /begin ANNOTATION ANNOTATION_LABEL "TimeResolution" ANNOTATION_ORIGIN "Group" /begin ANNOTATION_TEXT "0" /end ANNOTATION_TEXT /end ANNOTATION
 /begin REF_MEASUREMENT OUT_HMI.HMIDataFcnOilInfo._Ena.Task50ms OUT_HMI.HMIDataFcnOilInfo.HMIElm01Ok.Task1000ms OUT_HMI.HMIDataFcnOilInfo.HMIElm03Ok.Task1000ms OUT_HMI.HMIDataFcnOilInfo.HMIElm04Ok.Task1000ms OUT_HMI.HMIDataFcnOilInfo.OilLevelBargraphVal.Task1000ms OUT_HMI.HMIDataFcnOilInfo.OilLevelVal.Task1000ms OUT_HMI.HMIDataFcnOilInfo.OilPressureBargraphVal.Task1000ms /end REF_MEASUREMENT
/end GROUP
/begin GROUP SYSTEM.HMI.HMIDataFcnTripmeter "HMIDataFcnTripmeter"
 /begin ANNOTATION ANNOTATION_LABEL "Instance" ANNOTATION_ORIGIN "Group" /begin ANNOTATION_TEXT "14" /end ANNOTATION_TEXT /end ANNOTATION
 /begin ANNOTATION ANNOTATION_LABEL "TaskCycleTime" ANNOTATION_ORIGIN "Group" /begin ANNOTATION_TEXT "0" /end ANNOTATION_TEXT /end ANNOTATION
 /begin ANNOTATION ANNOTATION_LABEL "TimeResolution" ANNOTATION_ORIGIN "Group" /begin ANNOTATION_TEXT "0" /end ANNOTATION_TEXT /end ANNOTATION
 /begin REF_MEASUREMENT OUT_HMI.HMIDataFcnTripmeter._Ena.Task50ms OUT_HMI.HMIDataFcnTripmeter.Tripmeter.Task1000ms OUT_HMI.HMIDataFcnTripmeter.DistanceUnit.Task1000ms /end REF_MEASUREMENT
/end GROUP
/begin GROUP SYSTEM.HMI.HMIDataFcnVhSpdDigital "HMIDataFcnVhSpdDigital"
 /begin ANNOTATION ANNOTATION_LABEL "Instance" ANNOTATION_ORIGIN "Group" /begin ANNOTATION_TEXT "15" /end ANNOTATION_TEXT /end ANNOTATION
 /begin ANNOTATION ANNOTATION_LABEL "TaskCycleTime" ANNOTATION_ORIGIN "Group" /begin ANNOTATION_TEXT "0" /end ANNOTATION_TEXT /end ANNOTATION
 /begin ANNOTATION ANNOTATION_LABEL "TimeResolution" ANNOTATION_ORIGIN "Group" /begin ANNOTATION_TEXT "0" /end ANNOTATION_TEXT /end ANNOTATION
 /begin REF_MEASUREMENT OUT_HMI.HMIDataFcnVhSpdDigital._Ena.Task50ms OUT_HMI.HMIDataFcnVhSpdDigital.SpeedUnit.Task1000ms OUT_HMI.HMIDataFcnVhSpdDigital.VhSpeedDigital.Task1000ms /end REF_MEASUREMENT
/end GROUP
/begin GROUP SYSTEM.HMI.HMIDataFcnVhSpdGauge "HMIDataFcnVhSpdGauge"
 /begin ANNOTATION ANNOTATION_LABEL "Instance" ANNOTATION_ORIGIN "Group" /begin ANNOTATION_TEXT "16" /end ANNOTATION_TEXT /end ANNOTATION
 /begin ANNOTATION ANNOTATION_LABEL "TaskCycleTime" ANNOTATION_ORIGIN "Group" /begin ANNOTATION_TEXT "0" /end ANNOTATION_TEXT /end ANNOTATION
 /begin ANNOTATION ANNOTATION_LABEL "TimeResolution" ANNOTATION_ORIGIN "Group" /begin ANNOTATION_TEXT "0" /end ANNOTATION_TEXT /end ANNOTATION
 /begin REF_MEASUREMENT OUT_HMI.HMIDataFcnVhSpdGauge.VhSpeed.Task50ms OUT_HMI.HMIDataFcnVhSpdGauge._Ena.Task50ms OUT_HMI.HMIDataFcnVhSpdGauge.SpeedUnit.Task50ms /end REF_MEASUREMENT
/end GROUP
/begin COMPU_METHOD IS_BOOLEAN_TRUE "" RAT_FUNC "%11.5" "" COEFFS 0 1 0 0 0 1 /end COMPU_METHOD
/begin COMPU_METHOD COMP_DEFAULT "" RAT_FUNC "%11.5" "Increments" COEFFS 0 1 0 0 0 1 /end COMPU_METHOD
/begin COMPU_VTAB ASSHDL_en_AssetState ". " TAB_VERB 9 0 "AssetLCWakeupSequence" 1 "AssetSplashScreen" 2 "AssetAlerts01" 3 "AssetAlerts02" 4 "AssetWelcome" 5 "AssetBasic" 6 "AssetFull01" 7 "AssetFull02" 8 "AssetFailure" /end COMPU_VTAB
/begin COMPU_VTAB BRGHDL_en_BargraphBhvr ". " TAB_VERB 4 0 "BarGSolid" 1 "BarGSlow_Flash" 2 "BarGFast_Flash" 3 "BarGSolid1" /end COMPU_VTAB
/begin COMPU_VTAB DAHDL_en_FcnList ". " TAB_VERB 68 0 "FcnNoFcn" 1 "FcnAutonomyContentLeftRight" 10 "FcnBatteryVoltageContentLeft" 11 "FcnSettingsLeftGaugeMenu" 12 "FcnSettingsRightGaugeMenu" 13 "FcnNavigationContentRight" 14 "FcnMediaContentRight" 15 "FcnPhoneContentAreaRight" 16 "FcnNotificationActivePassiveLeft" 17 "FcnNotificationActivePassiveRight" 18 "FcnNotificationDriversGradeTip" 19 "FcnNotificationIncomingCall" 2 "FcnConsumptionContentLeftRight" 20 "FcnVehicleSpeedDigital" 21 "FcnADASLDWS" 22 "FcnSetupLDWS" 23 "FcnAdaptiveCruiseControl" 24 "FcnSetupSpeedLimit" 25 "FcnAdvancedEmergencyBrake" 26 "FcnDrowsinessDetection" 27 "FcnTrafficSignRecognition" 28 "FcnBlindSpotDetection" 29 "FcnDateTimeCentral" 3 "FcnEconometerContentLeftRight" 30 "FcnConsumptionCentral" 31 "FcnDriversGradeComplete" 32 "FcnTripInfoCentral" 33 "FcnEngineHoursCentral" 34 "FcnActiveFailuresCentral" 35 "FcnTireTemperature4AxlesCentral" 36 "FcnTirePressure4AxlesCentral" 37 "FcnTotalAxleWeight4AxlesCentral" 38 "FcnBrakeLining4AxlesCentral" 39 "FcnSetWipeAutoSpeed" 4 "FcnDriversAverageGradeLeftRight" 40 "FcnSetDoorOpeningPassengersSide" 41 "FcnSetSpeedWarningVolume" 42 "FcnSetDisplayPhoneOverlay" 43 "FcnSetDisplayDriversGradeTips" 44 "FcnSetDisplayDateTime" 45 "FcnSetDisplayScreenBrightness" 46 "FcnSetUnitsDistance" 47 "FcnSetUnitsDigitalSpeed" 48 "FcnSetUnitsPressure" 49 "FcnSetUnitsConsumption" 5 "FcnBrakePressureContentLeftRight" 50 "FcnSetLanguage" 51 "FcnVehicleID" 52 "FcnDiagnostics" 53 "FcnMaintenance" 54 "FcnGear" 55 "FcnDoorOpen" 56 "FcnVehicleSpeedGaugeDualGauge" 57 "FcnEngineSpeedGauge" 58 "FcnOdometer" 59 "FcnTripmeter" 6 "FcnOilInfo" 60 "FcnMapTime" 61 "FcnMapDistance" 62 "FcnVirtualTelltale" 63 "FcnMap" 64 "FcnCCSpeed" 65 "FcnCruiseControlSpeedValueAdj" 66 "FcnSpeedLimitIndication" 67 "FcnBackground" 7 "FcnCoolantTemp" 8 "FcnEngineHoursContentLeft" 9 "FcnEngineSpeedContentLeft" /end COMPU_VTAB
/begin COMPU_VTAB DAHDL_en_ScreenList ". " TAB_VERB 16 0 "DAScreenID00" 1 "DAScreenID01" 10 "DAScreenID10" 11 "DAScreenID11" 12 "DAScreenID12" 13 "DAScreenID13" 14 "DAScreenID14" 15 "DANoScreen" 2 "DAScreenID02" 3 "DAScreenID03" 4 "DAScreenID04" 5 "DAScreenID05" 6 "DAScreenID06" 7 "DAScreenID07" 8 "DAScreenID08" 9 "DAScreenID09" /end COMPU_VTAB
/begin COMPU_VTAB ESPDG_en_ESpdGreenRange ". " TAB_VERB 14 0 "ESpd_30_1000_1600" 1 "ESpd_30_1000_1500" 10 "ESpd_45_1300_2300" 11 "ESpd_45_1500_2500" 12 "ESpd_45_1500_2300" 15 "Espd_GreenNotAvailable" 2 "ESpd_30_1100_1700" 3 "ESpd_30_1100_1600" 4 "ESpd_30_1200_1600" 5 "ESpd_30_1200_1700" 6 "ESpd_35_1200_2000" 7 "ESpd_35_1200_1800" 8 "ESpd_35_1300_2000" 9 "ESpd_35_1300_1800" /end COMPU_VTAB
/begin COMPU_VTAB ESPDG_en_ESpdRedRange ". " TAB_VERB 5 0 "ESpd_30_2600_3000" 1 "ESpd_30_2500_3000" 15 "Espd_RedNotAvailable" 2 "ESpd_35_2900_3500" 3 "ESpd_45_4100_4500" /end COMPU_VTAB
/begin COMPU_VTAB ESPDG_en_ESpdYellowRange ". " TAB_VERB 14 0 "ESpd_30_1800_2500" 1 "ESpd_30_1800_2400" 10 "ESpd_35_2200_2600" 11 "ESpd_35_2000_2600" 12 "ESpd_35_2300_2800" 15 "ESpd_YellowNotAvailable" 2 "ESpd_30_2000_2500" 3 "ESpd_30_2000_2400" 4 "ESpd_30_1900_2400" 5 "ESpd_35_2200_2700" 6 "ESpd_35_2400_2800" 7 "ESpd_35_2100_2600" 8 "ESpd_35_2100_2500" 9 "ESpd_35_2000_2500" /end COMPU_VTAB
/begin COMPU_VTAB FCNBKG_en_BckgrndGlowColor ". " TAB_VERB 4 0 "BckgrndBLUE" 1 "BckgrndGREEN" 2 "BckgrndAMBAR" 3 "BckgrndPURPLE" /end COMPU_VTAB
/begin COMPU_VTAB FCNGR_en_GearMode ". " TAB_VERB 10 0 "GearModeIDLE" 1 "GearModeM" 15 "GearModeNotAvailable" 2 "GearModeD" 3 "GearModeP" 4 "GearModeN" 5 "GearModeR" 6 "GearModeL" 7 "GearModeA" 8 "GearModeC" /end COMPU_VTAB
/begin COMPU_VTAB FPCHDL_en_AssetStatus ". " TAB_VERB 5 0 "AssNotConfigured" 1 "AssNotLoaded" 2 "AssLoadedSuccess" 3 "AssLoadedError" 4 "AssNotAvailable" /end COMPU_VTAB
/begin COMPU_VTAB FPCHDL_en_AudioChannelSts ". " TAB_VERB 7 0 "SndReadyNotPlaying" 1 "SndReadyPlaying" 2 "SndConfigError" 3 "SndInternalError" 4 "SndKernelError" 5 "SndInvalidRqstError" 6 "SndNotInitializedError" /end COMPU_VTAB
/begin COMPU_VTAB FPCHDL_en_FpcSoundStatus ". " TAB_VERB 4 0 "SndNotReady" 1 "SndFailure" 2 "SndReadyNotPlaying" 3 "SndReadyPlaying" /end COMPU_VTAB
/begin COMPU_VTAB FPCHDL_en_MasterAssetStatus ". " TAB_VERB 5 0 "MstLoading" 1 "MstLoadedSuccess" 2 "MstLoadedError" 3 "MstDisplayError" 4 "MstKernelError" /end COMPU_VTAB
/begin COMPU_VTAB FPCHDL_en_VideoChSts ". " TAB_VERB 6 0 "VChstsInitializing" 1 "VChstsSigInactive" 2 "VChstsSigActive" 3 "VChstsChannelNotAvb" 4 "VChstsKernelError" 5 "VChstsDisplayNotAvb" /end COMPU_VTAB
/end MODULE
/end PROJECT
