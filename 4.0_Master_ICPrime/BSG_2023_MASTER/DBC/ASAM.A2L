ASAP2_VERSION 1 7
/begin PROJECT IcPrimeEOL "ManPrime_MBDS_IcPrimeEOL"
/begin HEADER "D:\IC_Prime_Github\IcPrimeEOL" VERSION "8.17.01.01_3441" PROJECT_NO _953887613 /end HEADER
/begin MODULE IcPrimeEOL "D:\IC_Prime_Github\IcPrimeEOL"
/begin MOD_COMMON "" BYTE_ORDER MSB_FIRST /end MOD_COMMON
/begin MEASUREMENT OUT_HMI.HMIDataFcnVirtualTelltale.SymbolVTT01.Task40ms "" UBYTE COMP_DEFAULT 0 0 0 255 ECU_ADDRESS 0x1D313 READ_WRITE /end MEASUREMENT
/begin MEASUREMENT OUT_HMI.HMIDataFcnVirtualTelltale.SymbolVTT02.Task40ms "" UBYTE COMP_DEFAULT 0 0 0 255 ECU_ADDRESS 0x1D314 READ_WRITE /end MEASUREMENT
/begin MEASUREMENT OUT_HMI.HMIDataFcnVirtualTelltale.SymbolVTT03.Task40ms "" UBYTE COMP_DEFAULT 0 0 0 255 ECU_ADDRESS 0x1D315 READ_WRITE /end MEASUREMENT
/begin MEASUREMENT OUT_HMI.HMIDataFcnVirtualTelltale.SymbolVTT04.Task40ms "" UBYTE COMP_DEFAULT 0 0 0 255 ECU_ADDRESS 0x1D316 READ_WRITE /end MEASUREMENT
/begin MEASUREMENT OUT_HMI.HMIDataFcnVirtualTelltale.SymbolVTT05.Task40ms "" UBYTE COMP_DEFAULT 0 0 0 255 ECU_ADDRESS 0x1D317 READ_WRITE /end MEASUREMENT
/begin MEASUREMENT OUT_HMI.HMIDataFcnVirtualTelltale.SymbolVTT06.Task40ms "" UBYTE COMP_DEFAULT 0 0 0 255 ECU_ADDRESS 0x1D318 READ_WRITE /end MEASUREMENT
/begin MEASUREMENT OUT_HMI.HMIDataFcnVirtualTelltale.SymbolVTT07.Task40ms "" UBYTE COMP_DEFAULT 0 0 0 255 ECU_ADDRESS 0x1D319 READ_WRITE /end MEASUREMENT
/begin MEASUREMENT OUT_HMI.HMIDataFcnVirtualTelltale.SymbolVTT08.Task40ms "" UBYTE COMP_DEFAULT 0 0 0 255 ECU_ADDRESS 0x1D31A READ_WRITE /end MEASUREMENT
/begin MEASUREMENT OUT_HMI.HMIDataFcnVirtualTelltale.SymbolVTT09.Task40ms "" UBYTE COMP_DEFAULT 0 0 0 255 ECU_ADDRESS 0x1D31B READ_WRITE /end MEASUREMENT
/begin MEASUREMENT OUT_HMI.HMIDataFcnVirtualTelltale.SymbolVTT10.Task40ms "" UBYTE COMP_DEFAULT 0 0 0 255 ECU_ADDRESS 0x1D31C READ_WRITE /end MEASUREMENT
/begin MEASUREMENT OUT_HMI.HMIDataFcnVirtualTelltale.SymbolVTT11.Task40ms "" UBYTE COMP_DEFAULT 0 0 0 255 ECU_ADDRESS 0x1D31D READ_WRITE /end MEASUREMENT
/begin MEASUREMENT OUT_HMI.HMIDataFcnVirtualTelltale.SymbolVTT12.Task40ms "" UBYTE COMP_DEFAULT 0 0 0 255 ECU_ADDRESS 0x1D31E READ_WRITE /end MEASUREMENT
/begin MEASUREMENT OUT_HMI.HMIDataFcnVirtualTelltale.SymbolVTT13.Task40ms "" UBYTE COMP_DEFAULT 0 0 0 255 ECU_ADDRESS 0x1D31F READ_WRITE /end MEASUREMENT
/begin MEASUREMENT OUT_HMI.HMIDataFcnVirtualTelltale.SymbolVTT14.Task40ms "" UBYTE COMP_DEFAULT 0 0 0 255 ECU_ADDRESS 0x1D320 READ_WRITE /end MEASUREMENT
/begin MEASUREMENT OUT_HMI.HMIDataFcnVirtualTelltale.SymbolVTT15.Task40ms "" UBYTE COMP_DEFAULT 0 0 0 255 ECU_ADDRESS 0x1D321 READ_WRITE /end MEASUREMENT
/begin MEASUREMENT OUT_HMI.HMIDataFcnVirtualTelltale.SymbolVTT16.Task40ms "" UBYTE COMP_DEFAULT 0 0 0 255 ECU_ADDRESS 0x1D322 READ_WRITE /end MEASUREMENT
/begin MEASUREMENT OUT_HMI.HMIDataFcnVirtualTelltale.SymbolVTT17.Task40ms "" UBYTE COMP_DEFAULT 0 0 0 255 ECU_ADDRESS 0x1D323 READ_WRITE /end MEASUREMENT
/begin MEASUREMENT OUT_HMI.HMIDataFcnVirtualTelltale.SymbolVTT18.Task40ms "" UBYTE COMP_DEFAULT 0 0 0 255 ECU_ADDRESS 0x1D324 READ_WRITE /end MEASUREMENT
/begin MEASUREMENT OUT_HMI.HMIDataFcnVirtualTelltale.SymbolVTT19.Task40ms "" UBYTE COMP_DEFAULT 0 0 0 255 ECU_ADDRESS 0x1D325 READ_WRITE /end MEASUREMENT
/begin MEASUREMENT OUT_HMI.HMIDataFcnVirtualTelltale.SymbolVTT20.Task40ms "" UBYTE COMP_DEFAULT 0 0 0 255 ECU_ADDRESS 0x1D326 READ_WRITE /end MEASUREMENT
/begin MEASUREMENT OUT_HMI.HMIDataFcnVirtualTelltale.SymbolVTT21.Task40ms "" UBYTE COMP_DEFAULT 0 0 0 255 ECU_ADDRESS 0x1D327 READ_WRITE /end MEASUREMENT
/begin MEASUREMENT OUT_HMI.HMIDataFcnVirtualTelltale.SymbolVTT22.Task40ms "" UBYTE COMP_DEFAULT 0 0 0 255 ECU_ADDRESS 0x1D328 READ_WRITE /end MEASUREMENT
/begin MEASUREMENT OUT_HMI.HMIDataFcnVirtualTelltale.SymbolVTT23.Task40ms "" UBYTE COMP_DEFAULT 0 0 0 255 ECU_ADDRESS 0x1D329 READ_WRITE /end MEASUREMENT
/begin MEASUREMENT OUT_HMI.HMIDataFcnVirtualTelltale.SymbolVTT24.Task40ms "" UBYTE COMP_DEFAULT 0 0 0 255 ECU_ADDRESS 0x1D32A READ_WRITE /end MEASUREMENT
/begin MEASUREMENT OUT_HMI.HMIDataFcnVirtualTelltale._Ena.Task50ms "" UBYTE IS_BOOLEAN_TRUE 0 0 0 1 ECU_ADDRESS 0x1D242 READ_WRITE /end MEASUREMENT
/begin MEASUREMENT OUT_HMI.HMIDataFcnVirtualTelltale1.SymbolVTT25.Task40ms "" UBYTE COMP_DEFAULT 0 0 0 255 ECU_ADDRESS 0x1D32B READ_WRITE /end MEASUREMENT
/begin MEASUREMENT OUT_HMI.HMIDataFcnVirtualTelltale1.SymbolVTT26.Task40ms "" UBYTE COMP_DEFAULT 0 0 0 255 ECU_ADDRESS 0x1D32C READ_WRITE /end MEASUREMENT
/begin MEASUREMENT OUT_HMI.HMIDataFcnVirtualTelltale1.SymbolVTT27.Task40ms "" UBYTE COMP_DEFAULT 0 0 0 255 ECU_ADDRESS 0x1D32D READ_WRITE /end MEASUREMENT
/begin MEASUREMENT OUT_HMI.HMIDataFcnVirtualTelltale1.SymbolVTT28.Task40ms "" UBYTE COMP_DEFAULT 0 0 0 255 ECU_ADDRESS 0x1D32E READ_WRITE /end MEASUREMENT
/begin MEASUREMENT OUT_HMI.HMIDataFcnVirtualTelltale1.SymbolVTT29.Task40ms "" UBYTE COMP_DEFAULT 0 0 0 255 ECU_ADDRESS 0x1D32F READ_WRITE /end MEASUREMENT
/begin MEASUREMENT OUT_HMI.HMIDataFcnVirtualTelltale1.SymbolVTT30.Task40ms "" UBYTE COMP_DEFAULT 0 0 0 255 ECU_ADDRESS 0x1D330 READ_WRITE /end MEASUREMENT
/begin MEASUREMENT OUT_HMI.HMIDataFcnVirtualTelltale1.SymbolVTT31.Task40ms "" UBYTE COMP_DEFAULT 0 0 0 255 ECU_ADDRESS 0x1D331 READ_WRITE /end MEASUREMENT
/begin MEASUREMENT OUT_HMI.HMIDataFcnVirtualTelltale1.SymbolVTT32.Task40ms "" UBYTE COMP_DEFAULT 0 0 0 255 ECU_ADDRESS 0x1D332 READ_WRITE /end MEASUREMENT
/begin MEASUREMENT OUT_HMI.HMIDataFcnVirtualTelltale1.SymbolVTT33.Task40ms "" UBYTE COMP_DEFAULT 0 0 0 255 ECU_ADDRESS 0x1D333 READ_WRITE /end MEASUREMENT
/begin MEASUREMENT OUT_HMI.HMIDataFcnVirtualTelltale1.SymbolVTT34.Task40ms "" UBYTE COMP_DEFAULT 0 0 0 255 ECU_ADDRESS 0x1D334 READ_WRITE /end MEASUREMENT
/begin MEASUREMENT OUT_HMI.HMIDataFcnVirtualTelltale1.SymbolVTT35.Task40ms "" UBYTE COMP_DEFAULT 0 0 0 255 ECU_ADDRESS 0x1D335 READ_WRITE /end MEASUREMENT
/begin MEASUREMENT OUT_HMI.HMIDataFcnVirtualTelltale1.SymbolVTT36.Task40ms "" UBYTE COMP_DEFAULT 0 0 0 255 ECU_ADDRESS 0x1D336 READ_WRITE /end MEASUREMENT
/begin MEASUREMENT OUT_HMI.HMIDataFcnVirtualTelltale1.SymbolVTT37.Task40ms "" UBYTE COMP_DEFAULT 0 0 0 255 ECU_ADDRESS 0x1D337 READ_WRITE /end MEASUREMENT
/begin MEASUREMENT OUT_HMI.HMIDataFcnVirtualTelltale1.SymbolVTT38.Task40ms "" UBYTE COMP_DEFAULT 0 0 0 255 ECU_ADDRESS 0x1D338 READ_WRITE /end MEASUREMENT
/begin MEASUREMENT OUT_HMI.HMIDataFcnVirtualTelltale1.SymbolVTT39.Task40ms "" UBYTE COMP_DEFAULT 0 0 0 255 ECU_ADDRESS 0x1D339 READ_WRITE /end MEASUREMENT
/begin MEASUREMENT OUT_HMI.HMIDataFcnVirtualTelltale1.SymbolVTT40.Task40ms "" UBYTE COMP_DEFAULT 0 0 0 255 ECU_ADDRESS 0x1D33A READ_WRITE /end MEASUREMENT
/begin MEASUREMENT OUT_HMI.HMIDataFcnVirtualTelltale1.SymbolVTT41.Task40ms "" UBYTE COMP_DEFAULT 0 0 0 255 ECU_ADDRESS 0x1D33B READ_WRITE /end MEASUREMENT
/begin MEASUREMENT OUT_HMI.HMIDataFcnVirtualTelltale1.SymbolVTT42.Task40ms "" UBYTE COMP_DEFAULT 0 0 0 255 ECU_ADDRESS 0x1D33C READ_WRITE /end MEASUREMENT
/begin MEASUREMENT OUT_HMI.HMIDataFcnVirtualTelltale1.SymbolVTT43.Task40ms "" UBYTE COMP_DEFAULT 0 0 0 255 ECU_ADDRESS 0x1D33D READ_WRITE /end MEASUREMENT
/begin MEASUREMENT OUT_HMI.HMIDataFcnVirtualTelltale1.SymbolVTT44.Task40ms "" UBYTE COMP_DEFAULT 0 0 0 255 ECU_ADDRESS 0x1D33E READ_WRITE /end MEASUREMENT
/begin MEASUREMENT OUT_HMI.HMIDataFcnVirtualTelltale1.SymbolVTT45.Task40ms "" UBYTE COMP_DEFAULT 0 0 0 255 ECU_ADDRESS 0x1D33F READ_WRITE /end MEASUREMENT
/begin MEASUREMENT OUT_HMI.HMIDataFcnVirtualTelltale1.SymbolVTT46.Task40ms "" UBYTE COMP_DEFAULT 0 0 0 255 ECU_ADDRESS 0x1D340 READ_WRITE /end MEASUREMENT
/begin MEASUREMENT OUT_HMI.HMIDataFcnVirtualTelltale1.SymbolVTT47.Task40ms "" UBYTE COMP_DEFAULT 0 0 0 255 ECU_ADDRESS 0x1D341 READ_WRITE /end MEASUREMENT
/begin MEASUREMENT OUT_HMI.HMIDataFcnVirtualTelltale1._Ena.Task50ms "" UBYTE IS_BOOLEAN_TRUE 0 0 0 1 ECU_ADDRESS 0x1D243 READ_WRITE /end MEASUREMENT
/begin MEASUREMENT OUT_HMI.HMIDataGeneral1.SubViewTransAnimationRqst.Task50ms "" UBYTE COMP_DEFAULT 0 0 0 255 ECU_ADDRESS 0x1D244 READ_WRITE /end MEASUREMENT
/begin MEASUREMENT OUT_HMI.HMIDataGeneral1._Ena.Task100ms "" UBYTE IS_BOOLEAN_TRUE 0 0 0 1 ECU_ADDRESS 0x1D102 READ_WRITE /end MEASUREMENT
/begin MEASUREMENT OUT_HMI.HMIDataGeneral1.NightMode.Task200ms "" UBYTE IS_BOOLEAN_TRUE 0 0 0 1 ECU_ADDRESS 0x1D0E4 READ_WRITE /end MEASUREMENT
/begin MEASUREMENT OUT_HMI.HMIDataGeneral1.FpsEn.Task1000ms "" UBYTE IS_BOOLEAN_TRUE 0 0 0 1 ECU_ADDRESS 0x1D046 READ_WRITE /end MEASUREMENT
/begin MEASUREMENT OUT_HMI.HMIDataGeneral1.FrameCounterEn.Task1000ms "" UBYTE IS_BOOLEAN_TRUE 0 0 0 1 ECU_ADDRESS 0x1D047 READ_WRITE /end MEASUREMENT
/begin MEASUREMENT OUT_HMI.HMIDataGeneral1.FrameTimeEn.Task1000ms "" UBYTE IS_BOOLEAN_TRUE 0 0 0 1 ECU_ADDRESS 0x1D048 READ_WRITE /end MEASUREMENT
/begin MEASUREMENT OUT_HMI.HMIDataHmiHdl.FcnBackgroundScr.Task50ms "" UBYTE COMP_DEFAULT 0 0 0 255 ECU_ADDRESS 0x1D245 READ_WRITE /end MEASUREMENT
/begin MEASUREMENT OUT_HMI.HMIDataHmiHdl.FcnBrakePressureLeftScr.Task50ms "" UBYTE COMP_DEFAULT 0 0 0 255 ECU_ADDRESS 0x1D246 READ_WRITE /end MEASUREMENT
/begin MEASUREMENT OUT_HMI.HMIDataHmiHdl.FcnBrakePressureRightScr.Task50ms "" UBYTE COMP_DEFAULT 0 0 0 255 ECU_ADDRESS 0x1D247 READ_WRITE /end MEASUREMENT
/begin MEASUREMENT OUT_HMI.HMIDataHmiHdl.FcnConsumptionLeftScr.Task50ms "" UBYTE COMP_DEFAULT 0 0 0 255 ECU_ADDRESS 0x1D248 READ_WRITE /end MEASUREMENT
/begin MEASUREMENT OUT_HMI.HMIDataHmiHdl.FcnConsumptionRightScr.Task50ms "" UBYTE COMP_DEFAULT 0 0 0 255 ECU_ADDRESS 0x1D249 READ_WRITE /end MEASUREMENT
/begin MEASUREMENT OUT_HMI.HMIDataHmiHdl.FcnCoolantTemperatureScr.Task50ms "" UBYTE COMP_DEFAULT 0 0 0 255 ECU_ADDRESS 0x1D24A READ_WRITE /end MEASUREMENT
/begin MEASUREMENT OUT_HMI.HMIDataHmiHdl.FcnDiagnosticsScr.Task50ms "" UBYTE COMP_DEFAULT 0 0 0 255 ECU_ADDRESS 0x1D24B READ_WRITE /end MEASUREMENT
/begin MEASUREMENT OUT_HMI.HMIDataHmiHdl.FcnDriversGradeScr.Task50ms "" UBYTE COMP_DEFAULT 0 0 0 255 ECU_ADDRESS 0x1D24C READ_WRITE /end MEASUREMENT
/begin MEASUREMENT OUT_HMI.HMIDataHmiHdl.FcnGearScr.Task50ms "" UBYTE COMP_DEFAULT 0 0 0 255 ECU_ADDRESS 0x1D24D READ_WRITE /end MEASUREMENT
/begin MEASUREMENT OUT_HMI.HMIDataHmiHdl.FcnNotificationLeftScr.Task50ms "" UBYTE COMP_DEFAULT 0 0 0 255 ECU_ADDRESS 0x1D24E READ_WRITE /end MEASUREMENT
/begin MEASUREMENT OUT_HMI.HMIDataHmiHdl.FcnNotificationRightScr.Task50ms "" UBYTE COMP_DEFAULT 0 0 0 255 ECU_ADDRESS 0x1D24F READ_WRITE /end MEASUREMENT
/begin MEASUREMENT OUT_HMI.HMIDataHmiHdl.FcnOdometerScr.Task50ms "" UBYTE COMP_DEFAULT 0 0 0 255 ECU_ADDRESS 0x1D250 READ_WRITE /end MEASUREMENT
/begin MEASUREMENT OUT_HMI.HMIDataHmiHdl.FcnOilInfoLeftScr.Task50ms "" UBYTE COMP_DEFAULT 0 0 0 255 ECU_ADDRESS 0x1D251 READ_WRITE /end MEASUREMENT
/begin MEASUREMENT OUT_HMI.HMIDataHmiHdl.FcnOilInfoRightScr.Task50ms "" UBYTE COMP_DEFAULT 0 0 0 255 ECU_ADDRESS 0x1D252 READ_WRITE /end MEASUREMENT
/begin MEASUREMENT OUT_HMI.HMIDataHmiHdl.FcnRpmGaugeBigScr.Task50ms "" UBYTE COMP_DEFAULT 0 0 0 255 ECU_ADDRESS 0x1D253 READ_WRITE /end MEASUREMENT
/begin MEASUREMENT OUT_HMI.HMIDataHmiHdl.FcnRpmGaugeSmallScr.Task50ms "" UBYTE COMP_DEFAULT 0 0 0 255 ECU_ADDRESS 0x1D254 READ_WRITE /end MEASUREMENT
/begin MEASUREMENT OUT_HMI.HMIDataHmiHdl.FcnSpeedGaugeScr.Task50ms "" UBYTE COMP_DEFAULT 0 0 0 255 ECU_ADDRESS 0x1D255 READ_WRITE /end MEASUREMENT
/begin MEASUREMENT OUT_HMI.HMIDataHmiHdl.FcnTripmeterScr.Task50ms "" UBYTE COMP_DEFAULT 0 0 0 255 ECU_ADDRESS 0x1D256 READ_WRITE /end MEASUREMENT
/begin MEASUREMENT OUT_HMI.HMIDataHmiHdl.FcnVehicleSpeedDigitalDA03Scr.Task50ms "" UBYTE COMP_DEFAULT 0 0 0 255 ECU_ADDRESS 0x1D257 READ_WRITE /end MEASUREMENT
/begin MEASUREMENT OUT_HMI.HMIDataHmiHdl.FcnVehicleSpeedDigitalDA06Scr.Task50ms "" UBYTE COMP_DEFAULT 0 0 0 255 ECU_ADDRESS 0x1D258 READ_WRITE /end MEASUREMENT
/begin MEASUREMENT OUT_HMI.HMIDataHmiHdl.FcnVehicleSpeedDigitalDA13Scr.Task50ms "" UBYTE COMP_DEFAULT 0 0 0 255 ECU_ADDRESS 0x1D259 READ_WRITE /end MEASUREMENT
/begin MEASUREMENT OUT_HMI.HMIDataHmiHdl.FcnVehicleSpeedDigitalDA14Scr.Task50ms "" UBYTE COMP_DEFAULT 0 0 0 255 ECU_ADDRESS 0x1D25A READ_WRITE /end MEASUREMENT
/begin MEASUREMENT OUT_HMI.HMIDataHmiHdl._Ena.Task100ms "" UBYTE IS_BOOLEAN_TRUE 0 0 0 1 ECU_ADDRESS 0x1D103 READ_WRITE /end MEASUREMENT
/begin MEASUREMENT OUT_HMI.HMICtrlGeneral1.Language.Task50ms "" UBYTE COMP_DEFAULT 0 0 0 255 ECU_ADDRESS 0x1D20A READ_WRITE /end MEASUREMENT
/begin MEASUREMENT OUT_HMI.HMICtrlGeneral1._Ena.Task100ms "" UBYTE IS_BOOLEAN_TRUE 0 0 0 1 ECU_ADDRESS 0x1D0EA READ_WRITE /end MEASUREMENT
/begin MEASUREMENT OUT_HMI.HMICtrlGeneral1.CAGEnAssetAlerts01.Task100ms "" UBYTE IS_BOOLEAN_TRUE 0 0 0 1 ECU_ADDRESS 0x1D0EB READ_WRITE /end MEASUREMENT
/begin MEASUREMENT OUT_HMI.HMICtrlGeneral1.CAGEnAssetAlerts02.Task100ms "" UBYTE IS_BOOLEAN_TRUE 0 0 0 1 ECU_ADDRESS 0x1D0EC READ_WRITE /end MEASUREMENT
/begin MEASUREMENT OUT_HMI.HMICtrlGeneral1.CAGEnAssetBasic.Task100ms "" UBYTE IS_BOOLEAN_TRUE 0 0 0 1 ECU_ADDRESS 0x1D0ED READ_WRITE /end MEASUREMENT
/begin MEASUREMENT OUT_HMI.HMICtrlGeneral1.CAGEnAssetFull01.Task100ms "" UBYTE IS_BOOLEAN_TRUE 0 0 0 1 ECU_ADDRESS 0x1D0EE READ_WRITE /end MEASUREMENT
/begin MEASUREMENT OUT_HMI.HMICtrlGeneral1.CAGEnAssetFull02.Task100ms "" UBYTE IS_BOOLEAN_TRUE 0 0 0 1 ECU_ADDRESS 0x1D0EF READ_WRITE /end MEASUREMENT
/begin MEASUREMENT OUT_HMI.HMICtrlGeneral1.CAGEnAssetWelcome.Task100ms "" UBYTE IS_BOOLEAN_TRUE 0 0 0 1 ECU_ADDRESS 0x1D0F0 READ_WRITE /end MEASUREMENT
/begin MEASUREMENT OUT_Sounds.f_SoundGlblSndVol.Task100ms "" UBYTE COMP_DEFAULT 0 0 0 255 ECU_ADDRESS 0x1D1B3 READ_WRITE /end MEASUREMENT
/begin MEASUREMENT IN_Sounds.ExternalSounds.ChannelStatus.f_channelStatus.Task100ms "" UBYTE COMP_DEFAULT 0 0 0 255 ECU_ADDRESS 0x1D1EC READ_WRITE /end MEASUREMENT
/begin MEASUREMENT IN_Sounds.ExternalSounds.ChannelStatus.f_soundState.Task100ms "" UBYTE COMP_DEFAULT 0 0 0 255 ECU_ADDRESS 0x1D1ED READ_WRITE /end MEASUREMENT
/begin MEASUREMENT DIAG_Sounds.ExternalSounds.ChannelStatus.f_soundState_DIAG.Task100ms "Diagnostic Input" UWORD COMP_DEFAULT 0 0 0 65535 ECU_ADDRESS 0x1D1F6 READ_WRITE /end MEASUREMENT
/begin MEASUREMENT OUT_Sounds.ExternalSounds.S_002._SoundBalance.Task100ms "" SBYTE COMP_DEFAULT 0 0 -128 127 ECU_ADDRESS 0x1D109 READ_WRITE /end MEASUREMENT
/begin MEASUREMENT OUT_Sounds.ExternalSounds.S_002._SoundDeviceEnable.Task100ms "" UBYTE IS_BOOLEAN_TRUE 0 0 0 1 ECU_ADDRESS 0x1D10A READ_WRITE /end MEASUREMENT
/begin MEASUREMENT OUT_Sounds.ExternalSounds.S_002._SoundRecurrences.Task100ms "" UBYTE COMP_DEFAULT 0 0 0 255 ECU_ADDRESS 0x1D10B READ_WRITE /end MEASUREMENT
/begin MEASUREMENT OUT_Sounds.ExternalSounds.S_002._SoundRelVol.Task100ms "" UBYTE COMP_DEFAULT 0 0 0 255 ECU_ADDRESS 0x1D10C READ_WRITE /end MEASUREMENT
/begin MEASUREMENT OUT_Sounds.ExternalSounds.S_002._SoundRequest.Task100ms "" UBYTE IS_BOOLEAN_TRUE 0 0 0 1 ECU_ADDRESS 0x1D10D READ_WRITE /end MEASUREMENT
/begin MEASUREMENT OUT_Sounds.ExternalSounds.S_003._SoundBalance.Task100ms "" SBYTE COMP_DEFAULT 0 0 -128 127 ECU_ADDRESS 0x1D10E READ_WRITE /end MEASUREMENT
/begin MEASUREMENT OUT_Sounds.ExternalSounds.S_003._SoundDeviceEnable.Task100ms "" UBYTE IS_BOOLEAN_TRUE 0 0 0 1 ECU_ADDRESS 0x1D10F READ_WRITE /end MEASUREMENT
/begin MEASUREMENT OUT_Sounds.ExternalSounds.S_003._SoundRecurrences.Task100ms "" UBYTE COMP_DEFAULT 0 0 0 255 ECU_ADDRESS 0x1D110 READ_WRITE /end MEASUREMENT
/begin MEASUREMENT OUT_Sounds.ExternalSounds.S_003._SoundRelVol.Task100ms "" UBYTE COMP_DEFAULT 0 0 0 255 ECU_ADDRESS 0x1D111 READ_WRITE /end MEASUREMENT
/begin MEASUREMENT OUT_Sounds.ExternalSounds.S_003._SoundRequest.Task100ms "" UBYTE IS_BOOLEAN_TRUE 0 0 0 1 ECU_ADDRESS 0x1D112 READ_WRITE /end MEASUREMENT
/begin MEASUREMENT OUT_Sounds.ExternalSounds.S_004._SoundBalance.Task100ms "" SBYTE COMP_DEFAULT 0 0 -128 127 ECU_ADDRESS 0x1D113 READ_WRITE /end MEASUREMENT
/begin MEASUREMENT OUT_Sounds.ExternalSounds.S_004._SoundDeviceEnable.Task100ms "" UBYTE IS_BOOLEAN_TRUE 0 0 0 1 ECU_ADDRESS 0x1D114 READ_WRITE /end MEASUREMENT
/begin MEASUREMENT OUT_Sounds.ExternalSounds.S_004._SoundRecurrences.Task100ms "" UBYTE COMP_DEFAULT 0 0 0 255 ECU_ADDRESS 0x1D115 READ_WRITE /end MEASUREMENT
/begin MEASUREMENT OUT_Sounds.ExternalSounds.S_004._SoundRelVol.Task100ms "" UBYTE COMP_DEFAULT 0 0 0 255 ECU_ADDRESS 0x1D116 READ_WRITE /end MEASUREMENT
/begin MEASUREMENT OUT_Sounds.ExternalSounds.S_004._SoundRequest.Task100ms "" UBYTE IS_BOOLEAN_TRUE 0 0 0 1 ECU_ADDRESS 0x1D117 READ_WRITE /end MEASUREMENT
/begin MEASUREMENT OUT_Sounds.ExternalSounds.S_005._SoundBalance.Task100ms "" SBYTE COMP_DEFAULT 0 0 -128 127 ECU_ADDRESS 0x1D118 READ_WRITE /end MEASUREMENT
/begin MEASUREMENT OUT_Sounds.ExternalSounds.S_005._SoundDeviceEnable.Task100ms "" UBYTE IS_BOOLEAN_TRUE 0 0 0 1 ECU_ADDRESS 0x1D119 READ_WRITE /end MEASUREMENT
/begin MEASUREMENT OUT_Sounds.ExternalSounds.S_005._SoundRecurrences.Task100ms "" UBYTE COMP_DEFAULT 0 0 0 255 ECU_ADDRESS 0x1D11A READ_WRITE /end MEASUREMENT
/begin MEASUREMENT OUT_Sounds.ExternalSounds.S_005._SoundRelVol.Task100ms "" UBYTE COMP_DEFAULT 0 0 0 255 ECU_ADDRESS 0x1D11B READ_WRITE /end MEASUREMENT
/begin MEASUREMENT OUT_Sounds.ExternalSounds.S_005._SoundRequest.Task100ms "" UBYTE IS_BOOLEAN_TRUE 0 0 0 1 ECU_ADDRESS 0x1D11C READ_WRITE /end MEASUREMENT
/begin MEASUREMENT OUT_Sounds.ExternalSounds.S_006._SoundBalance.Task100ms "" SBYTE COMP_DEFAULT 0 0 -128 127 ECU_ADDRESS 0x1D11D READ_WRITE /end MEASUREMENT
/begin MEASUREMENT OUT_Sounds.ExternalSounds.S_006._SoundDeviceEnable.Task100ms "" UBYTE IS_BOOLEAN_TRUE 0 0 0 1 ECU_ADDRESS 0x1D11E READ_WRITE /end MEASUREMENT
/begin MEASUREMENT OUT_Sounds.ExternalSounds.S_006._SoundRecurrences.Task100ms "" UBYTE COMP_DEFAULT 0 0 0 255 ECU_ADDRESS 0x1D11F READ_WRITE /end MEASUREMENT
/begin MEASUREMENT OUT_Sounds.ExternalSounds.S_006._SoundRelVol.Task100ms "" UBYTE COMP_DEFAULT 0 0 0 255 ECU_ADDRESS 0x1D120 READ_WRITE /end MEASUREMENT
/begin MEASUREMENT OUT_Sounds.ExternalSounds.S_006._SoundRequest.Task100ms "" UBYTE IS_BOOLEAN_TRUE 0 0 0 1 ECU_ADDRESS 0x1D121 READ_WRITE /end MEASUREMENT
/begin MEASUREMENT OUT_Sounds.ExternalSounds.S_007._SoundBalance.Task100ms "" SBYTE COMP_DEFAULT 0 0 -128 127 ECU_ADDRESS 0x1D122 READ_WRITE /end MEASUREMENT
/begin MEASUREMENT OUT_Sounds.ExternalSounds.S_007._SoundDeviceEnable.Task100ms "" UBYTE IS_BOOLEAN_TRUE 0 0 0 1 ECU_ADDRESS 0x1D123 READ_WRITE /end MEASUREMENT
/begin MEASUREMENT OUT_Sounds.ExternalSounds.S_007._SoundRecurrences.Task100ms "" UBYTE COMP_DEFAULT 0 0 0 255 ECU_ADDRESS 0x1D124 READ_WRITE /end MEASUREMENT
/begin MEASUREMENT OUT_Sounds.ExternalSounds.S_007._SoundRelVol.Task100ms "" UBYTE COMP_DEFAULT 0 0 0 255 ECU_ADDRESS 0x1D125 READ_WRITE /end MEASUREMENT
/begin MEASUREMENT OUT_Sounds.ExternalSounds.S_007._SoundRequest.Task100ms "" UBYTE IS_BOOLEAN_TRUE 0 0 0 1 ECU_ADDRESS 0x1D126 READ_WRITE /end MEASUREMENT
/begin MEASUREMENT OUT_Sounds.ExternalSounds.S_008._SoundBalance.Task100ms "" SBYTE COMP_DEFAULT 0 0 -128 127 ECU_ADDRESS 0x1D127 READ_WRITE /end MEASUREMENT
/begin MEASUREMENT OUT_Sounds.ExternalSounds.S_008._SoundDeviceEnable.Task100ms "" UBYTE IS_BOOLEAN_TRUE 0 0 0 1 ECU_ADDRESS 0x1D128 READ_WRITE /end MEASUREMENT
/begin MEASUREMENT OUT_Sounds.ExternalSounds.S_008._SoundRecurrences.Task100ms "" UBYTE COMP_DEFAULT 0 0 0 255 ECU_ADDRESS 0x1D129 READ_WRITE /end MEASUREMENT
/begin MEASUREMENT OUT_Sounds.ExternalSounds.S_008._SoundRelVol.Task100ms "" UBYTE COMP_DEFAULT 0 0 0 255 ECU_ADDRESS 0x1D12A READ_WRITE /end MEASUREMENT
/begin MEASUREMENT OUT_Sounds.ExternalSounds.S_008._SoundRequest.Task100ms "" UBYTE IS_BOOLEAN_TRUE 0 0 0 1 ECU_ADDRESS 0x1D12B READ_WRITE /end MEASUREMENT
/begin MEASUREMENT OUT_Sounds.ExternalSounds.S_009._SoundBalance.Task100ms "" SBYTE COMP_DEFAULT 0 0 -128 127 ECU_ADDRESS 0x1D12C READ_WRITE /end MEASUREMENT
/begin MEASUREMENT OUT_Sounds.ExternalSounds.S_009._SoundDeviceEnable.Task100ms "" UBYTE IS_BOOLEAN_TRUE 0 0 0 1 ECU_ADDRESS 0x1D12D READ_WRITE /end MEASUREMENT
/begin MEASUREMENT OUT_Sounds.ExternalSounds.S_009._SoundRecurrences.Task100ms "" UBYTE COMP_DEFAULT 0 0 0 255 ECU_ADDRESS 0x1D12E READ_WRITE /end MEASUREMENT
/begin MEASUREMENT OUT_Sounds.ExternalSounds.S_009._SoundRelVol.Task100ms "" UBYTE COMP_DEFAULT 0 0 0 255 ECU_ADDRESS 0x1D12F READ_WRITE /end MEASUREMENT
/begin MEASUREMENT OUT_Sounds.ExternalSounds.S_009._SoundRequest.Task100ms "" UBYTE IS_BOOLEAN_TRUE 0 0 0 1 ECU_ADDRESS 0x1D130 READ_WRITE /end MEASUREMENT
/begin MEASUREMENT OUT_Sounds.ExternalSounds.S_010._SoundBalance.Task100ms "" SBYTE COMP_DEFAULT 0 0 -128 127 ECU_ADDRESS 0x1D131 READ_WRITE /end MEASUREMENT
/begin MEASUREMENT OUT_Sounds.ExternalSounds.S_010._SoundDeviceEnable.Task100ms "" UBYTE IS_BOOLEAN_TRUE 0 0 0 1 ECU_ADDRESS 0x1D132 READ_WRITE /end MEASUREMENT
/begin MEASUREMENT OUT_Sounds.ExternalSounds.S_010._SoundRecurrences.Task100ms "" UBYTE COMP_DEFAULT 0 0 0 255 ECU_ADDRESS 0x1D133 READ_WRITE /end MEASUREMENT
/begin MEASUREMENT OUT_Sounds.ExternalSounds.S_010._SoundRelVol.Task100ms "" UBYTE COMP_DEFAULT 0 0 0 255 ECU_ADDRESS 0x1D134 READ_WRITE /end MEASUREMENT
/begin MEASUREMENT OUT_Sounds.ExternalSounds.S_010._SoundRequest.Task100ms "" UBYTE IS_BOOLEAN_TRUE 0 0 0 1 ECU_ADDRESS 0x1D135 READ_WRITE /end MEASUREMENT
/begin MEASUREMENT OUT_Sounds.ExternalSounds.S_011._SoundBalance.Task100ms "" SBYTE COMP_DEFAULT 0 0 -128 127 ECU_ADDRESS 0x1D136 READ_WRITE /end MEASUREMENT
/begin MEASUREMENT OUT_Sounds.ExternalSounds.S_011._SoundDeviceEnable.Task100ms "" UBYTE IS_BOOLEAN_TRUE 0 0 0 1 ECU_ADDRESS 0x1D137 READ_WRITE /end MEASUREMENT
/begin MEASUREMENT OUT_Sounds.ExternalSounds.S_011._SoundRecurrences.Task100ms "" UBYTE COMP_DEFAULT 0 0 0 255 ECU_ADDRESS 0x1D138 READ_WRITE /end MEASUREMENT
/begin MEASUREMENT OUT_Sounds.ExternalSounds.S_011._SoundRelVol.Task100ms "" UBYTE COMP_DEFAULT 0 0 0 255 ECU_ADDRESS 0x1D139 READ_WRITE /end MEASUREMENT
/begin MEASUREMENT OUT_Sounds.ExternalSounds.S_011._SoundRequest.Task100ms "" UBYTE IS_BOOLEAN_TRUE 0 0 0 1 ECU_ADDRESS 0x1D13A READ_WRITE /end MEASUREMENT
/begin MEASUREMENT OUT_Sounds.ExternalSounds.S_012._SoundBalance.Task100ms "" SBYTE COMP_DEFAULT 0 0 -128 127 ECU_ADDRESS 0x1D13B READ_WRITE /end MEASUREMENT
/begin MEASUREMENT OUT_Sounds.ExternalSounds.S_012._SoundDeviceEnable.Task100ms "" UBYTE IS_BOOLEAN_TRUE 0 0 0 1 ECU_ADDRESS 0x1D13C READ_WRITE /end MEASUREMENT
/begin MEASUREMENT OUT_Sounds.ExternalSounds.S_012._SoundRecurrences.Task100ms "" UBYTE COMP_DEFAULT 0 0 0 255 ECU_ADDRESS 0x1D13D READ_WRITE /end MEASUREMENT
/begin MEASUREMENT OUT_Sounds.ExternalSounds.S_012._SoundRelVol.Task100ms "" UBYTE COMP_DEFAULT 0 0 0 255 ECU_ADDRESS 0x1D13E READ_WRITE /end MEASUREMENT
/begin MEASUREMENT OUT_Sounds.ExternalSounds.S_012._SoundRequest.Task100ms "" UBYTE IS_BOOLEAN_TRUE 0 0 0 1 ECU_ADDRESS 0x1D13F READ_WRITE /end MEASUREMENT
/begin MEASUREMENT OUT_Sounds.ExternalSounds.S_013._SoundBalance.Task100ms "" SBYTE COMP_DEFAULT 0 0 -128 127 ECU_ADDRESS 0x1D140 READ_WRITE /end MEASUREMENT
/begin MEASUREMENT OUT_Sounds.ExternalSounds.S_013._SoundDeviceEnable.Task100ms "" UBYTE IS_BOOLEAN_TRUE 0 0 0 1 ECU_ADDRESS 0x1D141 READ_WRITE /end MEASUREMENT
/begin MEASUREMENT OUT_Sounds.ExternalSounds.S_013._SoundRecurrences.Task100ms "" UBYTE COMP_DEFAULT 0 0 0 255 ECU_ADDRESS 0x1D142 READ_WRITE /end MEASUREMENT
/begin MEASUREMENT OUT_Sounds.ExternalSounds.S_013._SoundRelVol.Task100ms "" UBYTE COMP_DEFAULT 0 0 0 255 ECU_ADDRESS 0x1D143 READ_WRITE /end MEASUREMENT
/begin MEASUREMENT OUT_Sounds.ExternalSounds.S_013._SoundRequest.Task100ms "" UBYTE IS_BOOLEAN_TRUE 0 0 0 1 ECU_ADDRESS 0x1D144 READ_WRITE /end MEASUREMENT
/begin MEASUREMENT OUT_Sounds.ExternalSounds.S_014._SoundBalance.Task100ms "" SBYTE COMP_DEFAULT 0 0 -128 127 ECU_ADDRESS 0x1D145 READ_WRITE /end MEASUREMENT
/begin MEASUREMENT OUT_Sounds.ExternalSounds.S_014._SoundDeviceEnable.Task100ms "" UBYTE IS_BOOLEAN_TRUE 0 0 0 1 ECU_ADDRESS 0x1D146 READ_WRITE /end MEASUREMENT
/begin MEASUREMENT OUT_Sounds.ExternalSounds.S_014._SoundRecurrences.Task100ms "" UBYTE COMP_DEFAULT 0 0 0 255 ECU_ADDRESS 0x1D147 READ_WRITE /end MEASUREMENT
/begin MEASUREMENT OUT_Sounds.ExternalSounds.S_014._SoundRelVol.Task100ms "" UBYTE COMP_DEFAULT 0 0 0 255 ECU_ADDRESS 0x1D148 READ_WRITE /end MEASUREMENT
/begin MEASUREMENT OUT_Sounds.ExternalSounds.S_014._SoundRequest.Task100ms "" UBYTE IS_BOOLEAN_TRUE 0 0 0 1 ECU_ADDRESS 0x1D149 READ_WRITE /end MEASUREMENT
/begin MEASUREMENT OUT_Sounds.ExternalSounds.S_015._SoundBalance.Task100ms "" SBYTE COMP_DEFAULT 0 0 -128 127 ECU_ADDRESS 0x1D14A READ_WRITE /end MEASUREMENT
/begin MEASUREMENT OUT_Sounds.ExternalSounds.S_015._SoundDeviceEnable.Task100ms "" UBYTE IS_BOOLEAN_TRUE 0 0 0 1 ECU_ADDRESS 0x1D14B READ_WRITE /end MEASUREMENT
/begin MEASUREMENT OUT_Sounds.ExternalSounds.S_015._SoundRecurrences.Task100ms "" UBYTE COMP_DEFAULT 0 0 0 255 ECU_ADDRESS 0x1D14C READ_WRITE /end MEASUREMENT
/begin MEASUREMENT OUT_Sounds.ExternalSounds.S_015._SoundRelVol.Task100ms "" UBYTE COMP_DEFAULT 0 0 0 255 ECU_ADDRESS 0x1D14D READ_WRITE /end MEASUREMENT
/begin MEASUREMENT OUT_Sounds.ExternalSounds.S_015._SoundRequest.Task100ms "" UBYTE IS_BOOLEAN_TRUE 0 0 0 1 ECU_ADDRESS 0x1D14E READ_WRITE /end MEASUREMENT
/begin MEASUREMENT OUT_Sounds.ExternalSounds.S_016._SoundBalance.Task100ms "" SBYTE COMP_DEFAULT 0 0 -128 127 ECU_ADDRESS 0x1D14F READ_WRITE /end MEASUREMENT
/begin MEASUREMENT OUT_Sounds.ExternalSounds.S_016._SoundDeviceEnable.Task100ms "" UBYTE IS_BOOLEAN_TRUE 0 0 0 1 ECU_ADDRESS 0x1D150 READ_WRITE /end MEASUREMENT
/begin MEASUREMENT OUT_Sounds.ExternalSounds.S_016._SoundRecurrences.Task100ms "" UBYTE COMP_DEFAULT 0 0 0 255 ECU_ADDRESS 0x1D151 READ_WRITE /end MEASUREMENT
/begin MEASUREMENT OUT_Sounds.ExternalSounds.S_016._SoundRelVol.Task100ms "" UBYTE COMP_DEFAULT 0 0 0 255 ECU_ADDRESS 0x1D152 READ_WRITE /end MEASUREMENT
/begin MEASUREMENT OUT_Sounds.ExternalSounds.S_016._SoundRequest.Task100ms "" UBYTE IS_BOOLEAN_TRUE 0 0 0 1 ECU_ADDRESS 0x1D153 READ_WRITE /end MEASUREMENT
/begin MEASUREMENT OUT_Sounds.ExternalSounds.S_017._SoundBalance.Task100ms "" SBYTE COMP_DEFAULT 0 0 -128 127 ECU_ADDRESS 0x1D154 READ_WRITE /end MEASUREMENT
/begin MEASUREMENT OUT_Sounds.ExternalSounds.S_017._SoundDeviceEnable.Task100ms "" UBYTE IS_BOOLEAN_TRUE 0 0 0 1 ECU_ADDRESS 0x1D155 READ_WRITE /end MEASUREMENT
/begin MEASUREMENT OUT_Sounds.ExternalSounds.S_017._SoundRecurrences.Task100ms "" UBYTE COMP_DEFAULT 0 0 0 255 ECU_ADDRESS 0x1D156 READ_WRITE /end MEASUREMENT
/begin MEASUREMENT OUT_Sounds.ExternalSounds.S_017._SoundRelVol.Task100ms "" UBYTE COMP_DEFAULT 0 0 0 255 ECU_ADDRESS 0x1D157 READ_WRITE /end MEASUREMENT
/begin MEASUREMENT OUT_Sounds.ExternalSounds.S_017._SoundRequest.Task100ms "" UBYTE IS_BOOLEAN_TRUE 0 0 0 1 ECU_ADDRESS 0x1D158 READ_WRITE /end MEASUREMENT
/begin MEASUREMENT OUT_Sounds.ExternalSounds.S_018._SoundBalance.Task100ms "" SBYTE COMP_DEFAULT 0 0 -128 127 ECU_ADDRESS 0x1D159 READ_WRITE /end MEASUREMENT
/begin MEASUREMENT OUT_Sounds.ExternalSounds.S_018._SoundDeviceEnable.Task100ms "" UBYTE IS_BOOLEAN_TRUE 0 0 0 1 ECU_ADDRESS 0x1D15A READ_WRITE /end MEASUREMENT
/begin MEASUREMENT OUT_Sounds.ExternalSounds.S_018._SoundRecurrences.Task100ms "" UBYTE COMP_DEFAULT 0 0 0 255 ECU_ADDRESS 0x1D15B READ_WRITE /end MEASUREMENT
/begin MEASUREMENT OUT_Sounds.ExternalSounds.S_018._SoundRelVol.Task100ms "" UBYTE COMP_DEFAULT 0 0 0 255 ECU_ADDRESS 0x1D15C READ_WRITE /end MEASUREMENT
/begin MEASUREMENT OUT_Sounds.ExternalSounds.S_018._SoundRequest.Task100ms "" UBYTE IS_BOOLEAN_TRUE 0 0 0 1 ECU_ADDRESS 0x1D15D READ_WRITE /end MEASUREMENT
/begin MEASUREMENT OUT_Sounds.ExternalSounds.S_019._SoundBalance.Task100ms "" SBYTE COMP_DEFAULT 0 0 -128 127 ECU_ADDRESS 0x1D15E READ_WRITE /end MEASUREMENT
/begin MEASUREMENT OUT_Sounds.ExternalSounds.S_019._SoundDeviceEnable.Task100ms "" UBYTE IS_BOOLEAN_TRUE 0 0 0 1 ECU_ADDRESS 0x1D15F READ_WRITE /end MEASUREMENT
/begin MEASUREMENT OUT_Sounds.ExternalSounds.S_019._SoundRecurrences.Task100ms "" UBYTE COMP_DEFAULT 0 0 0 255 ECU_ADDRESS 0x1D160 READ_WRITE /end MEASUREMENT
/begin MEASUREMENT OUT_Sounds.ExternalSounds.S_019._SoundRelVol.Task100ms "" UBYTE COMP_DEFAULT 0 0 0 255 ECU_ADDRESS 0x1D161 READ_WRITE /end MEASUREMENT
/begin MEASUREMENT OUT_Sounds.ExternalSounds.S_019._SoundRequest.Task100ms "" UBYTE IS_BOOLEAN_TRUE 0 0 0 1 ECU_ADDRESS 0x1D162 READ_WRITE /end MEASUREMENT
/begin MEASUREMENT OUT_Sounds.ExternalSounds.S_020._SoundBalance.Task100ms "" SBYTE COMP_DEFAULT 0 0 -128 127 ECU_ADDRESS 0x1D163 READ_WRITE /end MEASUREMENT
/begin MEASUREMENT OUT_Sounds.ExternalSounds.S_020._SoundDeviceEnable.Task100ms "" UBYTE IS_BOOLEAN_TRUE 0 0 0 1 ECU_ADDRESS 0x1D164 READ_WRITE /end MEASUREMENT
/begin MEASUREMENT OUT_Sounds.ExternalSounds.S_020._SoundRecurrences.Task100ms "" UBYTE COMP_DEFAULT 0 0 0 255 ECU_ADDRESS 0x1D165 READ_WRITE /end MEASUREMENT
/begin MEASUREMENT OUT_Sounds.ExternalSounds.S_020._SoundRelVol.Task100ms "" UBYTE COMP_DEFAULT 0 0 0 255 ECU_ADDRESS 0x1D166 READ_WRITE /end MEASUREMENT
/begin MEASUREMENT OUT_Sounds.ExternalSounds.S_020._SoundRequest.Task100ms "" UBYTE IS_BOOLEAN_TRUE 0 0 0 1 ECU_ADDRESS 0x1D167 READ_WRITE /end MEASUREMENT
/begin MEASUREMENT OUT_Sounds.ExternalSounds.S_021._SoundBalance.Task100ms "" SBYTE COMP_DEFAULT 0 0 -128 127 ECU_ADDRESS 0x1D168 READ_WRITE /end MEASUREMENT
/begin MEASUREMENT OUT_Sounds.ExternalSounds.S_021._SoundDeviceEnable.Task100ms "" UBYTE IS_BOOLEAN_TRUE 0 0 0 1 ECU_ADDRESS 0x1D169 READ_WRITE /end MEASUREMENT
/begin MEASUREMENT OUT_Sounds.ExternalSounds.S_021._SoundRecurrences.Task100ms "" UBYTE COMP_DEFAULT 0 0 0 255 ECU_ADDRESS 0x1D16A READ_WRITE /end MEASUREMENT
/begin MEASUREMENT OUT_Sounds.ExternalSounds.S_021._SoundRelVol.Task100ms "" UBYTE COMP_DEFAULT 0 0 0 255 ECU_ADDRESS 0x1D16B READ_WRITE /end MEASUREMENT
/begin MEASUREMENT OUT_Sounds.ExternalSounds.S_021._SoundRequest.Task100ms "" UBYTE IS_BOOLEAN_TRUE 0 0 0 1 ECU_ADDRESS 0x1D16C READ_WRITE /end MEASUREMENT
/begin MEASUREMENT OUT_Sounds.ExternalSounds.S_022._SoundBalance.Task100ms "" SBYTE COMP_DEFAULT 0 0 -128 127 ECU_ADDRESS 0x1D16D READ_WRITE /end MEASUREMENT
/begin MEASUREMENT OUT_Sounds.ExternalSounds.S_022._SoundDeviceEnable.Task100ms "" UBYTE IS_BOOLEAN_TRUE 0 0 0 1 ECU_ADDRESS 0x1D16E READ_WRITE /end MEASUREMENT
/begin MEASUREMENT OUT_Sounds.ExternalSounds.S_022._SoundRecurrences.Task100ms "" UBYTE COMP_DEFAULT 0 0 0 255 ECU_ADDRESS 0x1D16F READ_WRITE /end MEASUREMENT
/begin MEASUREMENT OUT_Sounds.ExternalSounds.S_022._SoundRelVol.Task100ms "" UBYTE COMP_DEFAULT 0 0 0 255 ECU_ADDRESS 0x1D170 READ_WRITE /end MEASUREMENT
/begin MEASUREMENT OUT_Sounds.ExternalSounds.S_022._SoundRequest.Task100ms "" UBYTE IS_BOOLEAN_TRUE 0 0 0 1 ECU_ADDRESS 0x1D171 READ_WRITE /end MEASUREMENT
/begin MEASUREMENT OUT_Sounds.ExternalSounds.S_023._SoundBalance.Task100ms "" SBYTE COMP_DEFAULT 0 0 -128 127 ECU_ADDRESS 0x1D172 READ_WRITE /end MEASUREMENT
/begin MEASUREMENT OUT_Sounds.ExternalSounds.S_023._SoundDeviceEnable.Task100ms "" UBYTE IS_BOOLEAN_TRUE 0 0 0 1 ECU_ADDRESS 0x1D173 READ_WRITE /end MEASUREMENT
/begin MEASUREMENT OUT_Sounds.ExternalSounds.S_023._SoundRecurrences.Task100ms "" UBYTE COMP_DEFAULT 0 0 0 255 ECU_ADDRESS 0x1D174 READ_WRITE /end MEASUREMENT
/begin MEASUREMENT OUT_Sounds.ExternalSounds.S_023._SoundRelVol.Task100ms "" UBYTE COMP_DEFAULT 0 0 0 255 ECU_ADDRESS 0x1D175 READ_WRITE /end MEASUREMENT
/begin MEASUREMENT OUT_Sounds.ExternalSounds.S_023._SoundRequest.Task100ms "" UBYTE IS_BOOLEAN_TRUE 0 0 0 1 ECU_ADDRESS 0x1D176 READ_WRITE /end MEASUREMENT
/begin MEASUREMENT OUT_Sounds.ExternalSounds.S_024._SoundBalance.Task100ms "" SBYTE COMP_DEFAULT 0 0 -128 127 ECU_ADDRESS 0x1D177 READ_WRITE /end MEASUREMENT
/begin MEASUREMENT OUT_Sounds.ExternalSounds.S_024._SoundDeviceEnable.Task100ms "" UBYTE IS_BOOLEAN_TRUE 0 0 0 1 ECU_ADDRESS 0x1D178 READ_WRITE /end MEASUREMENT
/begin MEASUREMENT OUT_Sounds.ExternalSounds.S_024._SoundRecurrences.Task100ms "" UBYTE COMP_DEFAULT 0 0 0 255 ECU_ADDRESS 0x1D179 READ_WRITE /end MEASUREMENT
/begin MEASUREMENT OUT_Sounds.ExternalSounds.S_024._SoundRelVol.Task100ms "" UBYTE COMP_DEFAULT 0 0 0 255 ECU_ADDRESS 0x1D17A READ_WRITE /end MEASUREMENT
/begin MEASUREMENT OUT_Sounds.ExternalSounds.S_024._SoundRequest.Task100ms "" UBYTE IS_BOOLEAN_TRUE 0 0 0 1 ECU_ADDRESS 0x1D17B READ_WRITE /end MEASUREMENT
/begin MEASUREMENT OUT_Sounds.ExternalSounds.S_025._SoundBalance.Task100ms "" SBYTE COMP_DEFAULT 0 0 -128 127 ECU_ADDRESS 0x1D17C READ_WRITE /end MEASUREMENT
/begin MEASUREMENT OUT_Sounds.ExternalSounds.S_025._SoundDeviceEnable.Task100ms "" UBYTE IS_BOOLEAN_TRUE 0 0 0 1 ECU_ADDRESS 0x1D17D READ_WRITE /end MEASUREMENT
/begin MEASUREMENT OUT_Sounds.ExternalSounds.S_025._SoundRecurrences.Task100ms "" UBYTE COMP_DEFAULT 0 0 0 255 ECU_ADDRESS 0x1D17E READ_WRITE /end MEASUREMENT
/begin MEASUREMENT OUT_Sounds.ExternalSounds.S_025._SoundRelVol.Task100ms "" UBYTE COMP_DEFAULT 0 0 0 255 ECU_ADDRESS 0x1D17F READ_WRITE /end MEASUREMENT
/begin MEASUREMENT OUT_Sounds.ExternalSounds.S_025._SoundRequest.Task100ms "" UBYTE IS_BOOLEAN_TRUE 0 0 0 1 ECU_ADDRESS 0x1D180 READ_WRITE /end MEASUREMENT
/begin MEASUREMENT OUT_Sounds.ExternalSounds.S_026._SoundBalance.Task100ms "" SBYTE COMP_DEFAULT 0 0 -128 127 ECU_ADDRESS 0x1D181 READ_WRITE /end MEASUREMENT
/begin MEASUREMENT OUT_Sounds.ExternalSounds.S_026._SoundDeviceEnable.Task100ms "" UBYTE IS_BOOLEAN_TRUE 0 0 0 1 ECU_ADDRESS 0x1D182 READ_WRITE /end MEASUREMENT
/begin MEASUREMENT OUT_Sounds.ExternalSounds.S_026._SoundRecurrences.Task100ms "" UBYTE COMP_DEFAULT 0 0 0 255 ECU_ADDRESS 0x1D183 READ_WRITE /end MEASUREMENT
/begin MEASUREMENT OUT_Sounds.ExternalSounds.S_026._SoundRelVol.Task100ms "" UBYTE COMP_DEFAULT 0 0 0 255 ECU_ADDRESS 0x1D184 READ_WRITE /end MEASUREMENT
/begin MEASUREMENT OUT_Sounds.ExternalSounds.S_026._SoundRequest.Task100ms "" UBYTE IS_BOOLEAN_TRUE 0 0 0 1 ECU_ADDRESS 0x1D185 READ_WRITE /end MEASUREMENT
/begin MEASUREMENT OUT_Sounds.ExternalSounds.S_027._SoundBalance.Task100ms "" SBYTE COMP_DEFAULT 0 0 -128 127 ECU_ADDRESS 0x1D186 READ_WRITE /end MEASUREMENT
/begin MEASUREMENT OUT_Sounds.ExternalSounds.S_027._SoundDeviceEnable.Task100ms "" UBYTE IS_BOOLEAN_TRUE 0 0 0 1 ECU_ADDRESS 0x1D187 READ_WRITE /end MEASUREMENT
/begin MEASUREMENT OUT_Sounds.ExternalSounds.S_027._SoundRecurrences.Task100ms "" UBYTE COMP_DEFAULT 0 0 0 255 ECU_ADDRESS 0x1D188 READ_WRITE /end MEASUREMENT
/begin MEASUREMENT OUT_Sounds.ExternalSounds.S_027._SoundRelVol.Task100ms "" UBYTE COMP_DEFAULT 0 0 0 255 ECU_ADDRESS 0x1D189 READ_WRITE /end MEASUREMENT
/begin MEASUREMENT OUT_Sounds.ExternalSounds.S_027._SoundRequest.Task100ms "" UBYTE IS_BOOLEAN_TRUE 0 0 0 1 ECU_ADDRESS 0x1D18A READ_WRITE /end MEASUREMENT
/begin MEASUREMENT OUT_Sounds.ExternalSounds.S_028._SoundBalance.Task100ms "" SBYTE COMP_DEFAULT 0 0 -128 127 ECU_ADDRESS 0x1D18B READ_WRITE /end MEASUREMENT
/begin MEASUREMENT OUT_Sounds.ExternalSounds.S_028._SoundDeviceEnable.Task100ms "" UBYTE IS_BOOLEAN_TRUE 0 0 0 1 ECU_ADDRESS 0x1D18C READ_WRITE /end MEASUREMENT
/begin MEASUREMENT OUT_Sounds.ExternalSounds.S_028._SoundRecurrences.Task100ms "" UBYTE COMP_DEFAULT 0 0 0 255 ECU_ADDRESS 0x1D18D READ_WRITE /end MEASUREMENT
/begin MEASUREMENT OUT_Sounds.ExternalSounds.S_028._SoundRelVol.Task100ms "" UBYTE COMP_DEFAULT 0 0 0 255 ECU_ADDRESS 0x1D18E READ_WRITE /end MEASUREMENT
/begin MEASUREMENT OUT_Sounds.ExternalSounds.S_028._SoundRequest.Task100ms "" UBYTE IS_BOOLEAN_TRUE 0 0 0 1 ECU_ADDRESS 0x1D18F READ_WRITE /end MEASUREMENT
/begin MEASUREMENT OUT_Sounds.ExternalSounds.S_029._SoundBalance.Task100ms "" SBYTE COMP_DEFAULT 0 0 -128 127 ECU_ADDRESS 0x1D190 READ_WRITE /end MEASUREMENT
/begin MEASUREMENT OUT_Sounds.ExternalSounds.S_029._SoundDeviceEnable.Task100ms "" UBYTE IS_BOOLEAN_TRUE 0 0 0 1 ECU_ADDRESS 0x1D191 READ_WRITE /end MEASUREMENT
/begin MEASUREMENT OUT_Sounds.ExternalSounds.S_029._SoundRecurrences.Task100ms "" UBYTE COMP_DEFAULT 0 0 0 255 ECU_ADDRESS 0x1D192 READ_WRITE /end MEASUREMENT
/begin MEASUREMENT OUT_Sounds.ExternalSounds.S_029._SoundRelVol.Task100ms "" UBYTE COMP_DEFAULT 0 0 0 255 ECU_ADDRESS 0x1D193 READ_WRITE /end MEASUREMENT
/begin MEASUREMENT OUT_Sounds.ExternalSounds.S_029._SoundRequest.Task100ms "" UBYTE IS_BOOLEAN_TRUE 0 0 0 1 ECU_ADDRESS 0x1D194 READ_WRITE /end MEASUREMENT
/begin MEASUREMENT OUT_Sounds.ExternalSounds.S_030._SoundBalance.Task100ms "" SBYTE COMP_DEFAULT 0 0 -128 127 ECU_ADDRESS 0x1D195 READ_WRITE /end MEASUREMENT
/begin MEASUREMENT OUT_Sounds.ExternalSounds.S_030._SoundDeviceEnable.Task100ms "" UBYTE IS_BOOLEAN_TRUE 0 0 0 1 ECU_ADDRESS 0x1D196 READ_WRITE /end MEASUREMENT
/begin MEASUREMENT OUT_Sounds.ExternalSounds.S_030._SoundRecurrences.Task100ms "" UBYTE COMP_DEFAULT 0 0 0 255 ECU_ADDRESS 0x1D197 READ_WRITE /end MEASUREMENT
/begin MEASUREMENT OUT_Sounds.ExternalSounds.S_030._SoundRelVol.Task100ms "" UBYTE COMP_DEFAULT 0 0 0 255 ECU_ADDRESS 0x1D198 READ_WRITE /end MEASUREMENT
/begin MEASUREMENT OUT_Sounds.ExternalSounds.S_030._SoundRequest.Task100ms "" UBYTE IS_BOOLEAN_TRUE 0 0 0 1 ECU_ADDRESS 0x1D199 READ_WRITE /end MEASUREMENT
/begin MEASUREMENT OUT_Sounds.ExternalSounds.S_031._SoundBalance.Task100ms "" SBYTE COMP_DEFAULT 0 0 -128 127 ECU_ADDRESS 0x1D19A READ_WRITE /end MEASUREMENT
/begin MEASUREMENT OUT_Sounds.ExternalSounds.S_031._SoundDeviceEnable.Task100ms "" UBYTE IS_BOOLEAN_TRUE 0 0 0 1 ECU_ADDRESS 0x1D19B READ_WRITE /end MEASUREMENT
/begin MEASUREMENT OUT_Sounds.ExternalSounds.S_031._SoundRecurrences.Task100ms "" UBYTE COMP_DEFAULT 0 0 0 255 ECU_ADDRESS 0x1D19C READ_WRITE /end MEASUREMENT
/begin MEASUREMENT OUT_Sounds.ExternalSounds.S_031._SoundRelVol.Task100ms "" UBYTE COMP_DEFAULT 0 0 0 255 ECU_ADDRESS 0x1D19D READ_WRITE /end MEASUREMENT
/begin MEASUREMENT OUT_Sounds.ExternalSounds.S_031._SoundRequest.Task100ms "" UBYTE IS_BOOLEAN_TRUE 0 0 0 1 ECU_ADDRESS 0x1D19E READ_WRITE /end MEASUREMENT
/begin MEASUREMENT OUT_Sounds.ExternalSounds.S_032._SoundBalance.Task100ms "" SBYTE COMP_DEFAULT 0 0 -128 127 ECU_ADDRESS 0x1D19F READ_WRITE /end MEASUREMENT
/begin MEASUREMENT OUT_Sounds.ExternalSounds.S_032._SoundDeviceEnable.Task100ms "" UBYTE IS_BOOLEAN_TRUE 0 0 0 1 ECU_ADDRESS 0x1D1A0 READ_WRITE /end MEASUREMENT
/begin MEASUREMENT OUT_Sounds.ExternalSounds.S_032._SoundRecurrences.Task100ms "" UBYTE COMP_DEFAULT 0 0 0 255 ECU_ADDRESS 0x1D1A1 READ_WRITE /end MEASUREMENT
/begin MEASUREMENT OUT_Sounds.ExternalSounds.S_032._SoundRelVol.Task100ms "" UBYTE COMP_DEFAULT 0 0 0 255 ECU_ADDRESS 0x1D1A2 READ_WRITE /end MEASUREMENT
/begin MEASUREMENT OUT_Sounds.ExternalSounds.S_032._SoundRequest.Task100ms "" UBYTE IS_BOOLEAN_TRUE 0 0 0 1 ECU_ADDRESS 0x1D1A3 READ_WRITE /end MEASUREMENT
/begin MEASUREMENT OUT_Sounds.ExternalSounds.S_033._SoundBalance.Task100ms "" SBYTE COMP_DEFAULT 0 0 -128 127 ECU_ADDRESS 0x1D1A4 READ_WRITE /end MEASUREMENT
/begin MEASUREMENT OUT_Sounds.ExternalSounds.S_033._SoundDeviceEnable.Task100ms "" UBYTE IS_BOOLEAN_TRUE 0 0 0 1 ECU_ADDRESS 0x1D1A5 READ_WRITE /end MEASUREMENT
/begin MEASUREMENT OUT_Sounds.ExternalSounds.S_033._SoundRecurrences.Task100ms "" UBYTE COMP_DEFAULT 0 0 0 255 ECU_ADDRESS 0x1D1A6 READ_WRITE /end MEASUREMENT
/begin MEASUREMENT OUT_Sounds.ExternalSounds.S_033._SoundRelVol.Task100ms "" UBYTE COMP_DEFAULT 0 0 0 255 ECU_ADDRESS 0x1D1A7 READ_WRITE /end MEASUREMENT
/begin MEASUREMENT OUT_Sounds.ExternalSounds.S_033._SoundRequest.Task100ms "" UBYTE IS_BOOLEAN_TRUE 0 0 0 1 ECU_ADDRESS 0x1D1A8 READ_WRITE /end MEASUREMENT
/begin MEASUREMENT OUT_Sounds.ExternalSounds.S_034._SoundBalance.Task100ms "" SBYTE COMP_DEFAULT 0 0 -128 127 ECU_ADDRESS 0x1D1A9 READ_WRITE /end MEASUREMENT
/begin MEASUREMENT OUT_Sounds.ExternalSounds.S_034._SoundDeviceEnable.Task100ms "" UBYTE IS_BOOLEAN_TRUE 0 0 0 1 ECU_ADDRESS 0x1D1AA READ_WRITE /end MEASUREMENT
/begin MEASUREMENT OUT_Sounds.ExternalSounds.S_034._SoundRecurrences.Task100ms "" UBYTE COMP_DEFAULT 0 0 0 255 ECU_ADDRESS 0x1D1AB READ_WRITE /end MEASUREMENT
/begin MEASUREMENT OUT_Sounds.ExternalSounds.S_034._SoundRelVol.Task100ms "" UBYTE COMP_DEFAULT 0 0 0 255 ECU_ADDRESS 0x1D1AC READ_WRITE /end MEASUREMENT
/begin MEASUREMENT OUT_Sounds.ExternalSounds.S_034._SoundRequest.Task100ms "" UBYTE IS_BOOLEAN_TRUE 0 0 0 1 ECU_ADDRESS 0x1D1AD READ_WRITE /end MEASUREMENT
/begin MEASUREMENT OUT_Sounds.ExternalSounds.S_035._SoundBalance.Task100ms "" SBYTE COMP_DEFAULT 0 0 -128 127 ECU_ADDRESS 0x1D1AE READ_WRITE /end MEASUREMENT
/begin MEASUREMENT OUT_Sounds.ExternalSounds.S_035._SoundDeviceEnable.Task100ms "" UBYTE IS_BOOLEAN_TRUE 0 0 0 1 ECU_ADDRESS 0x1D1AF READ_WRITE /end MEASUREMENT
/begin MEASUREMENT OUT_Sounds.ExternalSounds.S_035._SoundRecurrences.Task100ms "" UBYTE COMP_DEFAULT 0 0 0 255 ECU_ADDRESS 0x1D1B0 READ_WRITE /end MEASUREMENT
/begin MEASUREMENT OUT_Sounds.ExternalSounds.S_035._SoundRelVol.Task100ms "" UBYTE COMP_DEFAULT 0 0 0 255 ECU_ADDRESS 0x1D1B1 READ_WRITE /end MEASUREMENT
/begin MEASUREMENT OUT_Sounds.ExternalSounds.S_035._SoundRequest.Task100ms "" UBYTE IS_BOOLEAN_TRUE 0 0 0 1 ECU_ADDRESS 0x1D1B2 READ_WRITE /end MEASUREMENT
/begin MEASUREMENT OUT_Sounds.ExternalSounds.S_001._SoundBalance.Task100ms "" SBYTE COMP_DEFAULT 0 0 -128 127 ECU_ADDRESS 0x1D104 READ_WRITE /end MEASUREMENT
/begin MEASUREMENT OUT_Sounds.ExternalSounds.S_001._SoundDeviceEnable.Task100ms "" UBYTE IS_BOOLEAN_TRUE 0 0 0 1 ECU_ADDRESS 0x1D105 READ_WRITE /end MEASUREMENT
/begin MEASUREMENT OUT_Sounds.ExternalSounds.S_001._SoundRecurrences.Task100ms "" UBYTE COMP_DEFAULT 0 0 0 255 ECU_ADDRESS 0x1D106 READ_WRITE /end MEASUREMENT
/begin MEASUREMENT OUT_Sounds.ExternalSounds.S_001._SoundRelVol.Task100ms "" UBYTE COMP_DEFAULT 0 0 0 255 ECU_ADDRESS 0x1D107 READ_WRITE /end MEASUREMENT
/begin MEASUREMENT OUT_Sounds.ExternalSounds.S_001._SoundRequest.Task100ms "" UBYTE IS_BOOLEAN_TRUE 0 0 0 1 ECU_ADDRESS 0x1D108 READ_WRITE /end MEASUREMENT
/begin MEASUREMENT IN_NVM.NVMPar_EngOnly.Device_State.Task200ms "" UWORD COMP_DEFAULT 0 0 0 65535 ECU_ADDRESS 0x1D0D6 READ_WRITE /end MEASUREMENT
/begin MEASUREMENT IN_NVM.NVMPar_EngOnly.PhotosensorCorrectionFactor.Task200ms "" UBYTE COMP_LINEAR.IN_NVM.NVMPar_EngOnly.PhotosensorCorrectionFactor 0 0 0 25.5 ECU_ADDRESS 0x1D0D8 READ_WRITE /end MEASUREMENT
/begin MEASUREMENT IN_NVM.NVMPar_ManTruck1.Device_State.Task40ms "" UWORD COMP_DEFAULT 0 0 0 65535 ECU_ADDRESS 0x1D434 READ_WRITE /end MEASUREMENT
/begin MEASUREMENT IN_NVM.NVMPar_ManTruck1.ClusterIlluminationTransition.Task40ms "" UBYTE COMP_LINEAR.IN_NVM.NVMPar_ManTruck1.ClusterIlluminationTransition 0 0 0 10.2 ECU_ADDRESS 0x1D436 READ_WRITE /end MEASUREMENT
/begin MEASUREMENT IN_NVM.NVMPar_ManTruck1.MswInterfaceEnbl.Task40ms "" UBYTE IS_BOOLEAN_TRUE 0 0 0 1 ECU_ADDRESS 0x1D437 READ_WRITE /end MEASUREMENT
/begin MEASUREMENT IN_NVM.NVMPar_ManTruck1.Device_State.Task50ms "" UWORD COMP_DEFAULT 0 0 0 65535 ECU_ADDRESS 0x1D2B6 READ_WRITE /end MEASUREMENT
/begin MEASUREMENT IN_NVM.NVMPar_ManTruck1.ICDISSVCfg.Task50ms "" UBYTE COMP_DEFAULT 0 0 0 255 ECU_ADDRESS 0x1D2B8 READ_WRITE /end MEASUREMENT
/begin MEASUREMENT IN_NVM.NVMPar_ManTruck1.Device_State.Task1000ms "" UWORD COMP_DEFAULT 0 0 0 65535 ECU_ADDRESS 0x1D0C0 READ_WRITE /end MEASUREMENT
/begin MEASUREMENT IN_NVM.NVMPar_ManTruck1.BrakePressureEnbl.Task1000ms "" UBYTE IS_BOOLEAN_TRUE 0 0 0 1 ECU_ADDRESS 0x1D0C2 READ_WRITE /end MEASUREMENT
/begin MEASUREMENT IN_NVM.NVMPar_ManTruck1.OilInfoEnbl.Task1000ms "" UBYTE IS_BOOLEAN_TRUE 0 0 0 1 ECU_ADDRESS 0x1D0C3 READ_WRITE /end MEASUREMENT
/begin MEASUREMENT IN_UDSServices.f_diagCommunicationState.Task1000ms "" UBYTE IS_BOOLEAN_TRUE 0 0 0 1 ECU_ADDRESS 0x1D0CB READ_WRITE /end MEASUREMENT
/begin MEASUREMENT IN_UDSServices.f_diagCommunicationType.Task1000ms "" UBYTE COMP_DEFAULT 0 0 0 255 ECU_ADDRESS 0x1D0CC READ_WRITE /end MEASUREMENT
/begin MEASUREMENT IN_UDSServices.f_diagControlType.Task1000ms "" UBYTE COMP_DEFAULT 0 0 0 255 ECU_ADDRESS 0x1D0CD READ_WRITE /end MEASUREMENT
/begin MEASUREMENT IN_UDSServices.f_diagCurrentSession.Task1000ms "" UBYTE COMP_DEFAULT 0 0 0 255 ECU_ADDRESS 0x1D0CE READ_WRITE /end MEASUREMENT
/begin MEASUREMENT IN_UDSServices.f_diagResetToDefaultState.Task1000ms "" UBYTE IS_BOOLEAN_TRUE 0 0 0 1 ECU_ADDRESS 0x1D0CF READ_WRITE /end MEASUREMENT
/begin MEASUREMENT OUT_UDSServices.f_diagRejectAccess.Task1000ms "" UBYTE COMP_DEFAULT 0 0 0 255 ECU_ADDRESS 0x1D04F READ_WRITE /end MEASUREMENT
/begin MEASUREMENT OUT_UDSServices.f_diagResponseCode.Task1000ms "" UBYTE COMP_DEFAULT 0 0 0 255 ECU_ADDRESS 0x1D050 READ_WRITE /end MEASUREMENT
/begin MEASUREMENT IN_UDSServices.RoutineControlService.f_resetRoutinesRequest.Task1000ms "" UBYTE IS_BOOLEAN_TRUE 0 0 0 1 ECU_ADDRESS 0x1D0CA READ_WRITE /end MEASUREMENT
/begin MEASUREMENT IN_UDSServices.RoutineControlService.RID_SysPerformance.FpsEn.Task1000ms "" UBYTE IS_BOOLEAN_TRUE 0 0 0 1 ECU_ADDRESS 0x1D0C4 READ_WRITE /end MEASUREMENT
/begin MEASUREMENT IN_UDSServices.RoutineControlService.RID_SysPerformance.FrameCounterEn.Task1000ms "" UBYTE IS_BOOLEAN_TRUE 0 0 0 1 ECU_ADDRESS 0x1D0C5 READ_WRITE /end MEASUREMENT
/begin MEASUREMENT IN_UDSServices.RoutineControlService.RID_SysPerformance.FrameTimeEn.Task1000ms "" UBYTE IS_BOOLEAN_TRUE 0 0 0 1 ECU_ADDRESS 0x1D0C6 READ_WRITE /end MEASUREMENT
/begin MEASUREMENT IN_UDSServices.RoutineControlService.RID_SysPerformance.RequestResults_Request.Task1000ms "" UBYTE IS_BOOLEAN_TRUE 0 0 0 1 ECU_ADDRESS 0x1D0C7 READ_WRITE /end MEASUREMENT
/begin MEASUREMENT IN_UDSServices.RoutineControlService.RID_SysPerformance.StartRoutine_Request.Task1000ms "" UBYTE IS_BOOLEAN_TRUE 0 0 0 1 ECU_ADDRESS 0x1D0C8 READ_WRITE /end MEASUREMENT
/begin MEASUREMENT IN_UDSServices.RoutineControlService.RID_SysPerformance.StopRoutine_Request.Task1000ms "" UBYTE IS_BOOLEAN_TRUE 0 0 0 1 ECU_ADDRESS 0x1D0C9 READ_WRITE /end MEASUREMENT
/begin MEASUREMENT OUT_UDSServices.RoutineControlService.RID_SysPerformance.Response_Code.Task1000ms "" UBYTE COMP_DEFAULT 0 0 0 255 ECU_ADDRESS 0x1D04C READ_WRITE /end MEASUREMENT
/begin MEASUREMENT OUT_UDSServices.RoutineControlService.RID_SysPerformance.StartResponseCode.Task1000ms "" UBYTE COMP_DEFAULT 0 0 0 255 ECU_ADDRESS 0x1D04D READ_WRITE /end MEASUREMENT
/begin MEASUREMENT OUT_UDSServices.RoutineControlService.RID_SysPerformance.StopResponseCode.Task1000ms "" UBYTE COMP_DEFAULT 0 0 0 255 ECU_ADDRESS 0x1D04E READ_WRITE /end MEASUREMENT
/begin MEASUREMENT INOUT_RAMDevice.bo_FpcAssetFailure.Task40ms "" UBYTE IS_BOOLEAN_TRUE 0 0 0 1 ECU_ADDRESS 0x1D342 READ_WRITE /end MEASUREMENT
/begin MEASUREMENT INOUT_RAMDevice.bo_FpcReady.Task40ms "" UBYTE IS_BOOLEAN_TRUE 0 0 0 1 ECU_ADDRESS 0x1D343 READ_WRITE /end MEASUREMENT
/begin MEASUREMENT INOUT_RAMDevice.bo_ModelHoldApp.Task40ms "" UBYTE IS_BOOLEAN_TRUE 0 0 0 1 ECU_ADDRESS 0x1D344 READ_WRITE /end MEASUREMENT
/begin MEASUREMENT INOUT_RAMDevice.u8_AssetState.Task40ms "" UBYTE COMP_DEFAULT 0 0 0 255 ECU_ADDRESS 0x1D345 READ_WRITE /end MEASUREMENT
/begin MEASUREMENT INOUT_RAMDevice.u8_SystemState.Task40ms "" UBYTE COMP_DEFAULT 0 0 0 255 ECU_ADDRESS 0x1D346 READ_WRITE /end MEASUREMENT
/begin MEASUREMENT INOUT_RAMDevice.bo_Asset4BasicLoaded.Task50ms "" UBYTE IS_BOOLEAN_TRUE 0 0 0 1 ECU_ADDRESS 0x1D25C READ_WRITE /end MEASUREMENT
/begin MEASUREMENT INOUT_RAMDevice.bo_Fcn002Enabled.Task50ms "" UBYTE IS_BOOLEAN_TRUE 0 0 0 1 ECU_ADDRESS 0x1D25D READ_WRITE /end MEASUREMENT
/begin MEASUREMENT INOUT_RAMDevice.bo_Fcn002HmiDataEn.Task50ms "" UBYTE IS_BOOLEAN_TRUE 0 0 0 1 ECU_ADDRESS 0x1D25E READ_WRITE /end MEASUREMENT
/begin MEASUREMENT INOUT_RAMDevice.bo_Fcn005Enabled.Task50ms "" UBYTE IS_BOOLEAN_TRUE 0 0 0 1 ECU_ADDRESS 0x1D25F READ_WRITE /end MEASUREMENT
/begin MEASUREMENT INOUT_RAMDevice.bo_Fcn005HmiDataEn.Task50ms "" UBYTE IS_BOOLEAN_TRUE 0 0 0 1 ECU_ADDRESS 0x1D260 READ_WRITE /end MEASUREMENT
/begin MEASUREMENT INOUT_RAMDevice.bo_Fcn006Enabled.Task50ms "" UBYTE IS_BOOLEAN_TRUE 0 0 0 1 ECU_ADDRESS 0x1D261 READ_WRITE /end MEASUREMENT
/begin MEASUREMENT INOUT_RAMDevice.bo_Fcn006HmiDataEn.Task50ms "" UBYTE IS_BOOLEAN_TRUE 0 0 0 1 ECU_ADDRESS 0x1D262 READ_WRITE /end MEASUREMENT
/begin MEASUREMENT INOUT_RAMDevice.bo_Fcn007Enabled.Task50ms "" UBYTE IS_BOOLEAN_TRUE 0 0 0 1 ECU_ADDRESS 0x1D263 READ_WRITE /end MEASUREMENT
/begin MEASUREMENT INOUT_RAMDevice.bo_Fcn016Enable.Task50ms "" UBYTE IS_BOOLEAN_TRUE 0 0 0 1 ECU_ADDRESS 0x1D264 READ_WRITE /end MEASUREMENT
/begin MEASUREMENT INOUT_RAMDevice.bo_Fcn017Enable.Task50ms "" UBYTE IS_BOOLEAN_TRUE 0 0 0 1 ECU_ADDRESS 0x1D265 READ_WRITE /end MEASUREMENT
/begin MEASUREMENT INOUT_RAMDevice.bo_Fcn020Enabled.Task50ms "" UBYTE IS_BOOLEAN_TRUE 0 0 0 1 ECU_ADDRESS 0x1D266 READ_WRITE /end MEASUREMENT
/begin MEASUREMENT INOUT_RAMDevice.bo_Fcn031Enabled.Task50ms "" UBYTE IS_BOOLEAN_TRUE 0 0 0 1 ECU_ADDRESS 0x1D267 READ_WRITE /end MEASUREMENT
/begin MEASUREMENT INOUT_RAMDevice.bo_Fcn052Enabled.Task50ms "" UBYTE IS_BOOLEAN_TRUE 0 0 0 1 ECU_ADDRESS 0x1D268 READ_WRITE /end MEASUREMENT
/begin MEASUREMENT INOUT_RAMDevice.bo_Fcn054Enabled.Task50ms "" UBYTE IS_BOOLEAN_TRUE 0 0 0 1 ECU_ADDRESS 0x1D269 READ_WRITE /end MEASUREMENT
/begin MEASUREMENT INOUT_RAMDevice.bo_Fcn056Enabled.Task50ms "" UBYTE IS_BOOLEAN_TRUE 0 0 0 1 ECU_ADDRESS 0x1D26A READ_WRITE /end MEASUREMENT
/begin MEASUREMENT INOUT_RAMDevice.bo_Fcn057Enabled.Task50ms "" UBYTE IS_BOOLEAN_TRUE 0 0 0 1 ECU_ADDRESS 0x1D26B READ_WRITE /end MEASUREMENT
/begin MEASUREMENT INOUT_RAMDevice.bo_Fcn057HmiDataEn.Task50ms "" UBYTE IS_BOOLEAN_TRUE 0 0 0 1 ECU_ADDRESS 0x1D26C READ_WRITE /end MEASUREMENT
/begin MEASUREMENT INOUT_RAMDevice.bo_Fcn058Enabled.Task50ms "" UBYTE IS_BOOLEAN_TRUE 0 0 0 1 ECU_ADDRESS 0x1D26D READ_WRITE /end MEASUREMENT
/begin MEASUREMENT INOUT_RAMDevice.bo_Fcn059Enabled.Task50ms "" UBYTE IS_BOOLEAN_TRUE 0 0 0 1 ECU_ADDRESS 0x1D26E READ_WRITE /end MEASUREMENT
/begin MEASUREMENT INOUT_RAMDevice.u8_AssetState.Task50ms "" UBYTE COMP_DEFAULT 0 0 0 255 ECU_ADDRESS 0x1D26F READ_WRITE /end MEASUREMENT
/begin MEASUREMENT INOUT_RAMDevice.u8_Fcn002Scr.Task50ms "" UBYTE COMP_DEFAULT 0 0 0 255 ECU_ADDRESS 0x1D270 READ_WRITE /end MEASUREMENT
/begin MEASUREMENT INOUT_RAMDevice.u8_Fcn005Scr.Task50ms "" UBYTE COMP_DEFAULT 0 0 0 255 ECU_ADDRESS 0x1D271 READ_WRITE /end MEASUREMENT
/begin MEASUREMENT INOUT_RAMDevice.u8_Fcn006Scr.Task50ms "" UBYTE COMP_DEFAULT 0 0 0 255 ECU_ADDRESS 0x1D272 READ_WRITE /end MEASUREMENT
/begin MEASUREMENT INOUT_RAMDevice.u8_Fcn007Scr.Task50ms "" UBYTE COMP_DEFAULT 0 0 0 255 ECU_ADDRESS 0x1D273 READ_WRITE /end MEASUREMENT
/begin MEASUREMENT INOUT_RAMDevice.u8_Fcn016Scr.Task50ms "" UBYTE COMP_DEFAULT 0 0 0 255 ECU_ADDRESS 0x1D274 READ_WRITE /end MEASUREMENT
/begin MEASUREMENT INOUT_RAMDevice.u8_Fcn017Scr.Task50ms "" UBYTE COMP_DEFAULT 0 0 0 255 ECU_ADDRESS 0x1D275 READ_WRITE /end MEASUREMENT
/begin MEASUREMENT INOUT_RAMDevice.u8_Fcn020Scr.Task50ms "" UBYTE COMP_DEFAULT 0 0 0 255 ECU_ADDRESS 0x1D276 READ_WRITE /end MEASUREMENT
/begin MEASUREMENT INOUT_RAMDevice.u8_Fcn031Scr.Task50ms "" UBYTE COMP_DEFAULT 0 0 0 255 ECU_ADDRESS 0x1D277 READ_WRITE /end MEASUREMENT
/begin MEASUREMENT INOUT_RAMDevice.u8_Fcn052Scr.Task50ms "" UBYTE COMP_DEFAULT 0 0 0 255 ECU_ADDRESS 0x1D278 READ_WRITE /end MEASUREMENT
/begin MEASUREMENT INOUT_RAMDevice.u8_Fcn054Scr.Task50ms "" UBYTE COMP_DEFAULT 0 0 0 255 ECU_ADDRESS 0x1D279 READ_WRITE /end MEASUREMENT
/begin MEASUREMENT INOUT_RAMDevice.u8_Fcn056Scr.Task50ms "" UBYTE COMP_DEFAULT 0 0 0 255 ECU_ADDRESS 0x1D27A READ_WRITE /end MEASUREMENT
/begin MEASUREMENT INOUT_RAMDevice.u8_Fcn057Scr.Task50ms "" UBYTE COMP_DEFAULT 0 0 0 255 ECU_ADDRESS 0x1D27B READ_WRITE /end MEASUREMENT
/begin MEASUREMENT INOUT_RAMDevice.u8_Fcn058Scr.Task50ms "" UBYTE COMP_DEFAULT 0 0 0 255 ECU_ADDRESS 0x1D27C READ_WRITE /end MEASUREMENT
/begin MEASUREMENT INOUT_RAMDevice.u8_Fcn059Scr.Task50ms "" UBYTE COMP_DEFAULT 0 0 0 255 ECU_ADDRESS 0x1D27D READ_WRITE /end MEASUREMENT
/begin MEASUREMENT INOUT_RAMDevice.u8_ICDISSVCtrl.Task50ms "" UBYTE COMP_DEFAULT 0 0 0 255 ECU_ADDRESS 0x1D27E READ_WRITE /end MEASUREMENT
/begin MEASUREMENT INOUT_RAMDevice.u8_SystemState.Task50ms "" UBYTE COMP_DEFAULT 0 0 0 255 ECU_ADDRESS 0x1D27F READ_WRITE /end MEASUREMENT
/begin MEASUREMENT INOUT_RAMDevice.bo_Asset1Alerts1Loaded.Task100ms "" UBYTE IS_BOOLEAN_TRUE 0 0 0 1 ECU_ADDRESS 0x1D1B4 READ_WRITE /end MEASUREMENT
/begin MEASUREMENT INOUT_RAMDevice.bo_Asset2Alerts2Loaded.Task100ms "" UBYTE IS_BOOLEAN_TRUE 0 0 0 1 ECU_ADDRESS 0x1D1B5 READ_WRITE /end MEASUREMENT
/begin MEASUREMENT INOUT_RAMDevice.bo_Asset3WelcomeLoaded.Task100ms "" UBYTE IS_BOOLEAN_TRUE 0 0 0 1 ECU_ADDRESS 0x1D1B6 READ_WRITE /end MEASUREMENT
/begin MEASUREMENT INOUT_RAMDevice.bo_Asset4BasicLoaded.Task100ms "" UBYTE IS_BOOLEAN_TRUE 0 0 0 1 ECU_ADDRESS 0x1D1B7 READ_WRITE /end MEASUREMENT
/begin MEASUREMENT INOUT_RAMDevice.bo_Asset5Full1Loaded.Task100ms "" UBYTE IS_BOOLEAN_TRUE 0 0 0 1 ECU_ADDRESS 0x1D1B8 READ_WRITE /end MEASUREMENT
/begin MEASUREMENT INOUT_RAMDevice.bo_Asset6Full2Loaded.Task100ms "" UBYTE IS_BOOLEAN_TRUE 0 0 0 1 ECU_ADDRESS 0x1D1B9 READ_WRITE /end MEASUREMENT
/begin MEASUREMENT INOUT_RAMDevice.bo_Fcn016Enable.Task100ms "" UBYTE IS_BOOLEAN_TRUE 0 0 0 1 ECU_ADDRESS 0x1D1BA READ_WRITE /end MEASUREMENT
/begin MEASUREMENT INOUT_RAMDevice.bo_Fcn017Enable.Task100ms "" UBYTE IS_BOOLEAN_TRUE 0 0 0 1 ECU_ADDRESS 0x1D1BB READ_WRITE /end MEASUREMENT
/begin MEASUREMENT INOUT_RAMDevice.bo_Fcn054Enabled.Task100ms "" UBYTE IS_BOOLEAN_TRUE 0 0 0 1 ECU_ADDRESS 0x1D1BC READ_WRITE /end MEASUREMENT
/begin MEASUREMENT INOUT_RAMDevice.bo_FpcAssetFailure.Task100ms "" UBYTE IS_BOOLEAN_TRUE 0 0 0 1 ECU_ADDRESS 0x1D1BD READ_WRITE /end MEASUREMENT
/begin MEASUREMENT INOUT_RAMDevice.bo_FpcReady.Task100ms "" UBYTE IS_BOOLEAN_TRUE 0 0 0 1 ECU_ADDRESS 0x1D1BE READ_WRITE /end MEASUREMENT
/begin MEASUREMENT INOUT_RAMDevice.bo_ModelHoldApp.Task100ms "" UBYTE IS_BOOLEAN_TRUE 0 0 0 1 ECU_ADDRESS 0x1D1BF READ_WRITE /end MEASUREMENT
/begin MEASUREMENT INOUT_RAMDevice.u8_AssetState.Task100ms "" UBYTE COMP_DEFAULT 0 0 0 255 ECU_ADDRESS 0x1D1C0 READ_WRITE /end MEASUREMENT
/begin MEASUREMENT INOUT_RAMDevice.u8_Fcn016Scr.Task100ms "" UBYTE COMP_DEFAULT 0 0 0 255 ECU_ADDRESS 0x1D1C1 READ_WRITE /end MEASUREMENT
/begin MEASUREMENT INOUT_RAMDevice.u8_Fcn017Scr.Task100ms "" UBYTE COMP_DEFAULT 0 0 0 255 ECU_ADDRESS 0x1D1C2 READ_WRITE /end MEASUREMENT
/begin MEASUREMENT INOUT_RAMDevice.u8_Fcn054Scr.Task100ms "" UBYTE COMP_DEFAULT 0 0 0 255 ECU_ADDRESS 0x1D1C3 READ_WRITE /end MEASUREMENT
/begin MEASUREMENT INOUT_RAMDevice.u8_SystemState.Task100ms "" UBYTE COMP_DEFAULT 0 0 0 255 ECU_ADDRESS 0x1D1C4 READ_WRITE /end MEASUREMENT
/begin MEASUREMENT INOUT_RAMDevice.u8_SystemState.Task200ms "" UBYTE COMP_DEFAULT 0 0 0 255 ECU_ADDRESS 0x1D0E5 READ_WRITE /end MEASUREMENT
/begin MEASUREMENT INOUT_RAMDevice.bo_Fcn002Enabled.Task1000ms "" UBYTE IS_BOOLEAN_TRUE 0 0 0 1 ECU_ADDRESS 0x1D051 READ_WRITE /end MEASUREMENT
/begin MEASUREMENT INOUT_RAMDevice.bo_Fcn005Enabled.Task1000ms "" UBYTE IS_BOOLEAN_TRUE 0 0 0 1 ECU_ADDRESS 0x1D052 READ_WRITE /end MEASUREMENT
/begin MEASUREMENT INOUT_RAMDevice.bo_Fcn006Enabled.Task1000ms "" UBYTE IS_BOOLEAN_TRUE 0 0 0 1 ECU_ADDRESS 0x1D053 READ_WRITE /end MEASUREMENT
/begin MEASUREMENT INOUT_RAMDevice.bo_Fcn007Enabled.Task1000ms "" UBYTE IS_BOOLEAN_TRUE 0 0 0 1 ECU_ADDRESS 0x1D054 READ_WRITE /end MEASUREMENT
/begin MEASUREMENT INOUT_RAMDevice.bo_Fcn020Enabled.Task1000ms "" UBYTE IS_BOOLEAN_TRUE 0 0 0 1 ECU_ADDRESS 0x1D055 READ_WRITE /end MEASUREMENT
/begin MEASUREMENT INOUT_RAMDevice.bo_Fcn052Enabled.Task1000ms "" UBYTE IS_BOOLEAN_TRUE 0 0 0 1 ECU_ADDRESS 0x1D056 READ_WRITE /end MEASUREMENT
/begin MEASUREMENT INOUT_RAMDevice.bo_Fcn058Enabled.Task1000ms "" UBYTE IS_BOOLEAN_TRUE 0 0 0 1 ECU_ADDRESS 0x1D057 READ_WRITE /end MEASUREMENT
/begin MEASUREMENT INOUT_RAMDevice.bo_Fcn059Enabled.Task1000ms "" UBYTE IS_BOOLEAN_TRUE 0 0 0 1 ECU_ADDRESS 0x1D058 READ_WRITE /end MEASUREMENT
/begin MEASUREMENT INOUT_RAMDevice.u8_AssetState.Task1000ms "" UBYTE COMP_DEFAULT 0 0 0 255 ECU_ADDRESS 0x1D059 READ_WRITE /end MEASUREMENT
/begin MEASUREMENT INOUT_RAMDevice.u8_Fcn002Scr.Task1000ms "" UBYTE COMP_DEFAULT 0 0 0 255 ECU_ADDRESS 0x1D05A READ_WRITE /end MEASUREMENT
/begin MEASUREMENT INOUT_RAMDevice.u8_Fcn005Scr.Task1000ms "" UBYTE COMP_DEFAULT 0 0 0 255 ECU_ADDRESS 0x1D05B READ_WRITE /end MEASUREMENT
/begin MEASUREMENT INOUT_RAMDevice.u8_Fcn006Scr.Task1000ms "" UBYTE COMP_DEFAULT 0 0 0 255 ECU_ADDRESS 0x1D05C READ_WRITE /end MEASUREMENT
/begin MEASUREMENT INOUT_RAMDevice.u8_Fcn007Scr.Task1000ms "" UBYTE COMP_DEFAULT 0 0 0 255 ECU_ADDRESS 0x1D05D READ_WRITE /end MEASUREMENT
/begin MEASUREMENT INOUT_RAMDevice.u8_Fcn020Scr.Task1000ms "" UBYTE COMP_DEFAULT 0 0 0 255 ECU_ADDRESS 0x1D05E READ_WRITE /end MEASUREMENT
/begin MEASUREMENT INOUT_RAMDevice.u8_Fcn052Scr.Task1000ms "" UBYTE COMP_DEFAULT 0 0 0 255 ECU_ADDRESS 0x1D05F READ_WRITE /end MEASUREMENT
/begin MEASUREMENT INOUT_RAMDevice.u8_Fcn058Scr.Task1000ms "" UBYTE COMP_DEFAULT 0 0 0 255 ECU_ADDRESS 0x1D060 READ_WRITE /end MEASUREMENT
/begin MEASUREMENT INOUT_RAMDevice.u8_Fcn059Scr.Task1000ms "" UBYTE COMP_DEFAULT 0 0 0 255 ECU_ADDRESS 0x1D061 READ_WRITE /end MEASUREMENT
/begin MEASUREMENT IN_FPCControl.f_FPCcntrlAsset01state.Task100ms "" UBYTE COMP_DEFAULT 0 0 0 255 ECU_ADDRESS 0x1D1EE READ_WRITE /end MEASUREMENT
/begin MEASUREMENT IN_FPCControl.f_FPCcntrlAsset02state.Task100ms "" UBYTE COMP_DEFAULT 0 0 0 255 ECU_ADDRESS 0x1D1EF READ_WRITE /end MEASUREMENT
/begin MEASUREMENT IN_FPCControl.f_FPCcntrlAsset03state.Task100ms "" UBYTE COMP_DEFAULT 0 0 0 255 ECU_ADDRESS 0x1D1F0 READ_WRITE /end MEASUREMENT
/begin MEASUREMENT IN_FPCControl.f_FPCcntrlAsset04state.Task100ms "" UBYTE COMP_DEFAULT 0 0 0 255 ECU_ADDRESS 0x1D1F1 READ_WRITE /end MEASUREMENT
/begin MEASUREMENT IN_FPCControl.f_FPCcntrlAsset05state.Task100ms "" UBYTE COMP_DEFAULT 0 0 0 255 ECU_ADDRESS 0x1D1F2 READ_WRITE /end MEASUREMENT
/begin MEASUREMENT IN_FPCControl.f_FPCcntrlGHMIstate.Task100ms "" UBYTE COMP_DEFAULT 0 0 0 255 ECU_ADDRESS 0x1D1F3 READ_WRITE /end MEASUREMENT
/begin MEASUREMENT IN_FPCControl.f_FpcCntrlVidChnlState.Task100ms "" UBYTE COMP_DEFAULT 0 0 0 255 ECU_ADDRESS 0x1D1F4 READ_WRITE /end MEASUREMENT
/begin MEASUREMENT IN_FPCControl.f_FpcCntrlVidState.Task100ms "" UBYTE COMP_DEFAULT 0 0 0 255 ECU_ADDRESS 0x1D1F5 READ_WRITE /end MEASUREMENT
/begin MEASUREMENT OUT_FPCControl.f_FPCcntrlDeviceEna.Task100ms "" UBYTE IS_BOOLEAN_TRUE 0 0 0 1 ECU_ADDRESS 0x1D1C5 READ_WRITE /end MEASUREMENT
/begin MEASUREMENT OUT_FPCControl.f_FpcCntrlOperationMode.Task100ms "" UBYTE COMP_DEFAULT 0 0 0 255 ECU_ADDRESS 0x1D1C6 READ_WRITE /end MEASUREMENT
/begin MEASUREMENT DIAG_FPCControl.f_FPCcntrlAsset01state_DIAG.Task100ms "Diagnosis Input" UWORD COMP_DEFAULT 0 0 0 65535 ECU_ADDRESS 0x1D1F8 READ_WRITE /end MEASUREMENT
/begin MEASUREMENT DIAG_FPCControl.f_FPCcntrlAsset02state_DIAG.Task100ms "Diagnosis Input" UWORD COMP_DEFAULT 0 0 0 65535 ECU_ADDRESS 0x1D1FA READ_WRITE /end MEASUREMENT
/begin MEASUREMENT DIAG_FPCControl.f_FPCcntrlAsset03state_DIAG.Task100ms "Diagnosis Input" UWORD COMP_DEFAULT 0 0 0 65535 ECU_ADDRESS 0x1D1FC READ_WRITE /end MEASUREMENT
/begin MEASUREMENT DIAG_FPCControl.f_FPCcntrlAsset04state_DIAG.Task100ms "Diagnosis Input" UWORD COMP_DEFAULT 0 0 0 65535 ECU_ADDRESS 0x1D1FE READ_WRITE /end MEASUREMENT
/begin MEASUREMENT DIAG_FPCControl.f_FPCcntrlAsset05state_DIAG.Task100ms "Diagnosis Input" UWORD COMP_DEFAULT 0 0 0 65535 ECU_ADDRESS 0x1D200 READ_WRITE /end MEASUREMENT
/begin MEASUREMENT DIAG_FPCControl.f_FPCcntrlGHMIstate_DIAG.Task100ms "Diagnosis Input" UWORD COMP_DEFAULT 0 0 0 65535 ECU_ADDRESS 0x1D202 READ_WRITE /end MEASUREMENT
/begin MEASUREMENT DIAG_FPCControl.f_FpcCntrlVidChnlState_DIAG.Task100ms "Diagnosis Input" UWORD COMP_DEFAULT 0 0 0 65535 ECU_ADDRESS 0x1D204 READ_WRITE /end MEASUREMENT
/begin MEASUREMENT DIAG_FPCControl.f_FpcCntrlVidState_DIAG.Task100ms "Diagnosis Input" UWORD COMP_DEFAULT 0 0 0 65535 ECU_ADDRESS 0x1D206 READ_WRITE /end MEASUREMENT
/begin MEASUREMENT IN_Powerfaildevice.Trm30.f_powerFailTrm30.Task40ms "" SBYTE COMP_DEFAULT 0 0 -128 127 ECU_ADDRESS 0x1D438 READ_WRITE /end MEASUREMENT
/begin MEASUREMENT IN_Powerfaildevice.UVAlarm.f_powerFailUVAlarm.Task40ms "" UBYTE IS_BOOLEAN_TRUE 0 0 0 1 ECU_ADDRESS 0x1D439 READ_WRITE /end MEASUREMENT
/begin MEASUREMENT IN_TFTTemperature.f_TFTtempDegree.Task40ms "" SBYTE COMP_DEFAULT 0 0 -128 127 ECU_ADDRESS 0x1D43A READ_WRITE /end MEASUREMENT
/begin MEASUREMENT DIAG_TFTTemperature.f_TFTtempDegree_DIAG.Task40ms "Diagnosis Input" UWORD COMP_DEFAULT 0 0 0 65535 ECU_ADDRESS 0x1D45A READ_WRITE /end MEASUREMENT
/begin MEASUREMENT OUT_TelltalesOutput.Output.f_telltale01.Task40ms "" UBYTE IS_BOOLEAN_TRUE 0 0 0 1 ECU_ADDRESS 0x1D347 READ_WRITE /end MEASUREMENT
/begin MEASUREMENT OUT_TelltalesOutput.Output.f_telltale02.Task40ms "" UBYTE IS_BOOLEAN_TRUE 0 0 0 1 ECU_ADDRESS 0x1D348 READ_WRITE /end MEASUREMENT
/begin MEASUREMENT OUT_TelltalesOutput.Output.f_telltale03.Task40ms "" UBYTE IS_BOOLEAN_TRUE 0 0 0 1 ECU_ADDRESS 0x1D349 READ_WRITE /end MEASUREMENT
/begin MEASUREMENT OUT_TelltalesOutput.Output.f_telltale04.Task40ms "" UBYTE IS_BOOLEAN_TRUE 0 0 0 1 ECU_ADDRESS 0x1D34A READ_WRITE /end MEASUREMENT
/begin MEASUREMENT OUT_TelltalesOutput.Output.f_telltale05.Task40ms "" UBYTE IS_BOOLEAN_TRUE 0 0 0 1 ECU_ADDRESS 0x1D34B READ_WRITE /end MEASUREMENT
/begin MEASUREMENT OUT_TelltalesOutput.Output.f_telltale06.Task40ms "" UBYTE IS_BOOLEAN_TRUE 0 0 0 1 ECU_ADDRESS 0x1D34C READ_WRITE /end MEASUREMENT
/begin MEASUREMENT OUT_TelltalesOutput.Output.f_telltale07.Task40ms "" UBYTE IS_BOOLEAN_TRUE 0 0 0 1 ECU_ADDRESS 0x1D34D READ_WRITE /end MEASUREMENT
/begin MEASUREMENT OUT_TelltalesOutput.Output.f_telltale08.Task40ms "" UBYTE IS_BOOLEAN_TRUE 0 0 0 1 ECU_ADDRESS 0x1D34E READ_WRITE /end MEASUREMENT
/begin MEASUREMENT OUT_TelltalesOutput.Output.f_telltale09.Task40ms "" UBYTE IS_BOOLEAN_TRUE 0 0 0 1 ECU_ADDRESS 0x1D34F READ_WRITE /end MEASUREMENT
/begin MEASUREMENT OUT_TelltalesOutput.Output.f_telltale10.Task40ms "" UBYTE IS_BOOLEAN_TRUE 0 0 0 1 ECU_ADDRESS 0x1D350 READ_WRITE /end MEASUREMENT
/begin MEASUREMENT OUT_TelltalesOutput.Output.f_telltale11.Task40ms "" UBYTE IS_BOOLEAN_TRUE 0 0 0 1 ECU_ADDRESS 0x1D351 READ_WRITE /end MEASUREMENT
/begin MEASUREMENT OUT_TelltalesOutput.Output.f_telltale12.Task40ms "" UBYTE IS_BOOLEAN_TRUE 0 0 0 1 ECU_ADDRESS 0x1D352 READ_WRITE /end MEASUREMENT
/begin MEASUREMENT OUT_TelltalesOutput.Output.f_telltale13.Task40ms "" UBYTE IS_BOOLEAN_TRUE 0 0 0 1 ECU_ADDRESS 0x1D353 READ_WRITE /end MEASUREMENT
/begin MEASUREMENT OUT_TelltalesOutput.Output.f_telltale14.Task40ms "" UBYTE IS_BOOLEAN_TRUE 0 0 0 1 ECU_ADDRESS 0x1D354 READ_WRITE /end MEASUREMENT
/begin MEASUREMENT OUT_TelltalesOutput.Output.f_telltale15.Task40ms "" UBYTE IS_BOOLEAN_TRUE 0 0 0 1 ECU_ADDRESS 0x1D355 READ_WRITE /end MEASUREMENT
/begin MEASUREMENT OUT_TelltalesOutput.Output.f_telltale16.Task40ms "" UBYTE IS_BOOLEAN_TRUE 0 0 0 1 ECU_ADDRESS 0x1D356 READ_WRITE /end MEASUREMENT
/begin MEASUREMENT OUT_TelltalesOutput.Output.f_telltale17.Task40ms "" UBYTE IS_BOOLEAN_TRUE 0 0 0 1 ECU_ADDRESS 0x1D357 READ_WRITE /end MEASUREMENT
/begin MEASUREMENT OUT_TelltalesOutput.Output.f_telltale18.Task40ms "" UBYTE IS_BOOLEAN_TRUE 0 0 0 1 ECU_ADDRESS 0x1D358 READ_WRITE /end MEASUREMENT
/begin MEASUREMENT OUT_TelltalesOutput.Output.f_telltale19.Task40ms "" UBYTE IS_BOOLEAN_TRUE 0 0 0 1 ECU_ADDRESS 0x1D359 READ_WRITE /end MEASUREMENT
/begin MEASUREMENT OUT_TelltalesOutput.Output.f_telltale20.Task40ms "" UBYTE IS_BOOLEAN_TRUE 0 0 0 1 ECU_ADDRESS 0x1D35A READ_WRITE /end MEASUREMENT
/begin MEASUREMENT OUT_TelltalesOutput.Output.f_telltale21.Task40ms "" UBYTE IS_BOOLEAN_TRUE 0 0 0 1 ECU_ADDRESS 0x1D35B READ_WRITE /end MEASUREMENT
/begin MEASUREMENT OUT_TelltalesOutput.Output.f_telltale22.Task40ms "" UBYTE IS_BOOLEAN_TRUE 0 0 0 1 ECU_ADDRESS 0x1D35C READ_WRITE /end MEASUREMENT
/begin MEASUREMENT OUT_TelltalesOutput.Output.f_telltale23.Task40ms "" UBYTE IS_BOOLEAN_TRUE 0 0 0 1 ECU_ADDRESS 0x1D35D READ_WRITE /end MEASUREMENT
/begin MEASUREMENT OUT_TelltalesOutput.Output.f_telltale24.Task40ms "" UBYTE IS_BOOLEAN_TRUE 0 0 0 1 ECU_ADDRESS 0x1D35E READ_WRITE /end MEASUREMENT
/begin MEASUREMENT OUT_TelltalesOutput.Output.f_telltale25.Task40ms "" UBYTE IS_BOOLEAN_TRUE 0 0 0 1 ECU_ADDRESS 0x1D35F READ_WRITE /end MEASUREMENT
/begin MEASUREMENT OUT_TelltalesOutput.Output.f_telltale26.Task40ms "" UBYTE IS_BOOLEAN_TRUE 0 0 0 1 ECU_ADDRESS 0x1D360 READ_WRITE /end MEASUREMENT
/begin MEASUREMENT OUT_TelltalesOutput.Output.f_telltale27.Task40ms "" UBYTE IS_BOOLEAN_TRUE 0 0 0 1 ECU_ADDRESS 0x1D361 READ_WRITE /end MEASUREMENT
/begin MEASUREMENT OUT_TelltalesOutput.Output.f_telltale28.Task40ms "" UBYTE IS_BOOLEAN_TRUE 0 0 0 1 ECU_ADDRESS 0x1D362 READ_WRITE /end MEASUREMENT
/begin MEASUREMENT OUT_TelltalesOutput.Output.f_telltale29.Task40ms "" UBYTE IS_BOOLEAN_TRUE 0 0 0 1 ECU_ADDRESS 0x1D363 READ_WRITE /end MEASUREMENT
/begin MEASUREMENT OUT_TelltalesOutput.Output.f_telltale32.Task40ms "" UBYTE IS_BOOLEAN_TRUE 0 0 0 1 ECU_ADDRESS 0x1D364 READ_WRITE /end MEASUREMENT
/begin MEASUREMENT OUT_TelltalesOutput.Output.f_telltale33.Task40ms "" UBYTE IS_BOOLEAN_TRUE 0 0 0 1 ECU_ADDRESS 0x1D365 READ_WRITE /end MEASUREMENT
/begin MEASUREMENT OUT_TelltalesOutput.Output.f_telltale34.Task40ms "" UBYTE IS_BOOLEAN_TRUE 0 0 0 1 ECU_ADDRESS 0x1D366 READ_WRITE /end MEASUREMENT
/begin MEASUREMENT OUT_TelltalesOutput.Output.f_telltale35.Task40ms "" UBYTE IS_BOOLEAN_TRUE 0 0 0 1 ECU_ADDRESS 0x1D367 READ_WRITE /end MEASUREMENT
/begin MEASUREMENT OUT_TelltalesOutput.Output.f_telltale36.Task40ms "" UBYTE IS_BOOLEAN_TRUE 0 0 0 1 ECU_ADDRESS 0x1D368 READ_WRITE /end MEASUREMENT
/begin MEASUREMENT IN_DisplayIlluminationControl.Display.f_backLightDeviceState.Task40ms "" UWORD COMP_DEFAULT 0 0 0 65535 ECU_ADDRESS 0x1D43C READ_WRITE /end MEASUREMENT
/begin MEASUREMENT IN_DisplayIlluminationControl.Display.f_backlightGetPdf.Task40ms "" UBYTE COMP_DEFAULT 0 0 0 255 ECU_ADDRESS 0x1D43E READ_WRITE /end MEASUREMENT
/begin MEASUREMENT OUT_DisplayIlluminationControl.Display.f_backlightPDF.Task40ms "" UBYTE COMP_DEFAULT 0 0 0 255 ECU_ADDRESS 0x1D369 READ_WRITE /end MEASUREMENT
/begin MEASUREMENT IN_LIN0.DeviceState.Task40ms "3.1.2.1.1 DeviceState" UWORD COMP_DEFAULT 0 0 0 65535 ECU_ADDRESS 0x1D458 READ_WRITE /end MEASUREMENT
/begin MEASUREMENT OUT_LIN0.LinNetworkRequest1.Task40ms "" UBYTE IS_BOOLEAN_TRUE 0 0 0 1 ECU_ADDRESS 0x1D37A READ_WRITE /end MEASUREMENT
/begin MEASUREMENT OUT_LIN0.ScheduleTable.Task40ms "" UBYTE COMP_DEFAULT 0 0 0 255 ECU_ADDRESS 0x1D37B READ_WRITE /end MEASUREMENT
/begin MEASUREMENT DIAG_LIN0.ScheduleTable_DIAG.Task40ms "Diagnostic Input" UWORD COMP_DEFAULT 0 0 0 65535 ECU_ADDRESS 0x1D45C READ_WRITE /end MEASUREMENT
/begin MEASUREMENT IN_Node_MFL.MFLs_01.DeviceState.Task40ms "" UWORD COMP_DEFAULT 0 0 0 65535 ECU_ADDRESS 0x1D44A READ_WRITE /end MEASUREMENT
/begin MEASUREMENT IN_Node_MFL.MFLs_01.MFLSbyte1.Task40ms "" UBYTE COMP_DEFAULT 0 0 0 255 ECU_ADDRESS 0x1D44C READ_WRITE /end MEASUREMENT
/begin MEASUREMENT IN_Node_MFL.MFLs_01.MFLSbyte2.Task40ms "" UBYTE COMP_DEFAULT 0 0 0 255 ECU_ADDRESS 0x1D44D READ_WRITE /end MEASUREMENT
/begin MEASUREMENT IN_Node_MFL.MFLs_01.MFLSbyte3.Task40ms "" UBYTE COMP_DEFAULT 0 0 0 255 ECU_ADDRESS 0x1D44E READ_WRITE /end MEASUREMENT
/begin MEASUREMENT IN_Node_MFL.MFLs_01.MFLSbyte4.Task40ms "" UBYTE COMP_DEFAULT 0 0 0 255 ECU_ADDRESS 0x1D44F READ_WRITE /end MEASUREMENT
/begin MEASUREMENT IN_Node_MFL.MFLs_01.MFLSbyte5.Task40ms "" UBYTE COMP_DEFAULT 0 0 0 255 ECU_ADDRESS 0x1D450 READ_WRITE /end MEASUREMENT
/begin MEASUREMENT IN_Node_MFL.MFLs_01.MFLSbyte6.Task40ms "" UBYTE COMP_DEFAULT 0 0 0 255 ECU_ADDRESS 0x1D451 READ_WRITE /end MEASUREMENT
/begin MEASUREMENT IN_Node_MFL.MFLs_01.MFLSbyte7.Task40ms "" UBYTE COMP_DEFAULT 0 0 0 255 ECU_ADDRESS 0x1D452 READ_WRITE /end MEASUREMENT
/begin MEASUREMENT IN_Node_MFL.MFLs_01.MFLSbyte8.Task40ms "" UBYTE COMP_DEFAULT 0 0 0 255 ECU_ADDRESS 0x1D453 READ_WRITE /end MEASUREMENT
/begin MEASUREMENT IN_Node_MFL.GRA_ACCs_01.DeviceState.Task40ms "" UWORD COMP_DEFAULT 0 0 0 65535 ECU_ADDRESS 0x1D440 READ_WRITE /end MEASUREMENT
/begin MEASUREMENT IN_Node_MFL.GRA_ACCs_01.GRAbyte1.Task40ms "" UBYTE COMP_DEFAULT 0 0 0 255 ECU_ADDRESS 0x1D442 READ_WRITE /end MEASUREMENT
/begin MEASUREMENT IN_Node_MFL.GRA_ACCs_01.GRAbyte2.Task40ms "" UBYTE COMP_DEFAULT 0 0 0 255 ECU_ADDRESS 0x1D443 READ_WRITE /end MEASUREMENT
/begin MEASUREMENT IN_Node_MFL.GRA_ACCs_01.GRAbyte3.Task40ms "" UBYTE COMP_DEFAULT 0 0 0 255 ECU_ADDRESS 0x1D444 READ_WRITE /end MEASUREMENT
/begin MEASUREMENT IN_Node_MFL.GRA_ACCs_01.GRAbyte4.Task40ms "" UBYTE COMP_DEFAULT 0 0 0 255 ECU_ADDRESS 0x1D445 READ_WRITE /end MEASUREMENT
/begin MEASUREMENT IN_Node_MFL.GRA_ACCs_01.GRAbyte5.Task40ms "" UBYTE COMP_DEFAULT 0 0 0 255 ECU_ADDRESS 0x1D446 READ_WRITE /end MEASUREMENT
/begin MEASUREMENT IN_Node_MFL.GRA_ACCs_01.GRAbyte6.Task40ms "" UBYTE COMP_DEFAULT 0 0 0 255 ECU_ADDRESS 0x1D447 READ_WRITE /end MEASUREMENT
/begin MEASUREMENT IN_Node_MFL.GRA_ACCs_01.GRAbyte7.Task40ms "" UBYTE COMP_DEFAULT 0 0 0 255 ECU_ADDRESS 0x1D448 READ_WRITE /end MEASUREMENT
/begin MEASUREMENT IN_Node_MFL.GRA_ACCs_01.GRAbyte8.Task40ms "" UBYTE COMP_DEFAULT 0 0 0 255 ECU_ADDRESS 0x1D449 READ_WRITE /end MEASUREMENT
/begin MEASUREMENT IN_Node_MFL.UHRe_01.DeviceState.Task40ms "" UWORD COMP_DEFAULT 0 0 0 65535 ECU_ADDRESS 0x1D456 READ_WRITE /end MEASUREMENT
/begin MEASUREMENT OUT_Node_MFL.UHRe_01.UHREbyte1.Task40ms "" UBYTE COMP_DEFAULT 0 0 0 255 ECU_ADDRESS 0x1D372 READ_WRITE /end MEASUREMENT
/begin MEASUREMENT OUT_Node_MFL.UHRe_01.UHREbyte2.Task40ms "" UBYTE COMP_DEFAULT 0 0 0 255 ECU_ADDRESS 0x1D373 READ_WRITE /end MEASUREMENT
/begin MEASUREMENT OUT_Node_MFL.UHRe_01.UHREbyte3.Task40ms "" UBYTE COMP_DEFAULT 0 0 0 255 ECU_ADDRESS 0x1D374 READ_WRITE /end MEASUREMENT
/begin MEASUREMENT OUT_Node_MFL.UHRe_01.UHREbyte4.Task40ms "" UBYTE COMP_DEFAULT 0 0 0 255 ECU_ADDRESS 0x1D375 READ_WRITE /end MEASUREMENT
/begin MEASUREMENT OUT_Node_MFL.UHRe_01.UHREbyte5.Task40ms "" UBYTE COMP_DEFAULT 0 0 0 255 ECU_ADDRESS 0x1D376 READ_WRITE /end MEASUREMENT
/begin MEASUREMENT OUT_Node_MFL.UHRe_01.UHREbyte6.Task40ms "" UBYTE COMP_DEFAULT 0 0 0 255 ECU_ADDRESS 0x1D377 READ_WRITE /end MEASUREMENT
/begin MEASUREMENT OUT_Node_MFL.UHRe_01.UHREbyte7.Task40ms "" UBYTE COMP_DEFAULT 0 0 0 255 ECU_ADDRESS 0x1D378 READ_WRITE /end MEASUREMENT
/begin MEASUREMENT OUT_Node_MFL.UHRe_01.UHREbyte8.Task40ms "" UBYTE COMP_DEFAULT 0 0 0 255 ECU_ADDRESS 0x1D379 READ_WRITE /end MEASUREMENT
/begin MEASUREMENT IN_Node_MFL.MFLe_01.DeviceState.Task40ms "" UWORD COMP_DEFAULT 0 0 0 65535 ECU_ADDRESS 0x1D454 READ_WRITE /end MEASUREMENT
/begin MEASUREMENT OUT_Node_MFL.MFLe_01.MFLEbyte1.Task40ms "" UBYTE COMP_DEFAULT 0 0 0 255 ECU_ADDRESS 0x1D36A READ_WRITE /end MEASUREMENT
/begin MEASUREMENT OUT_Node_MFL.MFLe_01.MFLEbyte2.Task40ms "" UBYTE COMP_DEFAULT 0 0 0 255 ECU_ADDRESS 0x1D36B READ_WRITE /end MEASUREMENT
/begin MEASUREMENT OUT_Node_MFL.MFLe_01.MFLEbyte3.Task40ms "" UBYTE COMP_DEFAULT 0 0 0 255 ECU_ADDRESS 0x1D36C READ_WRITE /end MEASUREMENT
/begin MEASUREMENT OUT_Node_MFL.MFLe_01.MFLEbyte4.Task40ms "" UBYTE COMP_DEFAULT 0 0 0 255 ECU_ADDRESS 0x1D36D READ_WRITE /end MEASUREMENT
/begin MEASUREMENT OUT_Node_MFL.MFLe_01.MFLEbyte5.Task40ms "" UBYTE COMP_DEFAULT 0 0 0 255 ECU_ADDRESS 0x1D36E READ_WRITE /end MEASUREMENT
/begin MEASUREMENT OUT_Node_MFL.MFLe_01.MFLEbyte6.Task40ms "" UBYTE COMP_DEFAULT 0 0 0 255 ECU_ADDRESS 0x1D36F READ_WRITE /end MEASUREMENT
/begin MEASUREMENT OUT_Node_MFL.MFLe_01.MFLEbyte7.Task40ms "" UBYTE COMP_DEFAULT 0 0 0 255 ECU_ADDRESS 0x1D370 READ_WRITE /end MEASUREMENT
/begin MEASUREMENT OUT_Node_MFL.MFLe_01.MFLEbyte8.Task40ms "" UBYTE COMP_DEFAULT 0 0 0 255 ECU_ADDRESS 0x1D371 READ_WRITE /end MEASUREMENT
/begin MEASUREMENT IN_LightSensor.LightSensorValue.Task200ms "" ULONG COMP_DEFAULT 0 0 0 4294967295 ECU_ADDRESS 0x1D0DC READ_WRITE /end MEASUREMENT
/begin MEASUREMENT DIAG_LightSensor.LightSensorValue_DIAG.Task200ms "Diagnostic Input" UWORD COMP_DEFAULT 0 0 0 65535 ECU_ADDRESS 0x1D0E6 READ_WRITE /end MEASUREMENT
/begin CHARACTERISTIC ClusterIlluminationTransition "ClusterIlluminationTransition: 40ms/bit, Raw Range 0..255" VALUE 0x1DAEC LC_A_UINT8 0 COMP_LINEAR.ClusterIlluminationTransition 0 10.2 /end CHARACTERISTIC
/begin CHARACTERISTIC MswInterfaceEnbl "MswInterfaceEnbl: Enable Msw interface" VALUE 0x1DAED LC_A_BOOLEAN 0 IS_BOOLEAN_TRUE 0 1 /end CHARACTERISTIC
/begin CHARACTERISTIC ICDISSVCfg "ICDISSVCfg: [0]NavDis_AdasDis; [1]NavDis_AdasEn; [2]NavEn_AdasDis; [3]NavEn_AdasEn;" VALUE 0x1DAEE LC_A_UINT8 0 COMP_DEFAULT 0 255 /end CHARACTERISTIC
/begin CHARACTERISTIC BrakePressureEnbl "BrakePressureEnbl: [0]Brake Pressure Fcn disabled; [1]Brake Pressure Fcn enabled;" VALUE 0x1DAEF LC_A_BOOLEAN 0 IS_BOOLEAN_TRUE 0 1 /end CHARACTERISTIC
/begin CHARACTERISTIC OilInfoEnbl "OilInfoEnbl: [0]Oil Info Fcn disabled; [1]Oil InfoPressure Fcn enabled;" VALUE 0x1DAF0 LC_A_BOOLEAN 0 IS_BOOLEAN_TRUE 0 1 /end CHARACTERISTIC
/begin CHARACTERISTIC PhotosensorCorrectionFactor "PhotosensorCorrectionFactor" VALUE 0x1DAF6 LC_A_UINT8 0 COMP_LINEAR.PhotosensorCorrectionFactor 0 25.5 /end CHARACTERISTIC
/begin GROUP SYSTEM.HMI.HMIDataFcnVirtualTelltale "HMIDataFcnVirtualTelltale"
 /begin ANNOTATION ANNOTATION_LABEL "Instance" ANNOTATION_ORIGIN "Group" /begin ANNOTATION_TEXT "17" /end ANNOTATION_TEXT /end ANNOTATION
 /begin ANNOTATION ANNOTATION_LABEL "TaskCycleTime" ANNOTATION_ORIGIN "Group" /begin ANNOTATION_TEXT "0" /end ANNOTATION_TEXT /end ANNOTATION
 /begin ANNOTATION ANNOTATION_LABEL "TimeResolution" ANNOTATION_ORIGIN "Group" /begin ANNOTATION_TEXT "0" /end ANNOTATION_TEXT /end ANNOTATION
 /begin REF_MEASUREMENT OUT_HMI.HMIDataFcnVirtualTelltale.SymbolVTT01.Task40ms OUT_HMI.HMIDataFcnVirtualTelltale.SymbolVTT02.Task40ms OUT_HMI.HMIDataFcnVirtualTelltale.SymbolVTT03.Task40ms OUT_HMI.HMIDataFcnVirtualTelltale.SymbolVTT04.Task40ms OUT_HMI.HMIDataFcnVirtualTelltale.SymbolVTT05.Task40ms OUT_HMI.HMIDataFcnVirtualTelltale.SymbolVTT06.Task40ms OUT_HMI.HMIDataFcnVirtualTelltale.SymbolVTT07.Task40ms OUT_HMI.HMIDataFcnVirtualTelltale.SymbolVTT08.Task40ms OUT_HMI.HMIDataFcnVirtualTelltale.SymbolVTT09.Task40ms OUT_HMI.HMIDataFcnVirtualTelltale.SymbolVTT10.Task40ms OUT_HMI.HMIDataFcnVirtualTelltale.SymbolVTT11.Task40ms OUT_HMI.HMIDataFcnVirtualTelltale.SymbolVTT12.Task40ms OUT_HMI.HMIDataFcnVirtualTelltale.SymbolVTT13.Task40ms OUT_HMI.HMIDataFcnVirtualTelltale.SymbolVTT14.Task40ms OUT_HMI.HMIDataFcnVirtualTelltale.SymbolVTT15.Task40ms OUT_HMI.HMIDataFcnVirtualTelltale.SymbolVTT16.Task40ms OUT_HMI.HMIDataFcnVirtualTelltale.SymbolVTT17.Task40ms OUT_HMI.HMIDataFcnVirtualTelltale.SymbolVTT18.Task40ms OUT_HMI.HMIDataFcnVirtualTelltale.SymbolVTT19.Task40ms OUT_HMI.HMIDataFcnVirtualTelltale.SymbolVTT20.Task40ms OUT_HMI.HMIDataFcnVirtualTelltale.SymbolVTT21.Task40ms OUT_HMI.HMIDataFcnVirtualTelltale.SymbolVTT22.Task40ms OUT_HMI.HMIDataFcnVirtualTelltale.SymbolVTT23.Task40ms OUT_HMI.HMIDataFcnVirtualTelltale.SymbolVTT24.Task40ms OUT_HMI.HMIDataFcnVirtualTelltale._Ena.Task50ms /end REF_MEASUREMENT
/end GROUP
/begin GROUP SYSTEM.HMI.HMIDataFcnVirtualTelltale1 "HMIDataFcnVirtualTelltale1"
 /begin ANNOTATION ANNOTATION_LABEL "Instance" ANNOTATION_ORIGIN "Group" /begin ANNOTATION_TEXT "18" /end ANNOTATION_TEXT /end ANNOTATION
 /begin ANNOTATION ANNOTATION_LABEL "TaskCycleTime" ANNOTATION_ORIGIN "Group" /begin ANNOTATION_TEXT "0" /end ANNOTATION_TEXT /end ANNOTATION
 /begin ANNOTATION ANNOTATION_LABEL "TimeResolution" ANNOTATION_ORIGIN "Group" /begin ANNOTATION_TEXT "0" /end ANNOTATION_TEXT /end ANNOTATION
 /begin REF_MEASUREMENT OUT_HMI.HMIDataFcnVirtualTelltale1.SymbolVTT25.Task40ms OUT_HMI.HMIDataFcnVirtualTelltale1.SymbolVTT26.Task40ms OUT_HMI.HMIDataFcnVirtualTelltale1.SymbolVTT27.Task40ms OUT_HMI.HMIDataFcnVirtualTelltale1.SymbolVTT28.Task40ms OUT_HMI.HMIDataFcnVirtualTelltale1.SymbolVTT29.Task40ms OUT_HMI.HMIDataFcnVirtualTelltale1.SymbolVTT30.Task40ms OUT_HMI.HMIDataFcnVirtualTelltale1.SymbolVTT31.Task40ms OUT_HMI.HMIDataFcnVirtualTelltale1.SymbolVTT32.Task40ms OUT_HMI.HMIDataFcnVirtualTelltale1.SymbolVTT33.Task40ms OUT_HMI.HMIDataFcnVirtualTelltale1.SymbolVTT34.Task40ms OUT_HMI.HMIDataFcnVirtualTelltale1.SymbolVTT35.Task40ms OUT_HMI.HMIDataFcnVirtualTelltale1.SymbolVTT36.Task40ms OUT_HMI.HMIDataFcnVirtualTelltale1.SymbolVTT37.Task40ms OUT_HMI.HMIDataFcnVirtualTelltale1.SymbolVTT38.Task40ms OUT_HMI.HMIDataFcnVirtualTelltale1.SymbolVTT39.Task40ms OUT_HMI.HMIDataFcnVirtualTelltale1.SymbolVTT40.Task40ms OUT_HMI.HMIDataFcnVirtualTelltale1.SymbolVTT41.Task40ms OUT_HMI.HMIDataFcnVirtualTelltale1.SymbolVTT42.Task40ms OUT_HMI.HMIDataFcnVirtualTelltale1.SymbolVTT43.Task40ms OUT_HMI.HMIDataFcnVirtualTelltale1.SymbolVTT44.Task40ms OUT_HMI.HMIDataFcnVirtualTelltale1.SymbolVTT45.Task40ms OUT_HMI.HMIDataFcnVirtualTelltale1.SymbolVTT46.Task40ms OUT_HMI.HMIDataFcnVirtualTelltale1.SymbolVTT47.Task40ms OUT_HMI.HMIDataFcnVirtualTelltale1._Ena.Task50ms /end REF_MEASUREMENT
/end GROUP
/begin GROUP SYSTEM.HMI.HMIDataGeneral1 "HMIDataGeneral1"
 /begin ANNOTATION ANNOTATION_LABEL "Instance" ANNOTATION_ORIGIN "Group" /begin ANNOTATION_TEXT "19" /end ANNOTATION_TEXT /end ANNOTATION
 /begin ANNOTATION ANNOTATION_LABEL "TaskCycleTime" ANNOTATION_ORIGIN "Group" /begin ANNOTATION_TEXT "0" /end ANNOTATION_TEXT /end ANNOTATION
 /begin ANNOTATION ANNOTATION_LABEL "TimeResolution" ANNOTATION_ORIGIN "Group" /begin ANNOTATION_TEXT "0" /end ANNOTATION_TEXT /end ANNOTATION
 /begin REF_MEASUREMENT OUT_HMI.HMIDataGeneral1.SubViewTransAnimationRqst.Task50ms OUT_HMI.HMIDataGeneral1._Ena.Task100ms OUT_HMI.HMIDataGeneral1.NightMode.Task200ms OUT_HMI.HMIDataGeneral1.FpsEn.Task1000ms OUT_HMI.HMIDataGeneral1.FrameCounterEn.Task1000ms OUT_HMI.HMIDataGeneral1.FrameTimeEn.Task1000ms /end REF_MEASUREMENT
/end GROUP
/begin GROUP SYSTEM.HMI.HMIDataHmiHdl "HMIDataHmiHdl"
 /begin ANNOTATION ANNOTATION_LABEL "Instance" ANNOTATION_ORIGIN "Group" /begin ANNOTATION_TEXT "20" /end ANNOTATION_TEXT /end ANNOTATION
 /begin ANNOTATION ANNOTATION_LABEL "TaskCycleTime" ANNOTATION_ORIGIN "Group" /begin ANNOTATION_TEXT "0" /end ANNOTATION_TEXT /end ANNOTATION
 /begin ANNOTATION ANNOTATION_LABEL "TimeResolution" ANNOTATION_ORIGIN "Group" /begin ANNOTATION_TEXT "0" /end ANNOTATION_TEXT /end ANNOTATION
 /begin REF_MEASUREMENT OUT_HMI.HMIDataHmiHdl.FcnBackgroundScr.Task50ms OUT_HMI.HMIDataHmiHdl.FcnBrakePressureLeftScr.Task50ms OUT_HMI.HMIDataHmiHdl.FcnBrakePressureRightScr.Task50ms OUT_HMI.HMIDataHmiHdl.FcnConsumptionLeftScr.Task50ms OUT_HMI.HMIDataHmiHdl.FcnConsumptionRightScr.Task50ms OUT_HMI.HMIDataHmiHdl.FcnCoolantTemperatureScr.Task50ms OUT_HMI.HMIDataHmiHdl.FcnDiagnosticsScr.Task50ms OUT_HMI.HMIDataHmiHdl.FcnDriversGradeScr.Task50ms OUT_HMI.HMIDataHmiHdl.FcnGearScr.Task50ms OUT_HMI.HMIDataHmiHdl.FcnNotificationLeftScr.Task50ms OUT_HMI.HMIDataHmiHdl.FcnNotificationRightScr.Task50ms OUT_HMI.HMIDataHmiHdl.FcnOdometerScr.Task50ms OUT_HMI.HMIDataHmiHdl.FcnOilInfoLeftScr.Task50ms OUT_HMI.HMIDataHmiHdl.FcnOilInfoRightScr.Task50ms OUT_HMI.HMIDataHmiHdl.FcnRpmGaugeBigScr.Task50ms OUT_HMI.HMIDataHmiHdl.FcnRpmGaugeSmallScr.Task50ms OUT_HMI.HMIDataHmiHdl.FcnSpeedGaugeScr.Task50ms OUT_HMI.HMIDataHmiHdl.FcnTripmeterScr.Task50ms OUT_HMI.HMIDataHmiHdl.FcnVehicleSpeedDigitalDA03Scr.Task50ms OUT_HMI.HMIDataHmiHdl.FcnVehicleSpeedDigitalDA06Scr.Task50ms OUT_HMI.HMIDataHmiHdl.FcnVehicleSpeedDigitalDA13Scr.Task50ms OUT_HMI.HMIDataHmiHdl.FcnVehicleSpeedDigitalDA14Scr.Task50ms OUT_HMI.HMIDataHmiHdl._Ena.Task100ms /end REF_MEASUREMENT
/end GROUP
/begin GROUP SYSTEM.HMI.HMICtrlGeneral1 "HMICtrlGeneral1"
 /begin ANNOTATION ANNOTATION_LABEL "Instance" ANNOTATION_ORIGIN "Group" /begin ANNOTATION_TEXT "0" /end ANNOTATION_TEXT /end ANNOTATION
 /begin ANNOTATION ANNOTATION_LABEL "TaskCycleTime" ANNOTATION_ORIGIN "Group" /begin ANNOTATION_TEXT "0" /end ANNOTATION_TEXT /end ANNOTATION
 /begin ANNOTATION ANNOTATION_LABEL "TimeResolution" ANNOTATION_ORIGIN "Group" /begin ANNOTATION_TEXT "0" /end ANNOTATION_TEXT /end ANNOTATION
 /begin REF_MEASUREMENT OUT_HMI.HMICtrlGeneral1.Language.Task50ms OUT_HMI.HMICtrlGeneral1._Ena.Task100ms OUT_HMI.HMICtrlGeneral1.CAGEnAssetAlerts01.Task100ms OUT_HMI.HMICtrlGeneral1.CAGEnAssetAlerts02.Task100ms OUT_HMI.HMICtrlGeneral1.CAGEnAssetBasic.Task100ms OUT_HMI.HMICtrlGeneral1.CAGEnAssetFull01.Task100ms OUT_HMI.HMICtrlGeneral1.CAGEnAssetFull02.Task100ms OUT_HMI.HMICtrlGeneral1.CAGEnAssetWelcome.Task100ms /end REF_MEASUREMENT
/end GROUP
/begin GROUP SYSTEM.HMI "HMI"
 /begin ANNOTATION ANNOTATION_LABEL "Instance" ANNOTATION_ORIGIN "Group" /begin ANNOTATION_TEXT "0" /end ANNOTATION_TEXT /end ANNOTATION
 /begin ANNOTATION ANNOTATION_LABEL "TaskCycleTime" ANNOTATION_ORIGIN "Group" /begin ANNOTATION_TEXT "0" /end ANNOTATION_TEXT /end ANNOTATION
 /begin ANNOTATION ANNOTATION_LABEL "TimeResolution" ANNOTATION_ORIGIN "Group" /begin ANNOTATION_TEXT "0" /end ANNOTATION_TEXT /end ANNOTATION
 /begin SUB_GROUP SYSTEM.HMI.HMICtrlGeneral2 SYSTEM.HMI.HMIDataFcnBackground SYSTEM.HMI.HMIDataFcnBrakePressure SYSTEM.HMI.HMIDataFcnConsumption SYSTEM.HMI.HMIDataFcnCoolantTemp SYSTEM.HMI.HMIDataFcnDiagnostics SYSTEM.HMI.HMIDataFcnDriversGrade SYSTEM.HMI.HMIDataFcnESpdGauge SYSTEM.HMI.HMIDataFcnGear SYSTEM.HMI.HMIDataFcnNotificationLeft SYSTEM.HMI.HMIDataFcnNotificationRight SYSTEM.HMI.HMIDataFcnOdometer SYSTEM.HMI.HMIDataFcnOilInfo SYSTEM.HMI.HMIDataFcnTripmeter SYSTEM.HMI.HMIDataFcnVhSpdDigital SYSTEM.HMI.HMIDataFcnVhSpdGauge SYSTEM.HMI.HMIDataFcnVirtualTelltale SYSTEM.HMI.HMIDataFcnVirtualTelltale1 SYSTEM.HMI.HMIDataGeneral1 SYSTEM.HMI.HMIDataHmiHdl SYSTEM.HMI.HMICtrlGeneral1 /end SUB_GROUP
/end GROUP
/begin GROUP SYSTEM.Sounds.ExternalSounds.ChannelStatus "ChannelStatus"
 /begin ANNOTATION ANNOTATION_LABEL "Instance" ANNOTATION_ORIGIN "Group" /begin ANNOTATION_TEXT "0" /end ANNOTATION_TEXT /end ANNOTATION
 /begin ANNOTATION ANNOTATION_LABEL "TaskCycleTime" ANNOTATION_ORIGIN "Group" /begin ANNOTATION_TEXT "0" /end ANNOTATION_TEXT /end ANNOTATION
 /begin ANNOTATION ANNOTATION_LABEL "TimeResolution" ANNOTATION_ORIGIN "Group" /begin ANNOTATION_TEXT "0" /end ANNOTATION_TEXT /end ANNOTATION
 /begin REF_MEASUREMENT IN_Sounds.ExternalSounds.ChannelStatus.f_channelStatus.Task100ms IN_Sounds.ExternalSounds.ChannelStatus.f_soundState.Task100ms DIAG_Sounds.ExternalSounds.ChannelStatus.f_soundState_DIAG.Task100ms /end REF_MEASUREMENT
/end GROUP
/begin GROUP SYSTEM.Sounds.ExternalSounds.S_002 "S_002"
 /begin ANNOTATION ANNOTATION_LABEL "Instance" ANNOTATION_ORIGIN "Group" /begin ANNOTATION_TEXT "1" /end ANNOTATION_TEXT /end ANNOTATION
 /begin ANNOTATION ANNOTATION_LABEL "TaskCycleTime" ANNOTATION_ORIGIN "Group" /begin ANNOTATION_TEXT "0" /end ANNOTATION_TEXT /end ANNOTATION
 /begin ANNOTATION ANNOTATION_LABEL "TimeResolution" ANNOTATION_ORIGIN "Group" /begin ANNOTATION_TEXT "0" /end ANNOTATION_TEXT /end ANNOTATION
 /begin REF_MEASUREMENT OUT_Sounds.ExternalSounds.S_002._SoundBalance.Task100ms OUT_Sounds.ExternalSounds.S_002._SoundDeviceEnable.Task100ms OUT_Sounds.ExternalSounds.S_002._SoundRecurrences.Task100ms OUT_Sounds.ExternalSounds.S_002._SoundRelVol.Task100ms OUT_Sounds.ExternalSounds.S_002._SoundRequest.Task100ms /end REF_MEASUREMENT
/end GROUP
/begin GROUP SYSTEM.Sounds.ExternalSounds.S_003 "S_003"
 /begin ANNOTATION ANNOTATION_LABEL "Instance" ANNOTATION_ORIGIN "Group" /begin ANNOTATION_TEXT "2" /end ANNOTATION_TEXT /end ANNOTATION
 /begin ANNOTATION ANNOTATION_LABEL "TaskCycleTime" ANNOTATION_ORIGIN "Group" /begin ANNOTATION_TEXT "0" /end ANNOTATION_TEXT /end ANNOTATION
 /begin ANNOTATION ANNOTATION_LABEL "TimeResolution" ANNOTATION_ORIGIN "Group" /begin ANNOTATION_TEXT "0" /end ANNOTATION_TEXT /end ANNOTATION
 /begin REF_MEASUREMENT OUT_Sounds.ExternalSounds.S_003._SoundBalance.Task100ms OUT_Sounds.ExternalSounds.S_003._SoundDeviceEnable.Task100ms OUT_Sounds.ExternalSounds.S_003._SoundRecurrences.Task100ms OUT_Sounds.ExternalSounds.S_003._SoundRelVol.Task100ms OUT_Sounds.ExternalSounds.S_003._SoundRequest.Task100ms /end REF_MEASUREMENT
/end GROUP
/begin GROUP SYSTEM.Sounds.ExternalSounds.S_004 "S_004"
 /begin ANNOTATION ANNOTATION_LABEL "Instance" ANNOTATION_ORIGIN "Group" /begin ANNOTATION_TEXT "3" /end ANNOTATION_TEXT /end ANNOTATION
 /begin ANNOTATION ANNOTATION_LABEL "TaskCycleTime" ANNOTATION_ORIGIN "Group" /begin ANNOTATION_TEXT "0" /end ANNOTATION_TEXT /end ANNOTATION
 /begin ANNOTATION ANNOTATION_LABEL "TimeResolution" ANNOTATION_ORIGIN "Group" /begin ANNOTATION_TEXT "0" /end ANNOTATION_TEXT /end ANNOTATION
 /begin REF_MEASUREMENT OUT_Sounds.ExternalSounds.S_004._SoundBalance.Task100ms OUT_Sounds.ExternalSounds.S_004._SoundDeviceEnable.Task100ms OUT_Sounds.ExternalSounds.S_004._SoundRecurrences.Task100ms OUT_Sounds.ExternalSounds.S_004._SoundRelVol.Task100ms OUT_Sounds.ExternalSounds.S_004._SoundRequest.Task100ms /end REF_MEASUREMENT
/end GROUP
/begin GROUP SYSTEM.Sounds.ExternalSounds.S_005 "S_005"
 /begin ANNOTATION ANNOTATION_LABEL "Instance" ANNOTATION_ORIGIN "Group" /begin ANNOTATION_TEXT "4" /end ANNOTATION_TEXT /end ANNOTATION
 /begin ANNOTATION ANNOTATION_LABEL "TaskCycleTime" ANNOTATION_ORIGIN "Group" /begin ANNOTATION_TEXT "0" /end ANNOTATION_TEXT /end ANNOTATION
 /begin ANNOTATION ANNOTATION_LABEL "TimeResolution" ANNOTATION_ORIGIN "Group" /begin ANNOTATION_TEXT "0" /end ANNOTATION_TEXT /end ANNOTATION
 /begin REF_MEASUREMENT OUT_Sounds.ExternalSounds.S_005._SoundBalance.Task100ms OUT_Sounds.ExternalSounds.S_005._SoundDeviceEnable.Task100ms OUT_Sounds.ExternalSounds.S_005._SoundRecurrences.Task100ms OUT_Sounds.ExternalSounds.S_005._SoundRelVol.Task100ms OUT_Sounds.ExternalSounds.S_005._SoundRequest.Task100ms /end REF_MEASUREMENT
/end GROUP
/begin GROUP SYSTEM.Sounds.ExternalSounds.S_006 "S_006"
 /begin ANNOTATION ANNOTATION_LABEL "Instance" ANNOTATION_ORIGIN "Group" /begin ANNOTATION_TEXT "5" /end ANNOTATION_TEXT /end ANNOTATION
 /begin ANNOTATION ANNOTATION_LABEL "TaskCycleTime" ANNOTATION_ORIGIN "Group" /begin ANNOTATION_TEXT "0" /end ANNOTATION_TEXT /end ANNOTATION
 /begin ANNOTATION ANNOTATION_LABEL "TimeResolution" ANNOTATION_ORIGIN "Group" /begin ANNOTATION_TEXT "0" /end ANNOTATION_TEXT /end ANNOTATION
 /begin REF_MEASUREMENT OUT_Sounds.ExternalSounds.S_006._SoundBalance.Task100ms OUT_Sounds.ExternalSounds.S_006._SoundDeviceEnable.Task100ms OUT_Sounds.ExternalSounds.S_006._SoundRecurrences.Task100ms OUT_Sounds.ExternalSounds.S_006._SoundRelVol.Task100ms OUT_Sounds.ExternalSounds.S_006._SoundRequest.Task100ms /end REF_MEASUREMENT
/end GROUP
/begin GROUP SYSTEM.Sounds.ExternalSounds.S_007 "S_007"
 /begin ANNOTATION ANNOTATION_LABEL "Instance" ANNOTATION_ORIGIN "Group" /begin ANNOTATION_TEXT "6" /end ANNOTATION_TEXT /end ANNOTATION
 /begin ANNOTATION ANNOTATION_LABEL "TaskCycleTime" ANNOTATION_ORIGIN "Group" /begin ANNOTATION_TEXT "0" /end ANNOTATION_TEXT /end ANNOTATION
 /begin ANNOTATION ANNOTATION_LABEL "TimeResolution" ANNOTATION_ORIGIN "Group" /begin ANNOTATION_TEXT "0" /end ANNOTATION_TEXT /end ANNOTATION
 /begin REF_MEASUREMENT OUT_Sounds.ExternalSounds.S_007._SoundBalance.Task100ms OUT_Sounds.ExternalSounds.S_007._SoundDeviceEnable.Task100ms OUT_Sounds.ExternalSounds.S_007._SoundRecurrences.Task100ms OUT_Sounds.ExternalSounds.S_007._SoundRelVol.Task100ms OUT_Sounds.ExternalSounds.S_007._SoundRequest.Task100ms /end REF_MEASUREMENT
/end GROUP
/begin GROUP SYSTEM.Sounds.ExternalSounds.S_008 "S_008"
 /begin ANNOTATION ANNOTATION_LABEL "Instance" ANNOTATION_ORIGIN "Group" /begin ANNOTATION_TEXT "7" /end ANNOTATION_TEXT /end ANNOTATION
 /begin ANNOTATION ANNOTATION_LABEL "TaskCycleTime" ANNOTATION_ORIGIN "Group" /begin ANNOTATION_TEXT "0" /end ANNOTATION_TEXT /end ANNOTATION
 /begin ANNOTATION ANNOTATION_LABEL "TimeResolution" ANNOTATION_ORIGIN "Group" /begin ANNOTATION_TEXT "0" /end ANNOTATION_TEXT /end ANNOTATION
 /begin REF_MEASUREMENT OUT_Sounds.ExternalSounds.S_008._SoundBalance.Task100ms OUT_Sounds.ExternalSounds.S_008._SoundDeviceEnable.Task100ms OUT_Sounds.ExternalSounds.S_008._SoundRecurrences.Task100ms OUT_Sounds.ExternalSounds.S_008._SoundRelVol.Task100ms OUT_Sounds.ExternalSounds.S_008._SoundRequest.Task100ms /end REF_MEASUREMENT
/end GROUP
/begin GROUP SYSTEM.Sounds.ExternalSounds.S_009 "S_009"
 /begin ANNOTATION ANNOTATION_LABEL "Instance" ANNOTATION_ORIGIN "Group" /begin ANNOTATION_TEXT "8" /end ANNOTATION_TEXT /end ANNOTATION
 /begin ANNOTATION ANNOTATION_LABEL "TaskCycleTime" ANNOTATION_ORIGIN "Group" /begin ANNOTATION_TEXT "0" /end ANNOTATION_TEXT /end ANNOTATION
 /begin ANNOTATION ANNOTATION_LABEL "TimeResolution" ANNOTATION_ORIGIN "Group" /begin ANNOTATION_TEXT "0" /end ANNOTATION_TEXT /end ANNOTATION
 /begin REF_MEASUREMENT OUT_Sounds.ExternalSounds.S_009._SoundBalance.Task100ms OUT_Sounds.ExternalSounds.S_009._SoundDeviceEnable.Task100ms OUT_Sounds.ExternalSounds.S_009._SoundRecurrences.Task100ms OUT_Sounds.ExternalSounds.S_009._SoundRelVol.Task100ms OUT_Sounds.ExternalSounds.S_009._SoundRequest.Task100ms /end REF_MEASUREMENT
/end GROUP
/begin GROUP SYSTEM.Sounds.ExternalSounds.S_010 "S_010"
 /begin ANNOTATION ANNOTATION_LABEL "Instance" ANNOTATION_ORIGIN "Group" /begin ANNOTATION_TEXT "9" /end ANNOTATION_TEXT /end ANNOTATION
 /begin ANNOTATION ANNOTATION_LABEL "TaskCycleTime" ANNOTATION_ORIGIN "Group" /begin ANNOTATION_TEXT "0" /end ANNOTATION_TEXT /end ANNOTATION
 /begin ANNOTATION ANNOTATION_LABEL "TimeResolution" ANNOTATION_ORIGIN "Group" /begin ANNOTATION_TEXT "0" /end ANNOTATION_TEXT /end ANNOTATION
 /begin REF_MEASUREMENT OUT_Sounds.ExternalSounds.S_010._SoundBalance.Task100ms OUT_Sounds.ExternalSounds.S_010._SoundDeviceEnable.Task100ms OUT_Sounds.ExternalSounds.S_010._SoundRecurrences.Task100ms OUT_Sounds.ExternalSounds.S_010._SoundRelVol.Task100ms OUT_Sounds.ExternalSounds.S_010._SoundRequest.Task100ms /end REF_MEASUREMENT
/end GROUP
/begin GROUP SYSTEM.Sounds.ExternalSounds.S_011 "S_011"
 /begin ANNOTATION ANNOTATION_LABEL "Instance" ANNOTATION_ORIGIN "Group" /begin ANNOTATION_TEXT "10" /end ANNOTATION_TEXT /end ANNOTATION
 /begin ANNOTATION ANNOTATION_LABEL "TaskCycleTime" ANNOTATION_ORIGIN "Group" /begin ANNOTATION_TEXT "0" /end ANNOTATION_TEXT /end ANNOTATION
 /begin ANNOTATION ANNOTATION_LABEL "TimeResolution" ANNOTATION_ORIGIN "Group" /begin ANNOTATION_TEXT "0" /end ANNOTATION_TEXT /end ANNOTATION
 /begin REF_MEASUREMENT OUT_Sounds.ExternalSounds.S_011._SoundBalance.Task100ms OUT_Sounds.ExternalSounds.S_011._SoundDeviceEnable.Task100ms OUT_Sounds.ExternalSounds.S_011._SoundRecurrences.Task100ms OUT_Sounds.ExternalSounds.S_011._SoundRelVol.Task100ms OUT_Sounds.ExternalSounds.S_011._SoundRequest.Task100ms /end REF_MEASUREMENT
/end GROUP
/begin GROUP SYSTEM.Sounds.ExternalSounds.S_012 "S_012"
 /begin ANNOTATION ANNOTATION_LABEL "Instance" ANNOTATION_ORIGIN "Group" /begin ANNOTATION_TEXT "11" /end ANNOTATION_TEXT /end ANNOTATION
 /begin ANNOTATION ANNOTATION_LABEL "TaskCycleTime" ANNOTATION_ORIGIN "Group" /begin ANNOTATION_TEXT "0" /end ANNOTATION_TEXT /end ANNOTATION
 /begin ANNOTATION ANNOTATION_LABEL "TimeResolution" ANNOTATION_ORIGIN "Group" /begin ANNOTATION_TEXT "0" /end ANNOTATION_TEXT /end ANNOTATION
 /begin REF_MEASUREMENT OUT_Sounds.ExternalSounds.S_012._SoundBalance.Task100ms OUT_Sounds.ExternalSounds.S_012._SoundDeviceEnable.Task100ms OUT_Sounds.ExternalSounds.S_012._SoundRecurrences.Task100ms OUT_Sounds.ExternalSounds.S_012._SoundRelVol.Task100ms OUT_Sounds.ExternalSounds.S_012._SoundRequest.Task100ms /end REF_MEASUREMENT
/end GROUP
/begin GROUP SYSTEM.Sounds.ExternalSounds.S_013 "S_013"
 /begin ANNOTATION ANNOTATION_LABEL "Instance" ANNOTATION_ORIGIN "Group" /begin ANNOTATION_TEXT "12" /end ANNOTATION_TEXT /end ANNOTATION
 /begin ANNOTATION ANNOTATION_LABEL "TaskCycleTime" ANNOTATION_ORIGIN "Group" /begin ANNOTATION_TEXT "0" /end ANNOTATION_TEXT /end ANNOTATION
 /begin ANNOTATION ANNOTATION_LABEL "TimeResolution" ANNOTATION_ORIGIN "Group" /begin ANNOTATION_TEXT "0" /end ANNOTATION_TEXT /end ANNOTATION
 /begin REF_MEASUREMENT OUT_Sounds.ExternalSounds.S_013._SoundBalance.Task100ms OUT_Sounds.ExternalSounds.S_013._SoundDeviceEnable.Task100ms OUT_Sounds.ExternalSounds.S_013._SoundRecurrences.Task100ms OUT_Sounds.ExternalSounds.S_013._SoundRelVol.Task100ms OUT_Sounds.ExternalSounds.S_013._SoundRequest.Task100ms /end REF_MEASUREMENT
/end GROUP
/begin GROUP SYSTEM.Sounds.ExternalSounds.S_014 "S_014"
 /begin ANNOTATION ANNOTATION_LABEL "Instance" ANNOTATION_ORIGIN "Group" /begin ANNOTATION_TEXT "13" /end ANNOTATION_TEXT /end ANNOTATION
 /begin ANNOTATION ANNOTATION_LABEL "TaskCycleTime" ANNOTATION_ORIGIN "Group" /begin ANNOTATION_TEXT "0" /end ANNOTATION_TEXT /end ANNOTATION
 /begin ANNOTATION ANNOTATION_LABEL "TimeResolution" ANNOTATION_ORIGIN "Group" /begin ANNOTATION_TEXT "0" /end ANNOTATION_TEXT /end ANNOTATION
 /begin REF_MEASUREMENT OUT_Sounds.ExternalSounds.S_014._SoundBalance.Task100ms OUT_Sounds.ExternalSounds.S_014._SoundDeviceEnable.Task100ms OUT_Sounds.ExternalSounds.S_014._SoundRecurrences.Task100ms OUT_Sounds.ExternalSounds.S_014._SoundRelVol.Task100ms OUT_Sounds.ExternalSounds.S_014._SoundRequest.Task100ms /end REF_MEASUREMENT
/end GROUP
/begin GROUP SYSTEM.Sounds.ExternalSounds.S_015 "S_015"
 /begin ANNOTATION ANNOTATION_LABEL "Instance" ANNOTATION_ORIGIN "Group" /begin ANNOTATION_TEXT "14" /end ANNOTATION_TEXT /end ANNOTATION
 /begin ANNOTATION ANNOTATION_LABEL "TaskCycleTime" ANNOTATION_ORIGIN "Group" /begin ANNOTATION_TEXT "0" /end ANNOTATION_TEXT /end ANNOTATION
 /begin ANNOTATION ANNOTATION_LABEL "TimeResolution" ANNOTATION_ORIGIN "Group" /begin ANNOTATION_TEXT "0" /end ANNOTATION_TEXT /end ANNOTATION
 /begin REF_MEASUREMENT OUT_Sounds.ExternalSounds.S_015._SoundBalance.Task100ms OUT_Sounds.ExternalSounds.S_015._SoundDeviceEnable.Task100ms OUT_Sounds.ExternalSounds.S_015._SoundRecurrences.Task100ms OUT_Sounds.ExternalSounds.S_015._SoundRelVol.Task100ms OUT_Sounds.ExternalSounds.S_015._SoundRequest.Task100ms /end REF_MEASUREMENT
/end GROUP
/begin GROUP SYSTEM.Sounds.ExternalSounds.S_016 "S_016"
 /begin ANNOTATION ANNOTATION_LABEL "Instance" ANNOTATION_ORIGIN "Group" /begin ANNOTATION_TEXT "15" /end ANNOTATION_TEXT /end ANNOTATION
 /begin ANNOTATION ANNOTATION_LABEL "TaskCycleTime" ANNOTATION_ORIGIN "Group" /begin ANNOTATION_TEXT "0" /end ANNOTATION_TEXT /end ANNOTATION
 /begin ANNOTATION ANNOTATION_LABEL "TimeResolution" ANNOTATION_ORIGIN "Group" /begin ANNOTATION_TEXT "0" /end ANNOTATION_TEXT /end ANNOTATION
 /begin REF_MEASUREMENT OUT_Sounds.ExternalSounds.S_016._SoundBalance.Task100ms OUT_Sounds.ExternalSounds.S_016._SoundDeviceEnable.Task100ms OUT_Sounds.ExternalSounds.S_016._SoundRecurrences.Task100ms OUT_Sounds.ExternalSounds.S_016._SoundRelVol.Task100ms OUT_Sounds.ExternalSounds.S_016._SoundRequest.Task100ms /end REF_MEASUREMENT
/end GROUP
/begin GROUP SYSTEM.Sounds.ExternalSounds.S_017 "S_017"
 /begin ANNOTATION ANNOTATION_LABEL "Instance" ANNOTATION_ORIGIN "Group" /begin ANNOTATION_TEXT "16" /end ANNOTATION_TEXT /end ANNOTATION
 /begin ANNOTATION ANNOTATION_LABEL "TaskCycleTime" ANNOTATION_ORIGIN "Group" /begin ANNOTATION_TEXT "0" /end ANNOTATION_TEXT /end ANNOTATION
 /begin ANNOTATION ANNOTATION_LABEL "TimeResolution" ANNOTATION_ORIGIN "Group" /begin ANNOTATION_TEXT "0" /end ANNOTATION_TEXT /end ANNOTATION
 /begin REF_MEASUREMENT OUT_Sounds.ExternalSounds.S_017._SoundBalance.Task100ms OUT_Sounds.ExternalSounds.S_017._SoundDeviceEnable.Task100ms OUT_Sounds.ExternalSounds.S_017._SoundRecurrences.Task100ms OUT_Sounds.ExternalSounds.S_017._SoundRelVol.Task100ms OUT_Sounds.ExternalSounds.S_017._SoundRequest.Task100ms /end REF_MEASUREMENT
/end GROUP
/begin GROUP SYSTEM.Sounds.ExternalSounds.S_018 "S_018"
 /begin ANNOTATION ANNOTATION_LABEL "Instance" ANNOTATION_ORIGIN "Group" /begin ANNOTATION_TEXT "17" /end ANNOTATION_TEXT /end ANNOTATION
 /begin ANNOTATION ANNOTATION_LABEL "TaskCycleTime" ANNOTATION_ORIGIN "Group" /begin ANNOTATION_TEXT "0" /end ANNOTATION_TEXT /end ANNOTATION
 /begin ANNOTATION ANNOTATION_LABEL "TimeResolution" ANNOTATION_ORIGIN "Group" /begin ANNOTATION_TEXT "0" /end ANNOTATION_TEXT /end ANNOTATION
 /begin REF_MEASUREMENT OUT_Sounds.ExternalSounds.S_018._SoundBalance.Task100ms OUT_Sounds.ExternalSounds.S_018._SoundDeviceEnable.Task100ms OUT_Sounds.ExternalSounds.S_018._SoundRecurrences.Task100ms OUT_Sounds.ExternalSounds.S_018._SoundRelVol.Task100ms OUT_Sounds.ExternalSounds.S_018._SoundRequest.Task100ms /end REF_MEASUREMENT
/end GROUP
/begin GROUP SYSTEM.Sounds.ExternalSounds.S_019 "S_019"
 /begin ANNOTATION ANNOTATION_LABEL "Instance" ANNOTATION_ORIGIN "Group" /begin ANNOTATION_TEXT "18" /end ANNOTATION_TEXT /end ANNOTATION
 /begin ANNOTATION ANNOTATION_LABEL "TaskCycleTime" ANNOTATION_ORIGIN "Group" /begin ANNOTATION_TEXT "0" /end ANNOTATION_TEXT /end ANNOTATION
 /begin ANNOTATION ANNOTATION_LABEL "TimeResolution" ANNOTATION_ORIGIN "Group" /begin ANNOTATION_TEXT "0" /end ANNOTATION_TEXT /end ANNOTATION
 /begin REF_MEASUREMENT OUT_Sounds.ExternalSounds.S_019._SoundBalance.Task100ms OUT_Sounds.ExternalSounds.S_019._SoundDeviceEnable.Task100ms OUT_Sounds.ExternalSounds.S_019._SoundRecurrences.Task100ms OUT_Sounds.ExternalSounds.S_019._SoundRelVol.Task100ms OUT_Sounds.ExternalSounds.S_019._SoundRequest.Task100ms /end REF_MEASUREMENT
/end GROUP
/begin GROUP SYSTEM.Sounds.ExternalSounds.S_020 "S_020"
 /begin ANNOTATION ANNOTATION_LABEL "Instance" ANNOTATION_ORIGIN "Group" /begin ANNOTATION_TEXT "19" /end ANNOTATION_TEXT /end ANNOTATION
 /begin ANNOTATION ANNOTATION_LABEL "TaskCycleTime" ANNOTATION_ORIGIN "Group" /begin ANNOTATION_TEXT "0" /end ANNOTATION_TEXT /end ANNOTATION
 /begin ANNOTATION ANNOTATION_LABEL "TimeResolution" ANNOTATION_ORIGIN "Group" /begin ANNOTATION_TEXT "0" /end ANNOTATION_TEXT /end ANNOTATION
 /begin REF_MEASUREMENT OUT_Sounds.ExternalSounds.S_020._SoundBalance.Task100ms OUT_Sounds.ExternalSounds.S_020._SoundDeviceEnable.Task100ms OUT_Sounds.ExternalSounds.S_020._SoundRecurrences.Task100ms OUT_Sounds.ExternalSounds.S_020._SoundRelVol.Task100ms OUT_Sounds.ExternalSounds.S_020._SoundRequest.Task100ms /end REF_MEASUREMENT
/end GROUP
/begin GROUP SYSTEM.Sounds.ExternalSounds.S_021 "S_021"
 /begin ANNOTATION ANNOTATION_LABEL "Instance" ANNOTATION_ORIGIN "Group" /begin ANNOTATION_TEXT "20" /end ANNOTATION_TEXT /end ANNOTATION
 /begin ANNOTATION ANNOTATION_LABEL "TaskCycleTime" ANNOTATION_ORIGIN "Group" /begin ANNOTATION_TEXT "0" /end ANNOTATION_TEXT /end ANNOTATION
 /begin ANNOTATION ANNOTATION_LABEL "TimeResolution" ANNOTATION_ORIGIN "Group" /begin ANNOTATION_TEXT "0" /end ANNOTATION_TEXT /end ANNOTATION
 /begin REF_MEASUREMENT OUT_Sounds.ExternalSounds.S_021._SoundBalance.Task100ms OUT_Sounds.ExternalSounds.S_021._SoundDeviceEnable.Task100ms OUT_Sounds.ExternalSounds.S_021._SoundRecurrences.Task100ms OUT_Sounds.ExternalSounds.S_021._SoundRelVol.Task100ms OUT_Sounds.ExternalSounds.S_021._SoundRequest.Task100ms /end REF_MEASUREMENT
/end GROUP
/begin GROUP SYSTEM.Sounds.ExternalSounds.S_022 "S_022"
 /begin ANNOTATION ANNOTATION_LABEL "Instance" ANNOTATION_ORIGIN "Group" /begin ANNOTATION_TEXT "21" /end ANNOTATION_TEXT /end ANNOTATION
 /begin ANNOTATION ANNOTATION_LABEL "TaskCycleTime" ANNOTATION_ORIGIN "Group" /begin ANNOTATION_TEXT "0" /end ANNOTATION_TEXT /end ANNOTATION
 /begin ANNOTATION ANNOTATION_LABEL "TimeResolution" ANNOTATION_ORIGIN "Group" /begin ANNOTATION_TEXT "0" /end ANNOTATION_TEXT /end ANNOTATION
 /begin REF_MEASUREMENT OUT_Sounds.ExternalSounds.S_022._SoundBalance.Task100ms OUT_Sounds.ExternalSounds.S_022._SoundDeviceEnable.Task100ms OUT_Sounds.ExternalSounds.S_022._SoundRecurrences.Task100ms OUT_Sounds.ExternalSounds.S_022._SoundRelVol.Task100ms OUT_Sounds.ExternalSounds.S_022._SoundRequest.Task100ms /end REF_MEASUREMENT
/end GROUP
/begin GROUP SYSTEM.Sounds.ExternalSounds.S_023 "S_023"
 /begin ANNOTATION ANNOTATION_LABEL "Instance" ANNOTATION_ORIGIN "Group" /begin ANNOTATION_TEXT "22" /end ANNOTATION_TEXT /end ANNOTATION
 /begin ANNOTATION ANNOTATION_LABEL "TaskCycleTime" ANNOTATION_ORIGIN "Group" /begin ANNOTATION_TEXT "0" /end ANNOTATION_TEXT /end ANNOTATION
 /begin ANNOTATION ANNOTATION_LABEL "TimeResolution" ANNOTATION_ORIGIN "Group" /begin ANNOTATION_TEXT "0" /end ANNOTATION_TEXT /end ANNOTATION
 /begin REF_MEASUREMENT OUT_Sounds.ExternalSounds.S_023._SoundBalance.Task100ms OUT_Sounds.ExternalSounds.S_023._SoundDeviceEnable.Task100ms OUT_Sounds.ExternalSounds.S_023._SoundRecurrences.Task100ms OUT_Sounds.ExternalSounds.S_023._SoundRelVol.Task100ms OUT_Sounds.ExternalSounds.S_023._SoundRequest.Task100ms /end REF_MEASUREMENT
/end GROUP
/begin GROUP SYSTEM.Sounds.ExternalSounds.S_024 "S_024"
 /begin ANNOTATION ANNOTATION_LABEL "Instance" ANNOTATION_ORIGIN "Group" /begin ANNOTATION_TEXT "23" /end ANNOTATION_TEXT /end ANNOTATION
 /begin ANNOTATION ANNOTATION_LABEL "TaskCycleTime" ANNOTATION_ORIGIN "Group" /begin ANNOTATION_TEXT "0" /end ANNOTATION_TEXT /end ANNOTATION
 /begin ANNOTATION ANNOTATION_LABEL "TimeResolution" ANNOTATION_ORIGIN "Group" /begin ANNOTATION_TEXT "0" /end ANNOTATION_TEXT /end ANNOTATION
 /begin REF_MEASUREMENT OUT_Sounds.ExternalSounds.S_024._SoundBalance.Task100ms OUT_Sounds.ExternalSounds.S_024._SoundDeviceEnable.Task100ms OUT_Sounds.ExternalSounds.S_024._SoundRecurrences.Task100ms OUT_Sounds.ExternalSounds.S_024._SoundRelVol.Task100ms OUT_Sounds.ExternalSounds.S_024._SoundRequest.Task100ms /end REF_MEASUREMENT
/end GROUP
/begin GROUP SYSTEM.Sounds.ExternalSounds.S_025 "S_025"
 /begin ANNOTATION ANNOTATION_LABEL "Instance" ANNOTATION_ORIGIN "Group" /begin ANNOTATION_TEXT "24" /end ANNOTATION_TEXT /end ANNOTATION
 /begin ANNOTATION ANNOTATION_LABEL "TaskCycleTime" ANNOTATION_ORIGIN "Group" /begin ANNOTATION_TEXT "0" /end ANNOTATION_TEXT /end ANNOTATION
 /begin ANNOTATION ANNOTATION_LABEL "TimeResolution" ANNOTATION_ORIGIN "Group" /begin ANNOTATION_TEXT "0" /end ANNOTATION_TEXT /end ANNOTATION
 /begin REF_MEASUREMENT OUT_Sounds.ExternalSounds.S_025._SoundBalance.Task100ms OUT_Sounds.ExternalSounds.S_025._SoundDeviceEnable.Task100ms OUT_Sounds.ExternalSounds.S_025._SoundRecurrences.Task100ms OUT_Sounds.ExternalSounds.S_025._SoundRelVol.Task100ms OUT_Sounds.ExternalSounds.S_025._SoundRequest.Task100ms /end REF_MEASUREMENT
/end GROUP
/begin GROUP SYSTEM.Sounds.ExternalSounds.S_026 "S_026"
 /begin ANNOTATION ANNOTATION_LABEL "Instance" ANNOTATION_ORIGIN "Group" /begin ANNOTATION_TEXT "25" /end ANNOTATION_TEXT /end ANNOTATION
 /begin ANNOTATION ANNOTATION_LABEL "TaskCycleTime" ANNOTATION_ORIGIN "Group" /begin ANNOTATION_TEXT "0" /end ANNOTATION_TEXT /end ANNOTATION
 /begin ANNOTATION ANNOTATION_LABEL "TimeResolution" ANNOTATION_ORIGIN "Group" /begin ANNOTATION_TEXT "0" /end ANNOTATION_TEXT /end ANNOTATION
 /begin REF_MEASUREMENT OUT_Sounds.ExternalSounds.S_026._SoundBalance.Task100ms OUT_Sounds.ExternalSounds.S_026._SoundDeviceEnable.Task100ms OUT_Sounds.ExternalSounds.S_026._SoundRecurrences.Task100ms OUT_Sounds.ExternalSounds.S_026._SoundRelVol.Task100ms OUT_Sounds.ExternalSounds.S_026._SoundRequest.Task100ms /end REF_MEASUREMENT
/end GROUP
/begin GROUP SYSTEM.Sounds.ExternalSounds.S_027 "S_027"
 /begin ANNOTATION ANNOTATION_LABEL "Instance" ANNOTATION_ORIGIN "Group" /begin ANNOTATION_TEXT "26" /end ANNOTATION_TEXT /end ANNOTATION
 /begin ANNOTATION ANNOTATION_LABEL "TaskCycleTime" ANNOTATION_ORIGIN "Group" /begin ANNOTATION_TEXT "0" /end ANNOTATION_TEXT /end ANNOTATION
 /begin ANNOTATION ANNOTATION_LABEL "TimeResolution" ANNOTATION_ORIGIN "Group" /begin ANNOTATION_TEXT "0" /end ANNOTATION_TEXT /end ANNOTATION
 /begin REF_MEASUREMENT OUT_Sounds.ExternalSounds.S_027._SoundBalance.Task100ms OUT_Sounds.ExternalSounds.S_027._SoundDeviceEnable.Task100ms OUT_Sounds.ExternalSounds.S_027._SoundRecurrences.Task100ms OUT_Sounds.ExternalSounds.S_027._SoundRelVol.Task100ms OUT_Sounds.ExternalSounds.S_027._SoundRequest.Task100ms /end REF_MEASUREMENT
/end GROUP
/begin GROUP SYSTEM.Sounds.ExternalSounds.S_028 "S_028"
 /begin ANNOTATION ANNOTATION_LABEL "Instance" ANNOTATION_ORIGIN "Group" /begin ANNOTATION_TEXT "27" /end ANNOTATION_TEXT /end ANNOTATION
 /begin ANNOTATION ANNOTATION_LABEL "TaskCycleTime" ANNOTATION_ORIGIN "Group" /begin ANNOTATION_TEXT "0" /end ANNOTATION_TEXT /end ANNOTATION
 /begin ANNOTATION ANNOTATION_LABEL "TimeResolution" ANNOTATION_ORIGIN "Group" /begin ANNOTATION_TEXT "0" /end ANNOTATION_TEXT /end ANNOTATION
 /begin REF_MEASUREMENT OUT_Sounds.ExternalSounds.S_028._SoundBalance.Task100ms OUT_Sounds.ExternalSounds.S_028._SoundDeviceEnable.Task100ms OUT_Sounds.ExternalSounds.S_028._SoundRecurrences.Task100ms OUT_Sounds.ExternalSounds.S_028._SoundRelVol.Task100ms OUT_Sounds.ExternalSounds.S_028._SoundRequest.Task100ms /end REF_MEASUREMENT
/end GROUP
/begin GROUP SYSTEM.Sounds.ExternalSounds.S_029 "S_029"
 /begin ANNOTATION ANNOTATION_LABEL "Instance" ANNOTATION_ORIGIN "Group" /begin ANNOTATION_TEXT "28" /end ANNOTATION_TEXT /end ANNOTATION
 /begin ANNOTATION ANNOTATION_LABEL "TaskCycleTime" ANNOTATION_ORIGIN "Group" /begin ANNOTATION_TEXT "0" /end ANNOTATION_TEXT /end ANNOTATION
 /begin ANNOTATION ANNOTATION_LABEL "TimeResolution" ANNOTATION_ORIGIN "Group" /begin ANNOTATION_TEXT "0" /end ANNOTATION_TEXT /end ANNOTATION
 /begin REF_MEASUREMENT OUT_Sounds.ExternalSounds.S_029._SoundBalance.Task100ms OUT_Sounds.ExternalSounds.S_029._SoundDeviceEnable.Task100ms OUT_Sounds.ExternalSounds.S_029._SoundRecurrences.Task100ms OUT_Sounds.ExternalSounds.S_029._SoundRelVol.Task100ms OUT_Sounds.ExternalSounds.S_029._SoundRequest.Task100ms /end REF_MEASUREMENT
/end GROUP
/begin GROUP SYSTEM.Sounds.ExternalSounds.S_030 "S_030"
 /begin ANNOTATION ANNOTATION_LABEL "Instance" ANNOTATION_ORIGIN "Group" /begin ANNOTATION_TEXT "29" /end ANNOTATION_TEXT /end ANNOTATION
 /begin ANNOTATION ANNOTATION_LABEL "TaskCycleTime" ANNOTATION_ORIGIN "Group" /begin ANNOTATION_TEXT "0" /end ANNOTATION_TEXT /end ANNOTATION
 /begin ANNOTATION ANNOTATION_LABEL "TimeResolution" ANNOTATION_ORIGIN "Group" /begin ANNOTATION_TEXT "0" /end ANNOTATION_TEXT /end ANNOTATION
 /begin REF_MEASUREMENT OUT_Sounds.ExternalSounds.S_030._SoundBalance.Task100ms OUT_Sounds.ExternalSounds.S_030._SoundDeviceEnable.Task100ms OUT_Sounds.ExternalSounds.S_030._SoundRecurrences.Task100ms OUT_Sounds.ExternalSounds.S_030._SoundRelVol.Task100ms OUT_Sounds.ExternalSounds.S_030._SoundRequest.Task100ms /end REF_MEASUREMENT
/end GROUP
/begin GROUP SYSTEM.Sounds.ExternalSounds.S_031 "S_031"
 /begin ANNOTATION ANNOTATION_LABEL "Instance" ANNOTATION_ORIGIN "Group" /begin ANNOTATION_TEXT "30" /end ANNOTATION_TEXT /end ANNOTATION
 /begin ANNOTATION ANNOTATION_LABEL "TaskCycleTime" ANNOTATION_ORIGIN "Group" /begin ANNOTATION_TEXT "0" /end ANNOTATION_TEXT /end ANNOTATION
 /begin ANNOTATION ANNOTATION_LABEL "TimeResolution" ANNOTATION_ORIGIN "Group" /begin ANNOTATION_TEXT "0" /end ANNOTATION_TEXT /end ANNOTATION
 /begin REF_MEASUREMENT OUT_Sounds.ExternalSounds.S_031._SoundBalance.Task100ms OUT_Sounds.ExternalSounds.S_031._SoundDeviceEnable.Task100ms OUT_Sounds.ExternalSounds.S_031._SoundRecurrences.Task100ms OUT_Sounds.ExternalSounds.S_031._SoundRelVol.Task100ms OUT_Sounds.ExternalSounds.S_031._SoundRequest.Task100ms /end REF_MEASUREMENT
/end GROUP
/begin GROUP SYSTEM.Sounds.ExternalSounds.S_032 "S_032"
 /begin ANNOTATION ANNOTATION_LABEL "Instance" ANNOTATION_ORIGIN "Group" /begin ANNOTATION_TEXT "31" /end ANNOTATION_TEXT /end ANNOTATION
 /begin ANNOTATION ANNOTATION_LABEL "TaskCycleTime" ANNOTATION_ORIGIN "Group" /begin ANNOTATION_TEXT "0" /end ANNOTATION_TEXT /end ANNOTATION
 /begin ANNOTATION ANNOTATION_LABEL "TimeResolution" ANNOTATION_ORIGIN "Group" /begin ANNOTATION_TEXT "0" /end ANNOTATION_TEXT /end ANNOTATION
 /begin REF_MEASUREMENT OUT_Sounds.ExternalSounds.S_032._SoundBalance.Task100ms OUT_Sounds.ExternalSounds.S_032._SoundDeviceEnable.Task100ms OUT_Sounds.ExternalSounds.S_032._SoundRecurrences.Task100ms OUT_Sounds.ExternalSounds.S_032._SoundRelVol.Task100ms OUT_Sounds.ExternalSounds.S_032._SoundRequest.Task100ms /end REF_MEASUREMENT
/end GROUP
/begin GROUP SYSTEM.Sounds.ExternalSounds.S_033 "S_033"
 /begin ANNOTATION ANNOTATION_LABEL "Instance" ANNOTATION_ORIGIN "Group" /begin ANNOTATION_TEXT "32" /end ANNOTATION_TEXT /end ANNOTATION
 /begin ANNOTATION ANNOTATION_LABEL "TaskCycleTime" ANNOTATION_ORIGIN "Group" /begin ANNOTATION_TEXT "0" /end ANNOTATION_TEXT /end ANNOTATION
 /begin ANNOTATION ANNOTATION_LABEL "TimeResolution" ANNOTATION_ORIGIN "Group" /begin ANNOTATION_TEXT "0" /end ANNOTATION_TEXT /end ANNOTATION
 /begin REF_MEASUREMENT OUT_Sounds.ExternalSounds.S_033._SoundBalance.Task100ms OUT_Sounds.ExternalSounds.S_033._SoundDeviceEnable.Task100ms OUT_Sounds.ExternalSounds.S_033._SoundRecurrences.Task100ms OUT_Sounds.ExternalSounds.S_033._SoundRelVol.Task100ms OUT_Sounds.ExternalSounds.S_033._SoundRequest.Task100ms /end REF_MEASUREMENT
/end GROUP
/begin GROUP SYSTEM.Sounds.ExternalSounds.S_034 "S_034"
 /begin ANNOTATION ANNOTATION_LABEL "Instance" ANNOTATION_ORIGIN "Group" /begin ANNOTATION_TEXT "33" /end ANNOTATION_TEXT /end ANNOTATION
 /begin ANNOTATION ANNOTATION_LABEL "TaskCycleTime" ANNOTATION_ORIGIN "Group" /begin ANNOTATION_TEXT "0" /end ANNOTATION_TEXT /end ANNOTATION
 /begin ANNOTATION ANNOTATION_LABEL "TimeResolution" ANNOTATION_ORIGIN "Group" /begin ANNOTATION_TEXT "0" /end ANNOTATION_TEXT /end ANNOTATION
 /begin REF_MEASUREMENT OUT_Sounds.ExternalSounds.S_034._SoundBalance.Task100ms OUT_Sounds.ExternalSounds.S_034._SoundDeviceEnable.Task100ms OUT_Sounds.ExternalSounds.S_034._SoundRecurrences.Task100ms OUT_Sounds.ExternalSounds.S_034._SoundRelVol.Task100ms OUT_Sounds.ExternalSounds.S_034._SoundRequest.Task100ms /end REF_MEASUREMENT
/end GROUP
/begin GROUP SYSTEM.Sounds.ExternalSounds.S_035 "S_035"
 /begin ANNOTATION ANNOTATION_LABEL "Instance" ANNOTATION_ORIGIN "Group" /begin ANNOTATION_TEXT "34" /end ANNOTATION_TEXT /end ANNOTATION
 /begin ANNOTATION ANNOTATION_LABEL "TaskCycleTime" ANNOTATION_ORIGIN "Group" /begin ANNOTATION_TEXT "0" /end ANNOTATION_TEXT /end ANNOTATION
 /begin ANNOTATION ANNOTATION_LABEL "TimeResolution" ANNOTATION_ORIGIN "Group" /begin ANNOTATION_TEXT "0" /end ANNOTATION_TEXT /end ANNOTATION
 /begin REF_MEASUREMENT OUT_Sounds.ExternalSounds.S_035._SoundBalance.Task100ms OUT_Sounds.ExternalSounds.S_035._SoundDeviceEnable.Task100ms OUT_Sounds.ExternalSounds.S_035._SoundRecurrences.Task100ms OUT_Sounds.ExternalSounds.S_035._SoundRelVol.Task100ms OUT_Sounds.ExternalSounds.S_035._SoundRequest.Task100ms /end REF_MEASUREMENT
/end GROUP
/begin GROUP SYSTEM.Sounds.ExternalSounds.S_001 "S_001"
 /begin ANNOTATION ANNOTATION_LABEL "Instance" ANNOTATION_ORIGIN "Group" /begin ANNOTATION_TEXT "0" /end ANNOTATION_TEXT /end ANNOTATION
 /begin ANNOTATION ANNOTATION_LABEL "TaskCycleTime" ANNOTATION_ORIGIN "Group" /begin ANNOTATION_TEXT "0" /end ANNOTATION_TEXT /end ANNOTATION
 /begin ANNOTATION ANNOTATION_LABEL "TimeResolution" ANNOTATION_ORIGIN "Group" /begin ANNOTATION_TEXT "0" /end ANNOTATION_TEXT /end ANNOTATION
 /begin REF_MEASUREMENT OUT_Sounds.ExternalSounds.S_001._SoundBalance.Task100ms OUT_Sounds.ExternalSounds.S_001._SoundDeviceEnable.Task100ms OUT_Sounds.ExternalSounds.S_001._SoundRecurrences.Task100ms OUT_Sounds.ExternalSounds.S_001._SoundRelVol.Task100ms OUT_Sounds.ExternalSounds.S_001._SoundRequest.Task100ms /end REF_MEASUREMENT
/end GROUP
/begin GROUP SYSTEM.Sounds.ExternalSounds "ExternalSounds"
 /begin ANNOTATION ANNOTATION_LABEL "Instance" ANNOTATION_ORIGIN "Group" /begin ANNOTATION_TEXT "0" /end ANNOTATION_TEXT /end ANNOTATION
 /begin ANNOTATION ANNOTATION_LABEL "TaskCycleTime" ANNOTATION_ORIGIN "Group" /begin ANNOTATION_TEXT "0" /end ANNOTATION_TEXT /end ANNOTATION
 /begin ANNOTATION ANNOTATION_LABEL "TimeResolution" ANNOTATION_ORIGIN "Group" /begin ANNOTATION_TEXT "0" /end ANNOTATION_TEXT /end ANNOTATION
 /begin SUB_GROUP SYSTEM.Sounds.ExternalSounds.ChannelStatus SYSTEM.Sounds.ExternalSounds.S_002 SYSTEM.Sounds.ExternalSounds.S_003 SYSTEM.Sounds.ExternalSounds.S_004 SYSTEM.Sounds.ExternalSounds.S_005 SYSTEM.Sounds.ExternalSounds.S_006 SYSTEM.Sounds.ExternalSounds.S_007 SYSTEM.Sounds.ExternalSounds.S_008 SYSTEM.Sounds.ExternalSounds.S_009 SYSTEM.Sounds.ExternalSounds.S_010 SYSTEM.Sounds.ExternalSounds.S_011 SYSTEM.Sounds.ExternalSounds.S_012 SYSTEM.Sounds.ExternalSounds.S_013 SYSTEM.Sounds.ExternalSounds.S_014 SYSTEM.Sounds.ExternalSounds.S_015 SYSTEM.Sounds.ExternalSounds.S_016 SYSTEM.Sounds.ExternalSounds.S_017 SYSTEM.Sounds.ExternalSounds.S_018 SYSTEM.Sounds.ExternalSounds.S_019 SYSTEM.Sounds.ExternalSounds.S_020 SYSTEM.Sounds.ExternalSounds.S_021 SYSTEM.Sounds.ExternalSounds.S_022 SYSTEM.Sounds.ExternalSounds.S_023 SYSTEM.Sounds.ExternalSounds.S_024 SYSTEM.Sounds.ExternalSounds.S_025 SYSTEM.Sounds.ExternalSounds.S_026 SYSTEM.Sounds.ExternalSounds.S_027 SYSTEM.Sounds.ExternalSounds.S_028 SYSTEM.Sounds.ExternalSounds.S_029 SYSTEM.Sounds.ExternalSounds.S_030 SYSTEM.Sounds.ExternalSounds.S_031 SYSTEM.Sounds.ExternalSounds.S_032 SYSTEM.Sounds.ExternalSounds.S_033 SYSTEM.Sounds.ExternalSounds.S_034 SYSTEM.Sounds.ExternalSounds.S_035 SYSTEM.Sounds.ExternalSounds.S_001 /end SUB_GROUP
/end GROUP
/begin GROUP SYSTEM.Sounds "Sounds"
 /begin ANNOTATION ANNOTATION_LABEL "Instance" ANNOTATION_ORIGIN "Group" /begin ANNOTATION_TEXT "0" /end ANNOTATION_TEXT /end ANNOTATION
 /begin ANNOTATION ANNOTATION_LABEL "TaskCycleTime" ANNOTATION_ORIGIN "Group" /begin ANNOTATION_TEXT "0" /end ANNOTATION_TEXT /end ANNOTATION
 /begin ANNOTATION ANNOTATION_LABEL "TimeResolution" ANNOTATION_ORIGIN "Group" /begin ANNOTATION_TEXT "0" /end ANNOTATION_TEXT /end ANNOTATION
 /begin SUB_GROUP SYSTEM.Sounds.ExternalSounds /end SUB_GROUP
 /begin REF_MEASUREMENT OUT_Sounds.f_SoundGlblSndVol.Task100ms /end REF_MEASUREMENT
/end GROUP
/begin GROUP SYSTEM.NVM._0x00001480__NVMPar_EngOnly_ "0x00001480 (NVMPar_EngOnly)"
 /begin ANNOTATION ANNOTATION_LABEL "Instance" ANNOTATION_ORIGIN "Group" /begin ANNOTATION_TEXT "1" /end ANNOTATION_TEXT /end ANNOTATION
 /begin ANNOTATION ANNOTATION_LABEL "TaskCycleTime" ANNOTATION_ORIGIN "Group" /begin ANNOTATION_TEXT "0" /end ANNOTATION_TEXT /end ANNOTATION
 /begin ANNOTATION ANNOTATION_LABEL "TimeResolution" ANNOTATION_ORIGIN "Group" /begin ANNOTATION_TEXT "0" /end ANNOTATION_TEXT /end ANNOTATION
 /begin REF_MEASUREMENT IN_NVM.NVMPar_EngOnly.Device_State.Task200ms IN_NVM.NVMPar_EngOnly.PhotosensorCorrectionFactor.Task200ms /end REF_MEASUREMENT
/end GROUP
/begin GROUP SYSTEM.NVM._0x00001400__NVMPar_ManTruck1_ "0x00001400 (NVMPar_ManTruck1)"
 /begin ANNOTATION ANNOTATION_LABEL "Instance" ANNOTATION_ORIGIN "Group" /begin ANNOTATION_TEXT "0" /end ANNOTATION_TEXT /end ANNOTATION
 /begin ANNOTATION ANNOTATION_LABEL "TaskCycleTime" ANNOTATION_ORIGIN "Group" /begin ANNOTATION_TEXT "0" /end ANNOTATION_TEXT /end ANNOTATION
 /begin ANNOTATION ANNOTATION_LABEL "TimeResolution" ANNOTATION_ORIGIN "Group" /begin ANNOTATION_TEXT "0" /end ANNOTATION_TEXT /end ANNOTATION
 /begin REF_MEASUREMENT IN_NVM.NVMPar_ManTruck1.Device_State.Task40ms IN_NVM.NVMPar_ManTruck1.ClusterIlluminationTransition.Task40ms IN_NVM.NVMPar_ManTruck1.MswInterfaceEnbl.Task40ms IN_NVM.NVMPar_ManTruck1.Device_State.Task50ms IN_NVM.NVMPar_ManTruck1.ICDISSVCfg.Task50ms IN_NVM.NVMPar_ManTruck1.Device_State.Task1000ms IN_NVM.NVMPar_ManTruck1.BrakePressureEnbl.Task1000ms IN_NVM.NVMPar_ManTruck1.OilInfoEnbl.Task1000ms /end REF_MEASUREMENT
/end GROUP
/begin GROUP SYSTEM.NVM "NVM"
 /begin ANNOTATION ANNOTATION_LABEL "Instance" ANNOTATION_ORIGIN "Group" /begin ANNOTATION_TEXT "0" /end ANNOTATION_TEXT /end ANNOTATION
 /begin ANNOTATION ANNOTATION_LABEL "TaskCycleTime" ANNOTATION_ORIGIN "Group" /begin ANNOTATION_TEXT "0" /end ANNOTATION_TEXT /end ANNOTATION
 /begin ANNOTATION ANNOTATION_LABEL "TimeResolution" ANNOTATION_ORIGIN "Group" /begin ANNOTATION_TEXT "0" /end ANNOTATION_TEXT /end ANNOTATION
 /begin SUB_GROUP SYSTEM.NVM._0x00001480__NVMPar_EngOnly_ SYSTEM.NVM._0x00001400__NVMPar_ManTruck1_ /end SUB_GROUP
/end GROUP
/begin GROUP SYSTEM.UDS_Services.Routine_Control_Service.RID_SysPerformance "RID_SysPerformance"
 /begin ANNOTATION ANNOTATION_LABEL "Instance" ANNOTATION_ORIGIN "Group" /begin ANNOTATION_TEXT "0" /end ANNOTATION_TEXT /end ANNOTATION
 /begin ANNOTATION ANNOTATION_LABEL "TaskCycleTime" ANNOTATION_ORIGIN "Group" /begin ANNOTATION_TEXT "0" /end ANNOTATION_TEXT /end ANNOTATION
 /begin ANNOTATION ANNOTATION_LABEL "TimeResolution" ANNOTATION_ORIGIN "Group" /begin ANNOTATION_TEXT "0" /end ANNOTATION_TEXT /end ANNOTATION
 /begin REF_MEASUREMENT IN_UDSServices.RoutineControlService.RID_SysPerformance.FpsEn.Task1000ms IN_UDSServices.RoutineControlService.RID_SysPerformance.FrameCounterEn.Task1000ms IN_UDSServices.RoutineControlService.RID_SysPerformance.FrameTimeEn.Task1000ms IN_UDSServices.RoutineControlService.RID_SysPerformance.RequestResults_Request.Task1000ms IN_UDSServices.RoutineControlService.RID_SysPerformance.StartRoutine_Request.Task1000ms IN_UDSServices.RoutineControlService.RID_SysPerformance.StopRoutine_Request.Task1000ms OUT_UDSServices.RoutineControlService.RID_SysPerformance.Response_Code.Task1000ms OUT_UDSServices.RoutineControlService.RID_SysPerformance.StartResponseCode.Task1000ms OUT_UDSServices.RoutineControlService.RID_SysPerformance.StopResponseCode.Task1000ms /end REF_MEASUREMENT
/end GROUP
/begin GROUP SYSTEM.UDS_Services.Routine_Control_Service "Routine Control Service"
 /begin ANNOTATION ANNOTATION_LABEL "Instance" ANNOTATION_ORIGIN "Group" /begin ANNOTATION_TEXT "0" /end ANNOTATION_TEXT /end ANNOTATION
 /begin ANNOTATION ANNOTATION_LABEL "TaskCycleTime" ANNOTATION_ORIGIN "Group" /begin ANNOTATION_TEXT "0" /end ANNOTATION_TEXT /end ANNOTATION
 /begin ANNOTATION ANNOTATION_LABEL "TimeResolution" ANNOTATION_ORIGIN "Group" /begin ANNOTATION_TEXT "0" /end ANNOTATION_TEXT /end ANNOTATION
 /begin SUB_GROUP SYSTEM.UDS_Services.Routine_Control_Service.RID_SysPerformance /end SUB_GROUP
 /begin REF_MEASUREMENT IN_UDSServices.RoutineControlService.f_resetRoutinesRequest.Task1000ms /end REF_MEASUREMENT
/end GROUP
/begin GROUP SYSTEM.UDS_Services "UDS Services"
 /begin ANNOTATION ANNOTATION_LABEL "Instance" ANNOTATION_ORIGIN "Group" /begin ANNOTATION_TEXT "0" /end ANNOTATION_TEXT /end ANNOTATION
 /begin ANNOTATION ANNOTATION_LABEL "TaskCycleTime" ANNOTATION_ORIGIN "Group" /begin ANNOTATION_TEXT "0" /end ANNOTATION_TEXT /end ANNOTATION
 /begin ANNOTATION ANNOTATION_LABEL "TimeResolution" ANNOTATION_ORIGIN "Group" /begin ANNOTATION_TEXT "0" /end ANNOTATION_TEXT /end ANNOTATION
 /begin SUB_GROUP SYSTEM.UDS_Services.Routine_Control_Service /end SUB_GROUP
 /begin REF_MEASUREMENT IN_UDSServices.f_diagCommunicationState.Task1000ms IN_UDSServices.f_diagCommunicationType.Task1000ms IN_UDSServices.f_diagControlType.Task1000ms IN_UDSServices.f_diagCurrentSession.Task1000ms IN_UDSServices.f_diagResetToDefaultState.Task1000ms OUT_UDSServices.f_diagRejectAccess.Task1000ms OUT_UDSServices.f_diagResponseCode.Task1000ms /end REF_MEASUREMENT
/end GROUP
/begin GROUP SYSTEM.RAM_Device "RAM Device"
 /begin ANNOTATION ANNOTATION_LABEL "Instance" ANNOTATION_ORIGIN "Group" /begin ANNOTATION_TEXT "0" /end ANNOTATION_TEXT /end ANNOTATION
 /begin ANNOTATION ANNOTATION_LABEL "TaskCycleTime" ANNOTATION_ORIGIN "Group" /begin ANNOTATION_TEXT "0" /end ANNOTATION_TEXT /end ANNOTATION
 /begin ANNOTATION ANNOTATION_LABEL "TimeResolution" ANNOTATION_ORIGIN "Group" /begin ANNOTATION_TEXT "0" /end ANNOTATION_TEXT /end ANNOTATION
 /begin REF_MEASUREMENT INOUT_RAMDevice.bo_FpcAssetFailure.Task40ms INOUT_RAMDevice.bo_FpcReady.Task40ms INOUT_RAMDevice.bo_ModelHoldApp.Task40ms INOUT_RAMDevice.u8_AssetState.Task40ms INOUT_RAMDevice.u8_SystemState.Task40ms INOUT_RAMDevice.bo_Asset4BasicLoaded.Task50ms INOUT_RAMDevice.bo_Fcn002Enabled.Task50ms INOUT_RAMDevice.bo_Fcn002HmiDataEn.Task50ms INOUT_RAMDevice.bo_Fcn005Enabled.Task50ms INOUT_RAMDevice.bo_Fcn005HmiDataEn.Task50ms INOUT_RAMDevice.bo_Fcn006Enabled.Task50ms INOUT_RAMDevice.bo_Fcn006HmiDataEn.Task50ms INOUT_RAMDevice.bo_Fcn007Enabled.Task50ms INOUT_RAMDevice.bo_Fcn016Enable.Task50ms INOUT_RAMDevice.bo_Fcn017Enable.Task50ms INOUT_RAMDevice.bo_Fcn020Enabled.Task50ms INOUT_RAMDevice.bo_Fcn031Enabled.Task50ms INOUT_RAMDevice.bo_Fcn052Enabled.Task50ms INOUT_RAMDevice.bo_Fcn054Enabled.Task50ms INOUT_RAMDevice.bo_Fcn056Enabled.Task50ms INOUT_RAMDevice.bo_Fcn057Enabled.Task50ms INOUT_RAMDevice.bo_Fcn057HmiDataEn.Task50ms INOUT_RAMDevice.bo_Fcn058Enabled.Task50ms INOUT_RAMDevice.bo_Fcn059Enabled.Task50ms INOUT_RAMDevice.u8_AssetState.Task50ms INOUT_RAMDevice.u8_Fcn002Scr.Task50ms INOUT_RAMDevice.u8_Fcn005Scr.Task50ms INOUT_RAMDevice.u8_Fcn006Scr.Task50ms INOUT_RAMDevice.u8_Fcn007Scr.Task50ms INOUT_RAMDevice.u8_Fcn016Scr.Task50ms INOUT_RAMDevice.u8_Fcn017Scr.Task50ms INOUT_RAMDevice.u8_Fcn020Scr.Task50ms INOUT_RAMDevice.u8_Fcn031Scr.Task50ms INOUT_RAMDevice.u8_Fcn052Scr.Task50ms INOUT_RAMDevice.u8_Fcn054Scr.Task50ms INOUT_RAMDevice.u8_Fcn056Scr.Task50ms INOUT_RAMDevice.u8_Fcn057Scr.Task50ms INOUT_RAMDevice.u8_Fcn058Scr.Task50ms INOUT_RAMDevice.u8_Fcn059Scr.Task50ms INOUT_RAMDevice.u8_ICDISSVCtrl.Task50ms INOUT_RAMDevice.u8_SystemState.Task50ms INOUT_RAMDevice.bo_Asset1Alerts1Loaded.Task100ms INOUT_RAMDevice.bo_Asset2Alerts2Loaded.Task100ms INOUT_RAMDevice.bo_Asset3WelcomeLoaded.Task100ms INOUT_RAMDevice.bo_Asset4BasicLoaded.Task100ms INOUT_RAMDevice.bo_Asset5Full1Loaded.Task100ms INOUT_RAMDevice.bo_Asset6Full2Loaded.Task100ms INOUT_RAMDevice.bo_Fcn016Enable.Task100ms INOUT_RAMDevice.bo_Fcn017Enable.Task100ms INOUT_RAMDevice.bo_Fcn054Enabled.Task100ms INOUT_RAMDevice.bo_FpcAssetFailure.Task100ms INOUT_RAMDevice.bo_FpcReady.Task100ms INOUT_RAMDevice.bo_ModelHoldApp.Task100ms INOUT_RAMDevice.u8_AssetState.Task100ms INOUT_RAMDevice.u8_Fcn016Scr.Task100ms INOUT_RAMDevice.u8_Fcn017Scr.Task100ms INOUT_RAMDevice.u8_Fcn054Scr.Task100ms INOUT_RAMDevice.u8_SystemState.Task100ms INOUT_RAMDevice.u8_SystemState.Task200ms INOUT_RAMDevice.bo_Fcn002Enabled.Task1000ms INOUT_RAMDevice.bo_Fcn005Enabled.Task1000ms INOUT_RAMDevice.bo_Fcn006Enabled.Task1000ms INOUT_RAMDevice.bo_Fcn007Enabled.Task1000ms INOUT_RAMDevice.bo_Fcn020Enabled.Task1000ms INOUT_RAMDevice.bo_Fcn052Enabled.Task1000ms INOUT_RAMDevice.bo_Fcn058Enabled.Task1000ms INOUT_RAMDevice.bo_Fcn059Enabled.Task1000ms INOUT_RAMDevice.u8_AssetState.Task1000ms INOUT_RAMDevice.u8_Fcn002Scr.Task1000ms INOUT_RAMDevice.u8_Fcn005Scr.Task1000ms INOUT_RAMDevice.u8_Fcn006Scr.Task1000ms INOUT_RAMDevice.u8_Fcn007Scr.Task1000ms INOUT_RAMDevice.u8_Fcn020Scr.Task1000ms INOUT_RAMDevice.u8_Fcn052Scr.Task1000ms INOUT_RAMDevice.u8_Fcn058Scr.Task1000ms INOUT_RAMDevice.u8_Fcn059Scr.Task1000ms /end REF_MEASUREMENT
/end GROUP
/begin GROUP SYSTEM.FPC_Control "FPC Control"
 /begin ANNOTATION ANNOTATION_LABEL "Instance" ANNOTATION_ORIGIN "Group" /begin ANNOTATION_TEXT "0" /end ANNOTATION_TEXT /end ANNOTATION
 /begin ANNOTATION ANNOTATION_LABEL "TaskCycleTime" ANNOTATION_ORIGIN "Group" /begin ANNOTATION_TEXT "0" /end ANNOTATION_TEXT /end ANNOTATION
 /begin ANNOTATION ANNOTATION_LABEL "TimeResolution" ANNOTATION_ORIGIN "Group" /begin ANNOTATION_TEXT "0" /end ANNOTATION_TEXT /end ANNOTATION
 /begin REF_MEASUREMENT IN_FPCControl.f_FPCcntrlAsset01state.Task100ms IN_FPCControl.f_FPCcntrlAsset02state.Task100ms IN_FPCControl.f_FPCcntrlAsset03state.Task100ms IN_FPCControl.f_FPCcntrlAsset04state.Task100ms IN_FPCControl.f_FPCcntrlAsset05state.Task100ms IN_FPCControl.f_FPCcntrlGHMIstate.Task100ms IN_FPCControl.f_FpcCntrlVidChnlState.Task100ms IN_FPCControl.f_FpcCntrlVidState.Task100ms OUT_FPCControl.f_FPCcntrlDeviceEna.Task100ms OUT_FPCControl.f_FpcCntrlOperationMode.Task100ms DIAG_FPCControl.f_FPCcntrlAsset01state_DIAG.Task100ms DIAG_FPCControl.f_FPCcntrlAsset02state_DIAG.Task100ms DIAG_FPCControl.f_FPCcntrlAsset03state_DIAG.Task100ms DIAG_FPCControl.f_FPCcntrlAsset04state_DIAG.Task100ms DIAG_FPCControl.f_FPCcntrlAsset05state_DIAG.Task100ms DIAG_FPCControl.f_FPCcntrlGHMIstate_DIAG.Task100ms DIAG_FPCControl.f_FpcCntrlVidChnlState_DIAG.Task100ms DIAG_FPCControl.f_FpcCntrlVidState_DIAG.Task100ms /end REF_MEASUREMENT
/end GROUP
/begin GROUP SYSTEM.Powerfail_device.Trm30 "Trm30"
 /begin ANNOTATION ANNOTATION_LABEL "Instance" ANNOTATION_ORIGIN "Group" /begin ANNOTATION_TEXT "0" /end ANNOTATION_TEXT /end ANNOTATION
 /begin ANNOTATION ANNOTATION_LABEL "TaskCycleTime" ANNOTATION_ORIGIN "Group" /begin ANNOTATION_TEXT "0" /end ANNOTATION_TEXT /end ANNOTATION
 /begin ANNOTATION ANNOTATION_LABEL "TimeResolution" ANNOTATION_ORIGIN "Group" /begin ANNOTATION_TEXT "0" /end ANNOTATION_TEXT /end ANNOTATION
 /begin REF_MEASUREMENT IN_Powerfaildevice.Trm30.f_powerFailTrm30.Task40ms /end REF_MEASUREMENT
/end GROUP
/begin GROUP SYSTEM.Powerfail_device.UVAlarm "UVAlarm"
 /begin ANNOTATION ANNOTATION_LABEL "Instance" ANNOTATION_ORIGIN "Group" /begin ANNOTATION_TEXT "1" /end ANNOTATION_TEXT /end ANNOTATION
 /begin ANNOTATION ANNOTATION_LABEL "TaskCycleTime" ANNOTATION_ORIGIN "Group" /begin ANNOTATION_TEXT "0" /end ANNOTATION_TEXT /end ANNOTATION
 /begin ANNOTATION ANNOTATION_LABEL "TimeResolution" ANNOTATION_ORIGIN "Group" /begin ANNOTATION_TEXT "0" /end ANNOTATION_TEXT /end ANNOTATION
 /begin REF_MEASUREMENT IN_Powerfaildevice.UVAlarm.f_powerFailUVAlarm.Task40ms /end REF_MEASUREMENT
/end GROUP
/begin GROUP SYSTEM.Powerfail_device "Powerfail device"
 /begin ANNOTATION ANNOTATION_LABEL "Instance" ANNOTATION_ORIGIN "Group" /begin ANNOTATION_TEXT "0" /end ANNOTATION_TEXT /end ANNOTATION
 /begin ANNOTATION ANNOTATION_LABEL "TaskCycleTime" ANNOTATION_ORIGIN "Group" /begin ANNOTATION_TEXT "0" /end ANNOTATION_TEXT /end ANNOTATION
 /begin ANNOTATION ANNOTATION_LABEL "TimeResolution" ANNOTATION_ORIGIN "Group" /begin ANNOTATION_TEXT "0" /end ANNOTATION_TEXT /end ANNOTATION
 /begin SUB_GROUP SYSTEM.Powerfail_device.Trm30 SYSTEM.Powerfail_device.UVAlarm /end SUB_GROUP
/end GROUP
/begin GROUP SYSTEM.TFT_Temperature "TFT Temperature"
 /begin ANNOTATION ANNOTATION_LABEL "Instance" ANNOTATION_ORIGIN "Group" /begin ANNOTATION_TEXT "0" /end ANNOTATION_TEXT /end ANNOTATION
 /begin ANNOTATION ANNOTATION_LABEL "TaskCycleTime" ANNOTATION_ORIGIN "Group" /begin ANNOTATION_TEXT "0" /end ANNOTATION_TEXT /end ANNOTATION
 /begin ANNOTATION ANNOTATION_LABEL "TimeResolution" ANNOTATION_ORIGIN "Group" /begin ANNOTATION_TEXT "0" /end ANNOTATION_TEXT /end ANNOTATION
 /begin REF_MEASUREMENT IN_TFTTemperature.f_TFTtempDegree.Task40ms DIAG_TFTTemperature.f_TFTtempDegree_DIAG.Task40ms /end REF_MEASUREMENT
/end GROUP
/begin GROUP SYSTEM.Telltales_Output.Output "Output"
 /begin ANNOTATION ANNOTATION_LABEL "Instance" ANNOTATION_ORIGIN "Group" /begin ANNOTATION_TEXT "0" /end ANNOTATION_TEXT /end ANNOTATION
 /begin ANNOTATION ANNOTATION_LABEL "TaskCycleTime" ANNOTATION_ORIGIN "Group" /begin ANNOTATION_TEXT "0" /end ANNOTATION_TEXT /end ANNOTATION
 /begin ANNOTATION ANNOTATION_LABEL "TimeResolution" ANNOTATION_ORIGIN "Group" /begin ANNOTATION_TEXT "0" /end ANNOTATION_TEXT /end ANNOTATION
 /begin REF_MEASUREMENT OUT_TelltalesOutput.Output.f_telltale01.Task40ms OUT_TelltalesOutput.Output.f_telltale02.Task40ms OUT_TelltalesOutput.Output.f_telltale03.Task40ms OUT_TelltalesOutput.Output.f_telltale04.Task40ms OUT_TelltalesOutput.Output.f_telltale05.Task40ms OUT_TelltalesOutput.Output.f_telltale06.Task40ms OUT_TelltalesOutput.Output.f_telltale07.Task40ms OUT_TelltalesOutput.Output.f_telltale08.Task40ms OUT_TelltalesOutput.Output.f_telltale09.Task40ms OUT_TelltalesOutput.Output.f_telltale10.Task40ms OUT_TelltalesOutput.Output.f_telltale11.Task40ms OUT_TelltalesOutput.Output.f_telltale12.Task40ms OUT_TelltalesOutput.Output.f_telltale13.Task40ms OUT_TelltalesOutput.Output.f_telltale14.Task40ms OUT_TelltalesOutput.Output.f_telltale15.Task40ms OUT_TelltalesOutput.Output.f_telltale16.Task40ms OUT_TelltalesOutput.Output.f_telltale17.Task40ms OUT_TelltalesOutput.Output.f_telltale18.Task40ms OUT_TelltalesOutput.Output.f_telltale19.Task40ms OUT_TelltalesOutput.Output.f_telltale20.Task40ms OUT_TelltalesOutput.Output.f_telltale21.Task40ms OUT_TelltalesOutput.Output.f_telltale22.Task40ms OUT_TelltalesOutput.Output.f_telltale23.Task40ms OUT_TelltalesOutput.Output.f_telltale24.Task40ms OUT_TelltalesOutput.Output.f_telltale25.Task40ms OUT_TelltalesOutput.Output.f_telltale26.Task40ms OUT_TelltalesOutput.Output.f_telltale27.Task40ms OUT_TelltalesOutput.Output.f_telltale28.Task40ms OUT_TelltalesOutput.Output.f_telltale29.Task40ms OUT_TelltalesOutput.Output.f_telltale32.Task40ms OUT_TelltalesOutput.Output.f_telltale33.Task40ms OUT_TelltalesOutput.Output.f_telltale34.Task40ms OUT_TelltalesOutput.Output.f_telltale35.Task40ms OUT_TelltalesOutput.Output.f_telltale36.Task40ms /end REF_MEASUREMENT
/end GROUP
/begin GROUP SYSTEM.Telltales_Output "Telltales Output"
 /begin ANNOTATION ANNOTATION_LABEL "Instance" ANNOTATION_ORIGIN "Group" /begin ANNOTATION_TEXT "0" /end ANNOTATION_TEXT /end ANNOTATION
 /begin ANNOTATION ANNOTATION_LABEL "TaskCycleTime" ANNOTATION_ORIGIN "Group" /begin ANNOTATION_TEXT "0" /end ANNOTATION_TEXT /end ANNOTATION
 /begin ANNOTATION ANNOTATION_LABEL "TimeResolution" ANNOTATION_ORIGIN "Group" /begin ANNOTATION_TEXT "0" /end ANNOTATION_TEXT /end ANNOTATION
 /begin SUB_GROUP SYSTEM.Telltales_Output.Output /end SUB_GROUP
/end GROUP
/begin GROUP SYSTEM.Display_Illumination_Control.Display "Display"
 /begin ANNOTATION ANNOTATION_LABEL "Instance" ANNOTATION_ORIGIN "Group" /begin ANNOTATION_TEXT "0" /end ANNOTATION_TEXT /end ANNOTATION
 /begin ANNOTATION ANNOTATION_LABEL "TaskCycleTime" ANNOTATION_ORIGIN "Group" /begin ANNOTATION_TEXT "0" /end ANNOTATION_TEXT /end ANNOTATION
 /begin ANNOTATION ANNOTATION_LABEL "TimeResolution" ANNOTATION_ORIGIN "Group" /begin ANNOTATION_TEXT "0" /end ANNOTATION_TEXT /end ANNOTATION
 /begin REF_MEASUREMENT IN_DisplayIlluminationControl.Display.f_backLightDeviceState.Task40ms IN_DisplayIlluminationControl.Display.f_backlightGetPdf.Task40ms OUT_DisplayIlluminationControl.Display.f_backlightPDF.Task40ms /end REF_MEASUREMENT
/end GROUP
/begin GROUP SYSTEM.Display_Illumination_Control "Display Illumination Control"
 /begin ANNOTATION ANNOTATION_LABEL "Instance" ANNOTATION_ORIGIN "Group" /begin ANNOTATION_TEXT "0" /end ANNOTATION_TEXT /end ANNOTATION
 /begin ANNOTATION ANNOTATION_LABEL "TaskCycleTime" ANNOTATION_ORIGIN "Group" /begin ANNOTATION_TEXT "0" /end ANNOTATION_TEXT /end ANNOTATION
 /begin ANNOTATION ANNOTATION_LABEL "TimeResolution" ANNOTATION_ORIGIN "Group" /begin ANNOTATION_TEXT "0" /end ANNOTATION_TEXT /end ANNOTATION
 /begin SUB_GROUP SYSTEM.Display_Illumination_Control.Display /end SUB_GROUP
/end GROUP
/begin GROUP SYSTEM.LIN0.A_Node_MFL.A_Node_MFL__MFLs_01 "A_Node_MFL__MFLs_01"
 /begin ANNOTATION ANNOTATION_LABEL "Instance" ANNOTATION_ORIGIN "Group" /begin ANNOTATION_TEXT "2" /end ANNOTATION_TEXT /end ANNOTATION
 /begin ANNOTATION ANNOTATION_LABEL "TaskCycleTime" ANNOTATION_ORIGIN "Group" /begin ANNOTATION_TEXT "0" /end ANNOTATION_TEXT /end ANNOTATION
 /begin ANNOTATION ANNOTATION_LABEL "TimeResolution" ANNOTATION_ORIGIN "Group" /begin ANNOTATION_TEXT "0" /end ANNOTATION_TEXT /end ANNOTATION
 /begin REF_MEASUREMENT IN_Node_MFL.MFLs_01.DeviceState.Task40ms IN_Node_MFL.MFLs_01.MFLSbyte1.Task40ms IN_Node_MFL.MFLs_01.MFLSbyte2.Task40ms IN_Node_MFL.MFLs_01.MFLSbyte3.Task40ms IN_Node_MFL.MFLs_01.MFLSbyte4.Task40ms IN_Node_MFL.MFLs_01.MFLSbyte5.Task40ms IN_Node_MFL.MFLs_01.MFLSbyte6.Task40ms IN_Node_MFL.MFLs_01.MFLSbyte7.Task40ms IN_Node_MFL.MFLs_01.MFLSbyte8.Task40ms /end REF_MEASUREMENT
/end GROUP
/begin GROUP SYSTEM.LIN0.A_Node_MFL.A_Node_MFL__GRA_ACCs_01 "A_Node_MFL__GRA_ACCs_01"
 /begin ANNOTATION ANNOTATION_LABEL "Instance" ANNOTATION_ORIGIN "Group" /begin ANNOTATION_TEXT "0" /end ANNOTATION_TEXT /end ANNOTATION
 /begin ANNOTATION ANNOTATION_LABEL "TaskCycleTime" ANNOTATION_ORIGIN "Group" /begin ANNOTATION_TEXT "0" /end ANNOTATION_TEXT /end ANNOTATION
 /begin ANNOTATION ANNOTATION_LABEL "TimeResolution" ANNOTATION_ORIGIN "Group" /begin ANNOTATION_TEXT "0" /end ANNOTATION_TEXT /end ANNOTATION
 /begin REF_MEASUREMENT IN_Node_MFL.GRA_ACCs_01.DeviceState.Task40ms IN_Node_MFL.GRA_ACCs_01.GRAbyte1.Task40ms IN_Node_MFL.GRA_ACCs_01.GRAbyte2.Task40ms IN_Node_MFL.GRA_ACCs_01.GRAbyte3.Task40ms IN_Node_MFL.GRA_ACCs_01.GRAbyte4.Task40ms IN_Node_MFL.GRA_ACCs_01.GRAbyte5.Task40ms IN_Node_MFL.GRA_ACCs_01.GRAbyte6.Task40ms IN_Node_MFL.GRA_ACCs_01.GRAbyte7.Task40ms IN_Node_MFL.GRA_ACCs_01.GRAbyte8.Task40ms /end REF_MEASUREMENT
/end GROUP
/begin GROUP SYSTEM.LIN0.A_Node_MFL.A_Node_MFL__UHRe_01 "A_Node_MFL__UHRe_01"
 /begin ANNOTATION ANNOTATION_LABEL "Instance" ANNOTATION_ORIGIN "Group" /begin ANNOTATION_TEXT "1" /end ANNOTATION_TEXT /end ANNOTATION
 /begin ANNOTATION ANNOTATION_LABEL "TaskCycleTime" ANNOTATION_ORIGIN "Group" /begin ANNOTATION_TEXT "0" /end ANNOTATION_TEXT /end ANNOTATION
 /begin ANNOTATION ANNOTATION_LABEL "TimeResolution" ANNOTATION_ORIGIN "Group" /begin ANNOTATION_TEXT "0" /end ANNOTATION_TEXT /end ANNOTATION
 /begin REF_MEASUREMENT IN_Node_MFL.UHRe_01.DeviceState.Task40ms OUT_Node_MFL.UHRe_01.UHREbyte1.Task40ms OUT_Node_MFL.UHRe_01.UHREbyte2.Task40ms OUT_Node_MFL.UHRe_01.UHREbyte3.Task40ms OUT_Node_MFL.UHRe_01.UHREbyte4.Task40ms OUT_Node_MFL.UHRe_01.UHREbyte5.Task40ms OUT_Node_MFL.UHRe_01.UHREbyte6.Task40ms OUT_Node_MFL.UHRe_01.UHREbyte7.Task40ms OUT_Node_MFL.UHRe_01.UHREbyte8.Task40ms /end REF_MEASUREMENT
/end GROUP
/begin GROUP SYSTEM.LIN0.A_Node_MFL.A_Node_MFL__MFLe_01 "A_Node_MFL__MFLe_01"
 /begin ANNOTATION ANNOTATION_LABEL "Instance" ANNOTATION_ORIGIN "Group" /begin ANNOTATION_TEXT "0" /end ANNOTATION_TEXT /end ANNOTATION
 /begin ANNOTATION ANNOTATION_LABEL "TaskCycleTime" ANNOTATION_ORIGIN "Group" /begin ANNOTATION_TEXT "0" /end ANNOTATION_TEXT /end ANNOTATION
 /begin ANNOTATION ANNOTATION_LABEL "TimeResolution" ANNOTATION_ORIGIN "Group" /begin ANNOTATION_TEXT "0" /end ANNOTATION_TEXT /end ANNOTATION
 /begin REF_MEASUREMENT IN_Node_MFL.MFLe_01.DeviceState.Task40ms OUT_Node_MFL.MFLe_01.MFLEbyte1.Task40ms OUT_Node_MFL.MFLe_01.MFLEbyte2.Task40ms OUT_Node_MFL.MFLe_01.MFLEbyte3.Task40ms OUT_Node_MFL.MFLe_01.MFLEbyte4.Task40ms OUT_Node_MFL.MFLe_01.MFLEbyte5.Task40ms OUT_Node_MFL.MFLe_01.MFLEbyte6.Task40ms OUT_Node_MFL.MFLe_01.MFLEbyte7.Task40ms OUT_Node_MFL.MFLe_01.MFLEbyte8.Task40ms /end REF_MEASUREMENT
/end GROUP
/begin GROUP SYSTEM.LIN0.A_Node_MFL "A_Node_MFL"
 /begin ANNOTATION ANNOTATION_LABEL "Instance" ANNOTATION_ORIGIN "Group" /begin ANNOTATION_TEXT "0" /end ANNOTATION_TEXT /end ANNOTATION
 /begin ANNOTATION ANNOTATION_LABEL "TaskCycleTime" ANNOTATION_ORIGIN "Group" /begin ANNOTATION_TEXT "0" /end ANNOTATION_TEXT /end ANNOTATION
 /begin ANNOTATION ANNOTATION_LABEL "TimeResolution" ANNOTATION_ORIGIN "Group" /begin ANNOTATION_TEXT "0" /end ANNOTATION_TEXT /end ANNOTATION
 /begin SUB_GROUP SYSTEM.LIN0.A_Node_MFL.A_Node_MFL__MFLs_01 SYSTEM.LIN0.A_Node_MFL.A_Node_MFL__GRA_ACCs_01 SYSTEM.LIN0.A_Node_MFL.A_Node_MFL__UHRe_01 SYSTEM.LIN0.A_Node_MFL.A_Node_MFL__MFLe_01 /end SUB_GROUP
/end GROUP
/begin GROUP SYSTEM.LIN0 "LIN0"
 /begin ANNOTATION ANNOTATION_LABEL "Instance" ANNOTATION_ORIGIN "Group" /begin ANNOTATION_TEXT "0" /end ANNOTATION_TEXT /end ANNOTATION
 /begin ANNOTATION ANNOTATION_LABEL "TaskCycleTime" ANNOTATION_ORIGIN "Group" /begin ANNOTATION_TEXT "0" /end ANNOTATION_TEXT /end ANNOTATION
 /begin ANNOTATION ANNOTATION_LABEL "TimeResolution" ANNOTATION_ORIGIN "Group" /begin ANNOTATION_TEXT "0" /end ANNOTATION_TEXT /end ANNOTATION
 /begin SUB_GROUP SYSTEM.LIN0.A_Node_MFL /end SUB_GROUP
 /begin REF_MEASUREMENT IN_LIN0.DeviceState.Task40ms OUT_LIN0.LinNetworkRequest1.Task40ms OUT_LIN0.ScheduleTable.Task40ms DIAG_LIN0.ScheduleTable_DIAG.Task40ms /end REF_MEASUREMENT
/end GROUP
/begin GROUP SYSTEM.Light_Sensor "Light Sensor"
 /begin ANNOTATION ANNOTATION_LABEL "Instance" ANNOTATION_ORIGIN "Group" /begin ANNOTATION_TEXT "0" /end ANNOTATION_TEXT /end ANNOTATION
 /begin ANNOTATION ANNOTATION_LABEL "TaskCycleTime" ANNOTATION_ORIGIN "Group" /begin ANNOTATION_TEXT "0" /end ANNOTATION_TEXT /end ANNOTATION
 /begin ANNOTATION ANNOTATION_LABEL "TimeResolution" ANNOTATION_ORIGIN "Group" /begin ANNOTATION_TEXT "0" /end ANNOTATION_TEXT /end ANNOTATION
 /begin REF_MEASUREMENT IN_LightSensor.LightSensorValue.Task200ms DIAG_LightSensor.LightSensorValue_DIAG.Task200ms /end REF_MEASUREMENT
/end GROUP
/begin GROUP SYSTEM "SYSTEM"
 /begin ANNOTATION ANNOTATION_LABEL "Instance" ANNOTATION_ORIGIN "Group" /begin ANNOTATION_TEXT "0" /end ANNOTATION_TEXT /end ANNOTATION
 /begin ANNOTATION ANNOTATION_LABEL "TaskCycleTime" ANNOTATION_ORIGIN "Group" /begin ANNOTATION_TEXT "0" /end ANNOTATION_TEXT /end ANNOTATION
 /begin ANNOTATION ANNOTATION_LABEL "TimeResolution" ANNOTATION_ORIGIN "Group" /begin ANNOTATION_TEXT "0" /end ANNOTATION_TEXT /end ANNOTATION
 /begin SUB_GROUP SYSTEM.Control SYSTEM.Digital_Inputs SYSTEM.Digital_Outputs SYSTEM.CAN0 SYSTEM.CAN1 SYSTEM.HMI SYSTEM.Sounds SYSTEM.NVM SYSTEM.UDS_Services SYSTEM.RAM_Device SYSTEM.FPC_Control SYSTEM.Powerfail_device SYSTEM.TFT_Temperature SYSTEM.Telltales_Output SYSTEM.Display_Illumination_Control SYSTEM.LIN0 SYSTEM.Light_Sensor /end SUB_GROUP
/end GROUP
/begin GROUP PROCESSIMAGE "PROCESSIMAGE" ROOT
 /begin ANNOTATION ANNOTATION_LABEL "Instance" ANNOTATION_ORIGIN "Group" /begin ANNOTATION_TEXT "0" /end ANNOTATION_TEXT /end ANNOTATION
 /begin ANNOTATION ANNOTATION_LABEL "TaskCycleTime" ANNOTATION_ORIGIN "Group" /begin ANNOTATION_TEXT "0" /end ANNOTATION_TEXT /end ANNOTATION
 /begin ANNOTATION ANNOTATION_LABEL "TimeResolution" ANNOTATION_ORIGIN "Group" /begin ANNOTATION_TEXT "0" /end ANNOTATION_TEXT /end ANNOTATION
 /begin SUB_GROUP SYSTEM /end SUB_GROUP
/end GROUP
/begin GROUP NVMPARAMETER.NVMPar_ManTruck1 "NVMPar_ManTruck1"
 /begin ANNOTATION ANNOTATION_LABEL "Instance" ANNOTATION_ORIGIN "Group" /begin ANNOTATION_TEXT "0" /end ANNOTATION_TEXT /end ANNOTATION
 /begin ANNOTATION ANNOTATION_LABEL "TaskCycleTime" ANNOTATION_ORIGIN "Group" /begin ANNOTATION_TEXT "0" /end ANNOTATION_TEXT /end ANNOTATION
 /begin ANNOTATION ANNOTATION_LABEL "TimeResolution" ANNOTATION_ORIGIN "Group" /begin ANNOTATION_TEXT "0" /end ANNOTATION_TEXT /end ANNOTATION
 /begin REF_CHARACTERISTIC ClusterIlluminationTransition MswInterfaceEnbl ICDISSVCfg BrakePressureEnbl OilInfoEnbl /end REF_CHARACTERISTIC
/end GROUP
/begin GROUP NVMPARAMETER.NVMPar_EngOnly "NVMPar_EngOnly"
 /begin ANNOTATION ANNOTATION_LABEL "Instance" ANNOTATION_ORIGIN "Group" /begin ANNOTATION_TEXT "0" /end ANNOTATION_TEXT /end ANNOTATION
 /begin ANNOTATION ANNOTATION_LABEL "TaskCycleTime" ANNOTATION_ORIGIN "Group" /begin ANNOTATION_TEXT "0" /end ANNOTATION_TEXT /end ANNOTATION
 /begin ANNOTATION ANNOTATION_LABEL "TimeResolution" ANNOTATION_ORIGIN "Group" /begin ANNOTATION_TEXT "0" /end ANNOTATION_TEXT /end ANNOTATION
 /begin REF_CHARACTERISTIC PhotosensorCorrectionFactor /end REF_CHARACTERISTIC
/end GROUP
/begin GROUP NVMPARAMETER "NVMPARAMETER" ROOT
 /begin ANNOTATION ANNOTATION_LABEL "Instance" ANNOTATION_ORIGIN "Group" /begin ANNOTATION_TEXT "0" /end ANNOTATION_TEXT /end ANNOTATION
 /begin ANNOTATION ANNOTATION_LABEL "TaskCycleTime" ANNOTATION_ORIGIN "Group" /begin ANNOTATION_TEXT "0" /end ANNOTATION_TEXT /end ANNOTATION
 /begin ANNOTATION ANNOTATION_LABEL "TimeResolution" ANNOTATION_ORIGIN "Group" /begin ANNOTATION_TEXT "0" /end ANNOTATION_TEXT /end ANNOTATION
 /begin SUB_GROUP NVMPARAMETER.NVMPar_ManTruck1 NVMPARAMETER.NVMPar_EngOnly /end SUB_GROUP
/end GROUP
/begin COMPU_METHOD IS_BOOLEAN_TRUE "" RAT_FUNC "%11.5" "" COEFFS 0 1 0 0 0 1 /end COMPU_METHOD
/begin COMPU_METHOD COMP_DEFAULT "" RAT_FUNC "%11.5" "Increments" COEFFS 0 1 0 0 0 1 /end COMPU_METHOD
/begin COMPU_METHOD COMP_LINEAR.IN_NVM.NVMPar_EngOnly.PhotosensorCorrectionFactor "" RAT_FUNC "%11.5" "" COEFFS 0 1 0 0 0 0.1 /end COMPU_METHOD
/begin COMPU_METHOD COMP_LINEAR.IN_NVM.NVMPar_ManTruck1.ClusterIlluminationTransition "" RAT_FUNC "%11.5" "ms/bit" COEFFS 0 1 0 0 0 0.04 /end COMPU_METHOD
/begin COMPU_METHOD COMP_LINEAR.ClusterIlluminationTransition "" RAT_FUNC "%11.5" "ms/bit" COEFFS 0 1 0 0 0 0.04 /end COMPU_METHOD
/begin COMPU_METHOD COMP_LINEAR.PhotosensorCorrectionFactor "" RAT_FUNC "%11.5" "" COEFFS 0 1 0 0 0 0.1 /end COMPU_METHOD
/begin COMPU_VTAB FPCHDL_en_VideoStatus ". " TAB_VERB 6 0 "VstsLoading" 1 "VstsLoadedSuccess" 2 "VstsLoadedError" 3 "VstsNotAvailable" 4 "VstsKernelError" 5 "VstsDisplayNotAvb" /end COMPU_VTAB
/begin COMPU_VTAB ILLHDL_en_DispSts ". " TAB_VERB 4 0 "DispOnNoDerate" 1 "DispOnDerating" 2 "DispOnDerateProt" 3 "DisplayOff" /end COMPU_VTAB
/begin COMPU_VTAB IOHDL_en_PhotoStatus ". " TAB_VERB 4 1000 "PhotoMaxValue" 1021 "PhotoReserved" 1022 "PhotoFaulty" 1023 "PhotoNotAvailable" /end COMPU_VTAB
/begin COMPU_VTAB IOHDL_en_Trm15Status ". " TAB_VERB 4 0 "TRM15Off" 1 "TRM15On" 2 "TRM15Reserved" 3 "TRM15NotAvailable" /end COMPU_VTAB
/begin COMPU_VTAB LAGHDL_en_Language ". " TAB_VERB 5 0 "LAGPortuguese" 1 "LAGEnglish" 2 "LAGSpanish" 3 "LAGFrench" 4 "LAGArabic" /end COMPU_VTAB
/begin COMPU_VTAB SC_normal_Fehler ". " TAB_VERB 2 0 "SC_normal_Fehler__normal" 1 "SC_normal_Fehler__Fehler" /end COMPU_VTAB
/begin COMPU_VTAB SNDHDL_en_SoundNumber ". " TAB_VERB 37 0 "NoSound" 1 "Sound01" 10 "Sound10" 11 "Sound11" 12 "Sound12" 13 "Sound13" 14 "Sound14" 15 "Sound15" 16 "Sound16" 17 "Sound17" 18 "Sound18" 19 "Sound19" 2 "Sound02" 20 "Sound20" 21 "Sound21" 22 "Sound22" 23 "Sound23" 24 "Sound24" 25 "Sound25" 26 "Sound26" 27 "Sound27" 28 "Sound28" 29 "Sound29" 3 "Sound03" 30 "Sound30" 31 "Sound31" 32 "Sound32" 33 "Sound33" 34 "Sound34" 35 "Sound35" 36 "Invalid" 4 "Sound04" 5 "Sound05" 6 "Sound06" 7 "Sound07" 8 "Sound08" 9 "Sound09" /end COMPU_VTAB
/begin COMPU_VTAB SNDHDL_en_SoundStatus ". " TAB_VERB 16 0 "SoundLoading" 1 "SoundReady" 10 "Reserved8" 11 "Reserved9" 12 "SoundStopped" 13 "SoundTimeout" 14 "SoundFailure" 15 "NotAvailable" 2 "SoundPlaying" 3 "Reserved1" 4 "Reserved2" 5 "Reserved3" 6 "Reserved4" 7 "Reserved5" 8 "Reserved6" 9 "Reserved7" /end COMPU_VTAB
/begin COMPU_VTAB SVHDL_en_SubView ". " TAB_VERB 20 0 "V01SV01" 1 "V01SV02" 10 "V02SV03" 11 "V02SV04" 12 "V02SV05" 16 "V03SV01" 17 "V03SV02" 18 "V03SV03" 2 "V01SV03" 24 "V04SV01" 25 "V04SV02" 26 "V04SV03" 3 "V01SV04" 32 "V05SV01" 33 "V05SV02" 34 "V05SV03" 4 "V01SV05" 63 "SVNotSelectedDisabled" 8 "V02SV01" 9 "V02SV02" /end COMPU_VTAB
/begin COMPU_VTAB SVHDL_en_SubViewAnimation ". " TAB_VERB 42 0 "SVA_NoAnimation" 1 "SVA_V01_SV01_V01_SV02" 10 "SVA_V02_SV01_V02_SV02" 11 "SVA_V02_SV02_V02_SV01" 12 "SVA_V02_SV01_V02_SV03" 13 "SVA_V02_SV03_V02_SV01" 14 "SVA_V02_SV01_V02_SV04" 15 "SVA_V02_SV04_V02_SV01" 16 "SVA_V02_SV04_V02_SV05" 17 "SVA_V02_SV05_V02_SV04" 18 "SVA_V02_SV01_V03_SV01" 19 "SVA_V03_SV01_V03_SV02" 2 "SVA_V01_SV02_V01_SV01" 20 "SVA_V03_SV02_V03_SV01" 21 "SVA_V03_SV01_V03_SV03" 22 "SVA_V03_SV03_V03_SV01" 23 "SVA_V03_SV01_V01_SV01" 24 "SVA_V03_SV01_V04_SV01" 25 "SVA_V03_SV01_V05_SV01" 26 "SVA_V04_SV01_V04_SV02" 27 "SVA_V04_SV02_V04_SV01" 28 "SVA_V04_SV01_V04_SV03" 29 "SVA_V04_SV03_V04_SV01" 3 "SVA_V01_SV01_V01_SV03" 30 "SVA_V04_SV01_V01_SV01" 31 "SVA_V04_SV01_V05_SV01" 32 "SVA_V05_SV01_V05_SV02" 33 "SVA_V05_SV02_V05_SV01" 34 "SVA_V05_SV01_V05_SV03" 35 "SVA_V05_SV03_V05_SV01" 36 "SVA_V05_SV01_V01_SV01" 37 "SVA_TO_SV01_V01" 38 "SVA_TO_SV02_V01" 39 "SVA_TO_SV03_V01" 4 "SVA_V01_SV03_V01_SV01" 40 "SVA_TO_SV04_V01" 41 "SVA_TO_SV05_V01" 5 "SVA_V01_SV01_V01_SV04" 6 "SVA_V01_SV04_V01_SV01" 7 "SVA_V01_SV04_V01_SV05" 8 "SVA_V01_SV05_V01_SV04" 9 "SVA_V01_SV01_V02_SV01" /end COMPU_VTAB
/begin COMPU_VTAB SVHDL_en_SubViewCfg ". " TAB_VERB 4 0 "SVCFG_NavDis_AdasDis" 1 "SVCFG_NavDis_AdasEn" 2 "SVCFG_NavEn_AdasDis" 3 "SVCFG_NavEn_AdasEn" /end COMPU_VTAB
/begin COMPU_VTAB SVHDL_en_SubViewTransSts ". " TAB_VERB 2 0 "SVNoTransitionOnGoing" 1 "SVTransitionOnGoing" /end COMPU_VTAB
/begin COMPU_VTAB SYSHDL_en_BsgOperationalMode ". " TAB_VERB 3 0 "Shutdown" 1 "WakeUp" 2 "FlashMode" /end COMPU_VTAB
/begin COMPU_VTAB SYSHDL_en_FullState ". " TAB_VERB 14 0 "DispSplashScreen" 1 "DispAlerts01" 2 "DispAlerts02" 3 "DispWelcome" 4 "DispBasic" 5 "DispFull01" 57 "LCWakeupSequence" 58 "SYFlashMode" 59 "TimeOut" 6 "DispFull02" 60 "OverVoltage" 61 "UnderVoltage" 62 "AswFailure" 63 "NotAvailable" /end COMPU_VTAB
/begin COMPU_VTAB SYSHDL_en_PowerState ". " TAB_VERB 7 0 "NormalVoltage" 1 "OverVoltage1" 14 "VoltageAlarm" 15 "NotAvailable" 2 "OverVoltage2" 3 "UnderVoltage1" 4 "UnderVoltage2" /end COMPU_VTAB
/begin COMPU_VTAB SYSHDL_en_SystemState ". " TAB_VERB 9 0 "SleepMode" 1 "ShutdownMode" 2 "ASWFailureMode" 3 "ModeOverVoltage" 4 "ModeUnderVoltage" 5 "LCWakeupSequence" 6 "TimeoutFailureMode" 7 "ActiveMode" 8 "SYFlashingMode" /end COMPU_VTAB
/begin COMPU_VTAB SYSHDL_en_Trm30VoltageStatus ". " TAB_VERB 5 0 "NormalVoltage" 1 "OverVoltage1" -1 "UnderVoltage1" 2 "OverVoltage2" -2 "UnderVoltage2" /end COMPU_VTAB
/begin COMPU_VTAB TTHDL_en_TelltaleBhvr ". " TAB_VERB 4 0 "TT_Off" 1 "TT_On" 2 "TT_SlowFlash" 3 "TT_FastFlash" /end COMPU_VTAB
/begin RECORD_LAYOUT LC_A_UINT8 FNC_VALUES 1 UBYTE ROW_DIR DIRECT /end RECORD_LAYOUT
/begin RECORD_LAYOUT LC_A_BOOLEAN FNC_VALUES 1 UBYTE ROW_DIR DIRECT /end RECORD_LAYOUT
/end MODULE
/end PROJECT
