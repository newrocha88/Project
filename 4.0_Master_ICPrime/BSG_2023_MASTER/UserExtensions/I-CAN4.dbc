VERSION ""

NS_ :

BS_:

BU_: BSG_Master IC Tester
VAL_TABLE_ SoundID 18 "TickTock" 17 "Gong3" 16 "800Hz" 15 "1250Hz" 14 "625Hz" 13 "Clack" 12 "Click" 11 "976Hz" 10 "2200Hz" 9 "1200Hz" 8 "488Hz" 7 "FireAlarm" 6 "Gong2" 5 "Gong1" 4 "600Hz" 3 "Tick" 2 "Tock" 1 "920Hz" 0 "2800Hz" ;

BO_ 2147484928 GATEWAY_TT_Ctrl_To_IC: 8 BSG_Master
 SG_ N_Gateway  : 0|64@1+ (1,0) [0|0] "" IC

BO_ 2147484929 GATEWAY_Gauge_Ctrl_To_IC: 8 BSG_Master
 SG_ N_Gateway  : 0|64@1+ (1,0) [0|0] "" IC

BO_ 2147484930 GATEWAY_Illumination_Ctrl_To_IC: 8 BSG_Master
 SG_ N_Gateway  : 0|64@1+ (1,0) [0|0] "" IC

BO_ 2147484931 GATEWAY_Sound_Ctrl_To_IC: 8 BSG_Master
 SG_ N_Gateway  : 0|64@1+ (1,0) [0|0] "" IC

BO_ 2147484932 GATEWAY_IC_Mode_To_IC: 8 BSG_Master
 SG_ N_Gateway  : 0|64@1+ (1,0) [0|0] "" IC

BO_ 2147485184 GATEWAY_IC_Status_From_IC: 8 IC
 SG_ N_Gateway  : 0|64@1+ (1,0) [0|0] "" BSG_Master

BO_ 2147487729 GATEWAY_M1: 8 BSG_Master
 SG_ N1_Gateway  : 0|32@1+ (1,0) [0|4294967295] "" Tester
 SG_ N2_Gateway  : 32|32@1+ (1,0) [0|4294967295] "" Tester

BO_ 2147487730 GATEWAY_M2: 8 BSG_Master
 SG_ N1_Gateway  : 0|32@1+ (1,0) [0|4294967295] "" Tester
 SG_ N2_Gateway  : 32|32@1+ (1,0) [0|4294967295] "" Tester

BO_ 2147487731 GATEWAY_M3: 8 BSG_Master
 SG_ N1_Gateway  : 0|32@1+ (1,0) [0|4294967295] "" Tester
 SG_ N2_Gateway  : 32|32@1+ (1,0) [0|4294967295] "" Tester

BO_ 2147487732 GATEWAY_M4: 8 Tester
 SG_ N1_Gateway  : 0|32@1+ (1,0) [0|4294967295] "" BSG_Master
 SG_ N2_Gateway  : 32|32@1+ (1,0) [0|4294967295] "" BSG_Master

BO_ 2147487733 GATEWAY_M5: 8 BSG_Master
 SG_ N1_Gateway  : 0|32@1+ (1,0) [0|4294967295] "" Tester
 SG_ N2_Gateway  : 32|32@1+ (1,0) [0|4294967295] "" Tester

BO_ 2147487734 GATEWAY_M6: 8 BSG_Master
 SG_ N1_Gateway  : 0|32@1+ (1,0) [0|4294967295] "" Tester
 SG_ N2_Gateway  : 32|32@1+ (1,0) [0|4294967295] "" Tester

BO_ 2147487735 GATEWAY_M7: 8 BSG_Master
 SG_ N1_Gateway  : 0|32@1+ (1,0) [0|4294967295] "" Tester
 SG_ N2_Gateway  : 32|32@1+ (1,0) [0|4294967295] "" Tester

BO_ 2564429808 XCP_REQUEST_IC: 8 BSG_Master
 SG_ N_PDU  : 0|64@1+ (1,0) [0|0] "" IC

BO_ 2564429809 DIAGNOSTICS_REQUEST_IC: 8 BSG_Master
 SG_ N_PDU  : 0|64@1+ (1,0) [0|0] "" IC

BO_ 2564485143 XCP_RESPONSE_IC: 8 IC
 SG_ N_PDU  : 0|64@1+ (1,0) [0|0] "" BSG_Master

BO_ 2564485399 DIAGNOSTICS_RESPONSE_IC: 8 IC
 SG_ N_PDU  : 0|64@1+ (1,0) [0|0] "" BSG_Master

CM_ BO_ 2564429808 "Diagnostics Request";
CM_ BO_ 2564429809 "Diagnostics Request";
CM_ BO_ 2564485143 "Diagnostics Response";
CM_ BO_ 2564485399 "Diagnostics Response";

BA_DEF_                "BusType"                            STRING ;
BA_DEF_                "DBName"                             STRING ;
BA_DEF_                "NmBaseAddress"                      HEX 1024 1087;
BA_DEF_     BO_        "GenMsgCycleTime"                    INT 0 0;
BA_DEF_     BO_        "GenMsgCycleTimeFast"                INT 2 50000;
BA_DEF_     BO_        "GenMsgILSupport"                    ENUM "No","Yes";
BA_DEF_     BO_        "GenMsgSendType"                     ENUM "Cyclic","not_used","not_used","not_used","not_used","Cyclic","not_used","IfActive","NoMsgSendType";
BA_DEF_     BU_        "ILUsed"                             ENUM "No","Yes";
BA_DEF_     BU_        "NmStationAddress"                   HEX 0 0;
BA_DEF_     BU_        "NodeLayerModules"                   STRING ;
BA_DEF_     SG_        "GenSigSendType"                     ENUM "Cyclic","OnWrite","OnWriteWithRepetition","OnChange","OnChangeWithRepetition","IfActive","IfActiveWithRepetition","NoSigSendType";
BA_DEF_     SG_        "NWM-WakeupAllowed"                  ENUM "No","Yes";
BA_DEF_DEF_     "BusType"                         "CAN";
BA_DEF_DEF_     "DBName"                          "";
BA_DEF_DEF_     "GenMsgCycleTime"                 0;
BA_DEF_DEF_     "GenMsgCycleTimeFast"             100;
BA_DEF_DEF_     "GenMsgILSupport"                 "Yes";
BA_DEF_DEF_     "GenMsgSendType"                  "NoMsgSendType";
BA_DEF_DEF_     "GenSigSendType"                  "Cyclic";
BA_DEF_DEF_     "ILUsed"                          "Yes";
BA_DEF_DEF_     "NWM-WakeupAllowed"               "";
BA_DEF_DEF_     "NmBaseAddress"                   1024;
BA_DEF_DEF_     "NmStationAddress"                0;
BA_DEF_DEF_     "NodeLayerModules"                "";
BA_     "DBName"                                       "I_CAN4";
BA_     "GenMsgCycleTime"                         BO_ 2147487732    100;
BA_     "GenMsgILSupport"                         BO_ 2564429808    0;
BA_     "GenMsgILSupport"                         BO_ 2564429809    0;
BA_     "GenMsgILSupport"                         BO_ 2564485143    0;
BA_     "GenMsgILSupport"                         BO_ 2564485399    0;
BA_     "GenMsgSendType"                          BO_ 2147487732    0;
BA_     "GenSigSendType"                          SG_ 2147484928 N_Gateway   7;
BA_     "GenSigSendType"                          SG_ 2147484929 N_Gateway   7;
BA_     "GenSigSendType"                          SG_ 2147484930 N_Gateway   7;
BA_     "GenSigSendType"                          SG_ 2147484931 N_Gateway   7;
BA_     "GenSigSendType"                          SG_ 2147484932 N_Gateway   7;
BA_     "GenSigSendType"                          SG_ 2147485184 N_Gateway   7;
BA_     "GenSigSendType"                          SG_ 2564429808 N_PDU   7;
BA_     "GenSigSendType"                          SG_ 2564429809 N_PDU   7;
BA_     "GenSigSendType"                          SG_ 2564485143 N_PDU   7;
BA_     "GenSigSendType"                          SG_ 2564485399 N_PDU   7;
BA_     "NWM-WakeupAllowed"                       SG_ 2147484928 N_Gateway   0;
BA_     "NWM-WakeupAllowed"                       SG_ 2147484929 N_Gateway   0;
BA_     "NWM-WakeupAllowed"                       SG_ 2147484930 N_Gateway   0;
BA_     "NWM-WakeupAllowed"                       SG_ 2147484931 N_Gateway   0;
BA_     "NWM-WakeupAllowed"                       SG_ 2147484932 N_Gateway   0;
BA_     "NWM-WakeupAllowed"                       SG_ 2147485184 N_Gateway   0;
BA_     "NWM-WakeupAllowed"                       SG_ 2564429808 N_PDU   0;
BA_     "NWM-WakeupAllowed"                       SG_ 2564429809 N_PDU   0;
BA_     "NWM-WakeupAllowed"                       SG_ 2564485143 N_PDU   0;
BA_     "NWM-WakeupAllowed"                       SG_ 2564485399 N_PDU   0;
BA_     "NmStationAddress"                        BU_ BSG_Master    33;
BA_     "NmStationAddress"                        BU_ IC    23;
BA_     "NmStationAddress"                        BU_ Tester    16;
BA_     "NodeLayerModules"                        BU_ BSG_Master    "CANoeILNLVector.dll, osek_tp.dll";
BA_     "NodeLayerModules"                        BU_ IC    "CANoeILNLVector.dll";
BA_     "NodeLayerModules"                        BU_ Tester    "CANoeILNLVector.dll";
