-no_append

DEFAULTS
{
   bootrom_cleared_ram_size = 0xD0
   NULL = 0x00000000
}
SECTIONS
{
   _osNullPointer = NULL;
   _osBswRam1Start = MEMADDR(BSW_TCRAM_1);
 CGEN_nOS_MODEL_APP1_RAM_Start= MEMADDR(MODEL_RAM_1);
 CGEN_nOS_MODEL_APP2_RAM_Start= MEMADDR(MODEL_RAM_2);
 CGEN_nOS_MODEL_APP3_RAM_Start= MEMADDR(MODEL_RAM_3);
 CGEN_nOS_MODEL_APP4_RAM_Start= MEMADDR(MODEL_RAM_4);
 CGEN_nOS_MODEL_APP5_RAM_Start= MEMADDR(MODEL_RAM_5);
 CGEN_nOS_MODEL_APP6_RAM_Start= MEMADDR(MODEL_RAM_6);
 CGEN_nOS_MODEL_PI_OUT_APP1_RAM_Start = MEMADDR(CGEN_PI_WR_RAM_1);
 CGEN_nOS_MODEL_PI_OUT_APP2_RAM_Start = MEMADDR(CGEN_PI_WR_RAM_2);
 CGEN_nOS_MODEL_PI_OUT_APP3_RAM_Start = MEMADDR(CGEN_PI_WR_RAM_3);
 CGEN_nOS_MODEL_PI_OUT_APP4_RAM_Start = MEMADDR(CGEN_PI_WR_RAM_4);
 CGEN_nOS_MODEL_PI_OUT_APP5_RAM_Start = MEMADDR(CGEN_PI_WR_RAM_5);
 CGEN_nOS_MODEL_PI_OUT_APP6_RAM_Start = MEMADDR(CGEN_PI_WR_RAM_6);
 _osModelRamStart=MEMADDR(MODEL_RAM_1);
 _osCgenPIWriteStart=MEMADDR(CGEN_PI_WR_RAM_1); 
   _osBswRam2Start = MEMADDR(BSW_SYSRAM_2);
   _osBuRamStart = MEMADDR(BU_RAM);
   _osBswSharedRamStart = MEMADDR(BSW_SHAREDRAM);
   _osCgenPIReadStart = MEMADDR(CGEN_PI_RD_COMMON_RAM);
 
   _osCgenDataStart = MEMADDR(CGEN_TCRAM);
   _osCodeStart = MEMADDR(BSW_ROM);
   _osAllDataStart = MEMADDR(BSW_TCRAM_1);
   _osAllStacksStart = MEMADDR(BSW_TCRAM_STACK);
   _BuRamStart = MEMADDR(BU_RAM);
   _osBuRamFailsafeStart = MEMADDR(BU_RAM_FAILSAFE);
   _osBuRamFailsafeSize = MEMENDADDR(BU_RAM_FAILSAFE) - MEMADDR(BU_RAM_FAILSAFE);
   _ClibStackEndAdr = ENDADDR(.ClibMainStack);
   _ClibMainStackStartAdr    = ADDR(.ClibMainStack);
   _CorTst_SecCode2StartAdr  = ADDR(.CorTst_SecCode2);
   _CorTst_SecConst2StartAdr = ADDR(.CorTst_SecConst2);
   _CorTst_SecDataStartAdr   = ADDR(.CorTst_SecData);
}
SECTIONS
{
   __ghs_romstart = MEMADDR(BSW_ROM);
   __ghs_romend = MEMENDADDR(MODEL_ROM);
   __ghs_ramstart = MEMADDR(BSW_TCRAM_STACK);
   __ghs_ramend = MEMENDADDR(BSW_SYSRAM_2);

   __ghs_rombootcodestart = ADDR(.BOOTSTART);
   __ghs_rombootcodeend = ENDADDR(.ROM.MODEL_INIT);

   __ghs_rambootcodestart = 0;
   __ghs_rambootcodeend = 0;
}


MEMORY
{
   BSW_TCRAM_STACK : ORIGIN = 0x00000000, LENGTH = 0x00008000
   CGEN_TCRAM : ORIGIN = 0x00008000, LENGTH = 0x00006000
   CGEN_TCRAM2 : ORIGIN = 0x0000e000, LENGTH = 0x00002000
   BSW_TCRAM_1 : ORIGIN = 0x00010000, LENGTH = 0x0000ff00
   FLD_RAM : ORIGIN = 0x0001ff00, LENGTH = 0x00000100
   MODEL_RAM_1 : ORIGIN = 0x02000000, LENGTH = 0x00008000
   MODEL_RAM_2 : ORIGIN = 0x02008000, LENGTH = 0x00008000
   MODEL_RAM_3 : ORIGIN = 0x02010000, LENGTH = 0x00008000
   MODEL_RAM_4 : ORIGIN = 0x02018000, LENGTH = 0x00008000
   MODEL_RAM_5 : ORIGIN = 0x02020000, LENGTH = 0x00008000
   MODEL_RAM_6 : ORIGIN = 0x02028000, LENGTH = 0x00008000
   TRACE_RAM : ORIGIN = 0x02038000, LENGTH = 0x00008000
   CGEN_PI_RD_COMMON_RAM : ORIGIN = 0x02040000, LENGTH = 0x00008000
   CGEN_PI_WR_RAM_1 : ORIGIN = 0x02048000, LENGTH = 0x00001000
   CGEN_PI_WR_RAM_2 : ORIGIN = 0x02049000, LENGTH = 0x00001000
   CGEN_PI_WR_RAM_3 : ORIGIN = 0x0204a000, LENGTH = 0x00001000
   CGEN_PI_WR_RAM_4 : ORIGIN = 0x0204b000, LENGTH = 0x00001000
   CGEN_PI_WR_RAM_5 : ORIGIN = 0x0204c000, LENGTH = 0x00001000
   CGEN_PI_WR_RAM_6 : ORIGIN = 0x0204d000, LENGTH = 0x00001000
   BSW_SHAREDRAM : ORIGIN = 0x0204f000, LENGTH = 0x00000800
   BSW_SYSRAM_2 : ORIGIN = 0x02050000, LENGTH = 0x00010000
   BU_RAM : ORIGIN = 0x0e800000, LENGTH = 0x00007af0
   BU_RAM_FAILSAFE : ORIGIN = 0x0e807af0, LENGTH = 0x00000510
   BSW_FLD_HEADER : ORIGIN = 0x01a20000, LENGTH = 0x00000100
   BSW_ROM : ORIGIN = 0x01a20100, LENGTH = 0x0015ff00
   MODEL_ROM : ORIGIN = 0x01b80000, LENGTH = 0x00250000
   MK_BASE_ADDRESS : ORIGIN = 0x019f0000, LENGTH = 0x00000080
   DDR_BASE_ADDRESS : ORIGIN = 0x019f0080, LENGTH = 0x00000040
   BDR_BASE_ADDRESS : ORIGIN = 0x019f00c0, LENGTH = 0x00000040
   WDR_BASE_ADDRESS : ORIGIN = 0x019f0100, LENGTH = 0x00000080
   CANConfigDatasetHdr : ORIGIN = 0x01de8000, LENGTH = 0x00000060
   CANConfigDatasetPayload : ORIGIN = 0x01de80a0, LENGTH = 0x00017f60
}

SECTIONS
{
   __BSW_RAM_tcram_stacks  : > BSW_TCRAM_STACK
   #include "rt3_tcram_stacks.ld" 
   __BSW_RAM_tcram_stacks_end  : > BSW_TCRAM_STACK
   CGEN_DATA_BSS NOCLEAR : > CGEN_TCRAM
   CGEN_RAMD_BSS NOCLEAR : > CGEN_TCRAM
   CGEN_NVM1_MODEL_BSS NOCLEAR : > CGEN_TCRAM
   CGEN_PGN_BSS NOCLEAR : > CGEN_TCRAM
   CGEN_REMOTE_BSS NOCLEAR : > CGEN_TCRAM
   CGEN_HMI_BSS NOCLEAR : > CGEN_TCRAM
   CGEN_PGN_MSGBUFFERS  : > CGEN_TCRAM2
   .CorTst_SecBss ALIGN(4096) : > BSW_TCRAM_1
   .osbss NOCLEAR : > BSW_TCRAM_1
   .bss_tcram NOCLEAR : > BSW_TCRAM_1
   .AIO_DATA_DMA align(4) NOCLEAR : > BSW_TCRAM_1
   .AIO_DATA_DMA_INV align(4) NOCLEAR : > BSW_TCRAM_1
   FSBIC_TCRAMTEST ALIGN (8) MIN_SIZE (8) : > BSW_TCRAM_1
   .ramtstStackBakupArea ALIGN (16) MIN_SIZE (768) : > BSW_TCRAM_1
   .ramtstDataBackupArea ALIGN (16) MIN_SIZE (1024) : > BSW_TCRAM_1
   .ramtstVStaticArea ALIGN (16) MIN_SIZE (128) : > BSW_TCRAM_1
   .CorTst_SecData ALIGN(64) : > BSW_TCRAM_1
   .osdata  : > BSW_TCRAM_1
   .data_tcram  : > BSW_TCRAM_1
   .safeguardEccTcFlash ALIGN(32) : > BSW_TCRAM_1
   MODEL_INIT_OsAppModel1Data  : > MODEL_RAM_1
   MODEL_DATA_OsAppModel1Bss NOCLEAR : > MODEL_RAM_1
   MODEL_INIT_OsAppModel2Data  : > MODEL_RAM_2
   MODEL_DATA_OsAppModel2Bss NOCLEAR : > MODEL_RAM_2
   MODEL_INIT_OsAppModel3Data  : > MODEL_RAM_3
   MODEL_DATA_OsAppModel3Bss NOCLEAR : > MODEL_RAM_3
   MODEL_INIT_OsAppModel4Data  : > MODEL_RAM_4
   MODEL_DATA_OsAppModel4Bss NOCLEAR : > MODEL_RAM_4
   MODEL_INIT_OsAppModel5Data  : > MODEL_RAM_5
   MODEL_DATA_OsAppModel5Bss NOCLEAR : > MODEL_RAM_5
   MODEL_INIT_OsAppModel6Data  : > MODEL_RAM_6
   MODEL_DATA_OsAppModel6Bss NOCLEAR : > MODEL_RAM_6
   .TRACE_BSS NOCLEAR : > TRACE_RAM
   CGEN_PI_BSS NOCLEAR : > CGEN_PI_RD_COMMON_RAM
   CGEN_PI_RD_OsAppAllModels_BSS NOCLEAR : > CGEN_PI_RD_COMMON_RAM
   CGEN_PI_WR_OsAppModel1 NOCLEAR : > CGEN_PI_WR_RAM_1
   CGEN_PI_WR_OsAppModel2 NOCLEAR : > CGEN_PI_WR_RAM_2
   CGEN_PI_WR_OsAppModel3 NOCLEAR : > CGEN_PI_WR_RAM_3
   CGEN_PI_WR_OsAppModel4 NOCLEAR : > CGEN_PI_WR_RAM_4
   CGEN_PI_WR_OsAppModel5 NOCLEAR : > CGEN_PI_WR_RAM_5
   CGEN_PI_WR_OsAppModel6 NOCLEAR : > CGEN_PI_WR_RAM_6
   .bss_shared  : > BSW_SHAREDRAM
   .data_shared  : > BSW_SHAREDRAM
   .ClibMainStack align(1024) MIN_SIZE (1024) NOCLEAR : > BSW_SHAREDRAM
   __BSW_RAM_sysram_stacks  : > BSW_SYSRAM_2
   #include "rt3_sysram_stacks.ld" 
   __BSW_RAM_sysram_stacks_end  : > BSW_SYSRAM_2
   .pidbase NOCLEAR align(16) : > BSW_SYSRAM_2
   .bss NOCLEAR : > BSW_SYSRAM_2
   .ethbss NOCLEAR : > BSW_SYSRAM_2
   MODEL_DATA_BSS NOCLEAR : > BSW_SYSRAM_2
   FSBIC_SYSRAMTEST_AXI64 MIN_SIZE (8) ALIGN (8)  : > BSW_SYSRAM_2
   .ethdata  : > BSW_SYSRAM_2
   .data  : > BSW_SYSRAM_2
   .syscall  : > BSW_SYSRAM_2
   MODEL_INIT  : > BSW_SYSRAM_2
   BU_RAM_START  : > BU_RAM
   . /* start BU data */ = align(32K) /*MPU8UsageBUData*/;
   .NOINIT NOCLEAR : > BU_RAM
   CGEN_BUDATA_BSS NOCLEAR : > BU_RAM
   CGEN_NVM2_BSW_BSS NOCLEAR : > BU_RAM
   FSBIC_BURAMTEST_AHB32 MIN_SIZE (4) ALIGN (4)  : > BU_RAM
   . /* end BU data */ = align(32K) /*MPU8UsageBUData*/;
   .EXEAREC  : > BU_RAM_FAILSAFE
   FAILSAFE_STORAGE  : > BU_RAM_FAILSAFE
   AdminInfoAppl  : > BSW_FLD_HEADER
   BSW_ROM_START  : > BSW_ROM
   .BOOTSTART ALIGN(16) : > BSW_ROM
   .oscode ALIGN(32) : > BSW_ROM
   .osIrqVecTab  : > BSW_ROM
   .osFiqVecTab  : > BSW_ROM
   .osArmExcVecTab  : > BSW_ROM
   .text  : > BSW_ROM
   .intercall  : > BSW_ROM
   .interfunc  : > BSW_ROM
   .CorTst_SecCode1  : > BSW_ROM
   .CorTst_SecCode2 ALIGN(4096) : > BSW_ROM
   .osSectionConfigBlock  : > BSW_ROM
   .osconst  : > BSW_ROM
   .robase  : > BSW_ROM
   .rodata  : > BSW_ROM
   .picbase  : > BSW_ROM
   .fixaddr  : > BSW_ROM
   .fixtype  : > BSW_ROM
   .secinfo  : > BSW_ROM
   .CorTst_SecConst1  : > BSW_ROM
   .CorTst_SecConst2 ALIGN(256) : > BSW_ROM
   FSBIC_TCFLASHTEST_AXI64 ALIGN(8) : > BSW_ROM
   .ROM.CorTst_SecData ROM(.CorTst_SecData) : > BSW_ROM
   .ROM.data ROM(.data) : > BSW_ROM
   .ROM.data_shared ROM(.data_shared) : > BSW_ROM
   .ROM.data_tcram ROM(.data_tcram) : > BSW_ROM
   .ROM.ethdata ROM(.ethdata) : > BSW_ROM
   .ROM.osdata ROM(.osdata) : > BSW_ROM
   .ROM.safeguardEccTcFlash ROM(.safeguardEccTcFlash) : > BSW_ROM
   .ROM.syscall ROM(.syscall) : > BSW_ROM
   CGEN_CODE  : > MODEL_ROM
   CGEN_CONST  : > MODEL_ROM
   CGEN_CONST_DATA  : > MODEL_ROM
   CGEN_CONST_BSS  : > MODEL_ROM
   CGEN_REMOTE_CONST  : > MODEL_ROM
   MODEL_CODE  : > MODEL_ROM
   MODEL_CODE_OsAppModel1  : > MODEL_ROM
   MODEL_CODE_OsAppModel2  : > MODEL_ROM
   MODEL_CODE_OsAppModel3  : > MODEL_ROM
   MODEL_CODE_OsAppModel4  : > MODEL_ROM
   MODEL_CODE_OsAppModel5  : > MODEL_ROM
   MODEL_CODE_OsAppModel6  : > MODEL_ROM
   MODEL_CONST  : > MODEL_ROM
   MODEL_CONST_OsAppModel1  : > MODEL_ROM
   MODEL_CONST_OsAppModel2  : > MODEL_ROM
   MODEL_CONST_OsAppModel3  : > MODEL_ROM
   MODEL_CONST_OsAppModel4  : > MODEL_ROM
   MODEL_CONST_OsAppModel5  : > MODEL_ROM
   MODEL_CONST_OsAppModel6  : > MODEL_ROM
   CGEN_FSC  : > MODEL_ROM
   . /* end BSW code */ = align(1M) /*MPU2UsageConst*/;
   .ROM.pidbase ROM(.pidbase) : > MODEL_ROM
   .ROM.__BSW_RAM_sysram_stacks ROM(__BSW_RAM_sysram_stacks) : > MODEL_ROM
   .ROM.BU_RAM_START ROM(BU_RAM_START) : > MODEL_ROM
   .ROM.MODEL_INIT ROM(MODEL_INIT) : > MODEL_ROM
   .ROM.MODEL_INIT_OsAppModel1Data ROM(MODEL_INIT_OsAppModel1Data) : > MODEL_ROM
   .ROM.MODEL_INIT_OsAppModel2Data ROM(MODEL_INIT_OsAppModel2Data) : > MODEL_ROM
   .ROM.MODEL_INIT_OsAppModel3Data ROM(MODEL_INIT_OsAppModel3Data) : > MODEL_ROM
   .ROM.MODEL_INIT_OsAppModel4Data ROM(MODEL_INIT_OsAppModel4Data) : > MODEL_ROM
   .ROM.MODEL_INIT_OsAppModel5Data ROM(MODEL_INIT_OsAppModel5Data) : > MODEL_ROM
   .ROM.MODEL_INIT_OsAppModel6Data ROM(MODEL_INIT_OsAppModel6Data) : > MODEL_ROM
   .MK  : > MK_BASE_ADDRESS
   .DDR  : > DDR_BASE_ADDRESS
   .BDR  : > BDR_BASE_ADDRESS
   .WDR  : > WDR_BASE_ADDRESS
   CANConfigDatasetPayloadSection  : > CANConfigDatasetPayload
}

SECTIONS
{
   CGEN_BSW_TCRAM_STACK_Start = MEMADDR(BSW_TCRAM_STACK);
   CGEN_CGEN_TCRAM_Start = MEMADDR(CGEN_TCRAM);
   CGEN_CGEN_TCRAM2_Start = MEMADDR(CGEN_TCRAM2);
   CGEN_BSW_TCRAM_1_Start = MEMADDR(BSW_TCRAM_1);
   CGEN_FLD_RAM_Start = MEMADDR(FLD_RAM);
   CGEN_MODEL_RAM_1_Start = MEMADDR(MODEL_RAM_1);
   CGEN_MODEL_RAM_2_Start = MEMADDR(MODEL_RAM_2);
   CGEN_MODEL_RAM_3_Start = MEMADDR(MODEL_RAM_3);
   CGEN_MODEL_RAM_4_Start = MEMADDR(MODEL_RAM_4);
   CGEN_MODEL_RAM_5_Start = MEMADDR(MODEL_RAM_5);
   CGEN_MODEL_RAM_6_Start = MEMADDR(MODEL_RAM_6);
   CGEN_TRACE_RAM_Start = MEMADDR(TRACE_RAM);
   CGEN_CGEN_PI_RD_COMMON_RAM_Start = MEMADDR(CGEN_PI_RD_COMMON_RAM);
   CGEN_CGEN_PI_WR_RAM_1_Start = MEMADDR(CGEN_PI_WR_RAM_1);
   CGEN_CGEN_PI_WR_RAM_2_Start = MEMADDR(CGEN_PI_WR_RAM_2);
   CGEN_CGEN_PI_WR_RAM_3_Start = MEMADDR(CGEN_PI_WR_RAM_3);
   CGEN_CGEN_PI_WR_RAM_4_Start = MEMADDR(CGEN_PI_WR_RAM_4);
   CGEN_CGEN_PI_WR_RAM_5_Start = MEMADDR(CGEN_PI_WR_RAM_5);
   CGEN_CGEN_PI_WR_RAM_6_Start = MEMADDR(CGEN_PI_WR_RAM_6);
   CGEN_BSW_SHAREDRAM_Start = MEMADDR(BSW_SHAREDRAM);
   CGEN_BSW_SYSRAM_2_Start = MEMADDR(BSW_SYSRAM_2);
   CGEN_BU_RAM_Start = MEMADDR(BU_RAM);
   CGEN_BU_RAM_FAILSAFE_Start = MEMADDR(BU_RAM_FAILSAFE);
}
