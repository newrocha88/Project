ASAP2_VERSION 1 7
/begin PROJECT RT_Test_eBSG_Master_010001 "BSG_EVO_Master_MBDS_RT_Test_eBSG_Master_010001"
/begin HEADER "C:\Proj\BSG_EVO\TestApp\__eBSG__MASTER\RT_Test_eBSG_Master_010001" VERSION "8.27.01.01_1210" PROJECT_NO _818303857 /end HEADER
/begin MODULE RT_Test_eBSG_Master_010001 "C:\Proj\BSG_EVO\TestApp\__eBSG__MASTER\RT_Test_eBSG_Master_010001"
/begin IF_DATA XCP
 /begin XCP_ON_CAN 0x0100 /*XCP on CAN version*/ CAN_ID_MASTER 0x18ef21f0 /* CMD/STIM */ CAN_ID_SLAVE 0x18eff021 /* RES/ERR/EV/SERV/DAQ */ BAUDRATE 250000 /* BAUDRATE */ SAMPLE_POINT 87 /* SAMPLE_POINT */ SAMPLE_RATE 1 /* SAMPLE_RATE */ BTL_CYCLES 160 /* BTL_CYCLES */ SJW 1 /* length synchr. segment */ CAN_ID_MASTER 0x18ef21f0 /* CMD/STIM */ CAN_ID_SLAVE 0x18eff021 /* RES/ERR/EV/SERV/DAQ */ BAUDRATE 250000 /* BAUDRATE */ SAMPLE_POINT 87 /* SAMPLE_POINT */ SAMPLE_RATE 1 /* SAMPLE_RATE */ BTL_CYCLES 160 /* BTL_CYCLES */ SJW 1 /* length synchr. segment */
  /begin PROTOCOL_LAYER 0x0100 0x07D0 0x2710 0 0 0 0 0 8 /* kXcpMaxCto */ 8 /* kXcpMaxDto */ BYTE_ORDER_MSB_LAST ADDRESS_GRANULARITY_BYTE OPTIONAL_CMD GET_COMM_MODE_INFO OPTIONAL_CMD GET_ID OPTIONAL_CMD SET_REQUEST OPTIONAL_CMD SET_MTA OPTIONAL_CMD UPLOAD OPTIONAL_CMD SHORT_UPLOAD OPTIONAL_CMD BUILD_CHECKSUM OPTIONAL_CMD DOWNLOAD OPTIONAL_CMD DOWNLOAD_NEXT OPTIONAL_CMD SET_CAL_PAGE OPTIONAL_CMD GET_CAL_PAGE OPTIONAL_CMD GET_PAG_PROCESSOR_INFO OPTIONAL_CMD GET_PAGE_INFO OPTIONAL_CMD SET_SEGMENT_MODE OPTIONAL_CMD GET_SEGMENT_MODE OPTIONAL_CMD COPY_CAL_PAGE OPTIONAL_CMD SET_DAQ_PTR OPTIONAL_CMD WRITE_DAQ OPTIONAL_CMD SET_DAQ_LIST_MODE OPTIONAL_CMD GET_DAQ_LIST_MODE OPTIONAL_CMD START_STOP_DAQ_LIST OPTIONAL_CMD START_STOP_SYNCH OPTIONAL_CMD GET_DAQ_PROCESSOR_INFO OPTIONAL_CMD GET_DAQ_RESOLUTION_INFO OPTIONAL_CMD GET_DAQ_EVENT_INFO OPTIONAL_CMD FREE_DAQ OPTIONAL_CMD ALLOC_DAQ OPTIONAL_CMD ALLOC_ODT OPTIONAL_CMD ALLOC_ODT_ENTRY COMMUNICATION_MODE_SUPPORTED BLOCK SLAVE MASTER 43 0 /end PROTOCOL_LAYER
  /begin PAG 1 /* MAX_SEGMENTS */ FREEZE_SUPPORTED /end PAG
  /begin DAQ DYNAMIC 0 /* MAX_DAQ */ 2 /* MAX_EVENT_CHANNEL */ 0 /* MIN_DAQ */ OPTIMISATION_TYPE_DEFAULT /* OPTIMISATION_TYPE */ ADDRESS_EXTENSION_FREE /* ADDRESS_EXTENSION */ IDENTIFICATION_FIELD_TYPE_ABSOLUTE /* IDENTIFICATION_FIELD */ GRANULARITY_ODT_ENTRY_SIZE_DAQ_BYTE /* GRANULARITY_ODT_ENTRY_SIZE_DAQ */ 7 /* MAX_ODT_ENTRY_SIZE_DAQ */ OVERLOAD_INDICATION_PID PRESCALER_SUPPORTED RESUME_SUPPORTED
   /begin STIM GRANULARITY_ODT_ENTRY_SIZE_STIM_BYTE 7 /* MAX_ODT_ENTRY_SIZE_STIM */ /end STIM
   /begin EVENT "OltRead" /* EVENT_CHANNEL_NAME */ "OltRead" /* EVENT_CHANNEL_SHORT_NAME */ 0 /* EVENT_CHANNEL_NUMBER */ DAQ 1 /* MAX_DAQ_LIST */ 100 /* TIME_CYCLE */ 6 /* TIME_UNIT */ 0 /* PRIORITY */ /end EVENT
   /begin EVENT "OltWrite" /* EVENT_CHANNEL_NAME */ "OltWrite" /* EVENT_CHANNEL_SHORT_NAME */ 1 /* EVENT_CHANNEL_NUMBER */ DAQ 1 /* MAX_DAQ_LIST */ 100 /* TIME_CYCLE */ 6 /* TIME_UNIT */ 0 /* PRIORITY */ /end EVENT
  /end DAQ
  /begin PAG 1 /* MAX_SEGMENTS */ FREEZE_SUPPORTED /end PAG
 /end XCP_ON_CAN
/end IF_DATA
/begin IF_DATA VISION DEVICE_SETTING "FlashScript=2" DEVICE_SETTING "UDS_TargetCanID=0x98DA27F9" DEVICE_SETTING "UDS_ToolCanID=0x98DAF927" /end IF_DATA
/begin IF_DATA GENERATOR INFO "Description=Release-AnyCPU, .NET Framework 4.5" INFO "IMSVersion=1.33: DIAG.SW.TOOL.A2LGenerator(BASE)_V03.00.22" INFO "APPVersion=3.0.22.29848" /end IF_DATA
/begin MOD_PAR ""
 /begin MEMORY_SEGMENT NVM_Parameter "NVM Parameter_" DATA EEPROM INTERN 0x8910 0x06 -1 -1 -1 -1 -1 /end MEMORY_SEGMENT
 /begin MEMORY_SEGMENT MSW "MSW_" DATA ROM INTERN 0x1A20000 0x3B0000 -1 -1 -1 -1 -1 /end MEMORY_SEGMENT
 /begin MEMORY_SEGMENT MK_DDR_BDR_WDR "MK_DDR_BDR_WDR_" DATA ROM INTERN 0x19F0000 0x180 -1 -1 -1 -1 -1 /end MEMORY_SEGMENT
 /begin MEMORY_SEGMENT BM "BM_" DATA ROM INTERN 0x19F1F90 0x40 -1 -1 -1 -1 -1 /end MEMORY_SEGMENT
 /begin MEMORY_SEGMENT FLD "FLD_" DATA ROM INTERN 0x1A00010 0x40 -1 -1 -1 -1 -1 /end MEMORY_SEGMENT
 /begin MEMORY_SEGMENT CANConfigDataset "CANConfigDataset_" DATA ROM INTERN 0x1DE8000 0x18000 -1 -1 -1 -1 -1 /end MEMORY_SEGMENT
 SYSTEM_CONSTANT "BOOLEAN_TRUE" "1"
 SYSTEM_CONSTANT "BOOLEAN_FALSE" "0" VERSION "8.27.01.01_1210" ECU_CALIBRATION_OFFSET 0x00 /end MOD_PAR
/begin MOD_COMMON "" BYTE_ORDER MSB_LAST /end MOD_COMMON
/begin MEASUREMENT AlarmDevices.Alarm.CurrentAlarmTime.Task1 "" ULONG COMP_DEFAULT 0 0 0 255 ECU_ADDRESS 0x2040058 READ_WRITE /end MEASUREMENT
/begin MEASUREMENT AlarmDevices.Alarm.AlarmElapsed.Task1 "" UBYTE IS_BOOLEAN_TRUE 0 0 0 1 ECU_ADDRESS 0x204005C READ_WRITE /end MEASUREMENT
/begin MEASUREMENT AlarmDevices.Alarm.NewAlarmTime.Task1 "" ULONG COMP_DEFAULT 0 0 0 255 ECU_ADDRESS 0x2048000 READ_WRITE /end MEASUREMENT
/begin MEASUREMENT AlarmDevices.Alarm.SetAlarm.Task1 "" UBYTE IS_BOOLEAN_TRUE 0 0 0 1 ECU_ADDRESS 0x2048004 READ_WRITE /end MEASUREMENT
/begin MEASUREMENT AlarmDevices.Alarm.CurrentAlarmTime_DIAG.Task1 "Diagnosis Input" UWORD COMP_DEFAULT 0 0 0 65535 ECU_ADDRESS 0x2040008 READ_WRITE /end MEASUREMENT
/begin MEASUREMENT AlarmDevices.Alarm.SetAlarm_DIAG.Task1 "Diagnosis Input" UWORD COMP_DEFAULT 0 0 0 65535 ECU_ADDRESS 0x204000A READ_WRITE /end MEASUREMENT
/begin MEASUREMENT DateandTime.LocalTime.Task1 "3.1.2.1.2 LocalTime" ULONG COMP_DEFAULT 0 0 0 255 ECU_ADDRESS 0x2040060 READ_WRITE /end MEASUREMENT
/begin MEASUREMENT DateandTime.SystemTime.Task1 "3.1.2.1.1 SystemTime" ULONG COMP_DEFAULT 0 0 0 255 ECU_ADDRESS 0x2040064 READ_WRITE /end MEASUREMENT
/begin MEASUREMENT DateandTime.TicksCount.Task1 "3.1.2.1.3 TicksCount" ULONG COMP_DEFAULT 0 0 0 255 ECU_ADDRESS 0x2040068 READ_WRITE /end MEASUREMENT
/begin MEASUREMENT DateandTime.NewSystemTime.Task1 "3.1.2.2.1 NewSystemTime" ULONG COMP_DEFAULT 0 0 0 255 ECU_ADDRESS 0x2048008 READ_WRITE /end MEASUREMENT
/begin MEASUREMENT DateandTime.HourOffset.Task1 "3.1.2.2.2 HourOffset" SBYTE COMP_DEFAULT 0 0 -128 127 ECU_ADDRESS 0x204800C READ_WRITE /end MEASUREMENT
/begin MEASUREMENT DateandTime.MinuteOffset.Task1 "3.1.2.2.3 MinuteOffset" SBYTE COMP_DEFAULT 0 0 -128 127 ECU_ADDRESS 0x204800D READ_WRITE /end MEASUREMENT
/begin MEASUREMENT DateandTime.SetTime.Task1 "3.1.2.2.4 SetTime" UBYTE IS_BOOLEAN_TRUE 0 0 0 1 ECU_ADDRESS 0x204800E READ_WRITE /end MEASUREMENT
/begin MEASUREMENT DateandTime.LocalTime_DIAG.Task1 "Diagnosis Input" UWORD COMP_DEFAULT 0 0 0 65535 ECU_ADDRESS 0x204000C READ_WRITE /end MEASUREMENT
/begin MEASUREMENT DateandTime.SetTime_DIAG.Task1 "Diagnosis Input" UWORD COMP_DEFAULT 0 0 0 65535 ECU_ADDRESS 0x204000E READ_WRITE /end MEASUREMENT
/begin MEASUREMENT DateandTime.SystemTime_DIAG.Task1 "Diagnosis Input" UWORD COMP_DEFAULT 0 0 0 65535 ECU_ADDRESS 0x2040010 READ_WRITE /end MEASUREMENT
/begin MEASUREMENT OUT_ModelControl.ModelHold.Task1 "3.3.1.1.1 ModelHold" UBYTE IS_BOOLEAN_TRUE 0 0 0 1 ECU_ADDRESS 0x2048010 READ_WRITE /end MEASUREMENT
/begin MEASUREMENT DigitalInputs.IN_DIG_03.Task1 "" UBYTE IS_BOOLEAN_TRUE 0 0 0 1 ECU_ADDRESS 0x204006C READ_WRITE /end MEASUREMENT
/begin MEASUREMENT DigitalInputs.IN_DIG_04.Task1 "" UBYTE IS_BOOLEAN_TRUE 0 0 0 1 ECU_ADDRESS 0x204006D READ_WRITE /end MEASUREMENT
/begin MEASUREMENT DigitalInputs.IN_DIG_05.Task1 "" UBYTE IS_BOOLEAN_TRUE 0 0 0 1 ECU_ADDRESS 0x204006E READ_WRITE /end MEASUREMENT
/begin MEASUREMENT DigitalInputs.IN_DIG_06.Task1 "" UBYTE IS_BOOLEAN_TRUE 0 0 0 1 ECU_ADDRESS 0x204006F READ_WRITE /end MEASUREMENT
/begin MEASUREMENT DigitalInputs.IN_DIG_07.Task1 "" UBYTE IS_BOOLEAN_TRUE 0 0 0 1 ECU_ADDRESS 0x2040070 READ_WRITE /end MEASUREMENT
/begin MEASUREMENT DigitalInputs.IN_DIG_08.Task1 "" UBYTE IS_BOOLEAN_TRUE 0 0 0 1 ECU_ADDRESS 0x2040071 READ_WRITE /end MEASUREMENT
/begin MEASUREMENT DigitalInputs.IN_DIG_09.Task1 "" UBYTE IS_BOOLEAN_TRUE 0 0 0 1 ECU_ADDRESS 0x2040072 READ_WRITE /end MEASUREMENT
/begin MEASUREMENT DigitalInputs.IN_DIG_11.Task1 "" UBYTE IS_BOOLEAN_TRUE 0 0 0 1 ECU_ADDRESS 0x2040073 READ_WRITE /end MEASUREMENT
/begin MEASUREMENT DigitalInputs.IN_DIG_12.Task1 "" UBYTE IS_BOOLEAN_TRUE 0 0 0 1 ECU_ADDRESS 0x2040074 READ_WRITE /end MEASUREMENT
/begin MEASUREMENT DigitalInputs.IN_DIG_13.Task1 "" UBYTE IS_BOOLEAN_TRUE 0 0 0 1 ECU_ADDRESS 0x2040075 READ_WRITE /end MEASUREMENT
/begin MEASUREMENT DigitalInputs.IN_DIG_14.Task1 "" UBYTE IS_BOOLEAN_TRUE 0 0 0 1 ECU_ADDRESS 0x2040076 READ_WRITE /end MEASUREMENT
/begin MEASUREMENT DigitalInputs.IN_DIG_15.Task1 "" UBYTE IS_BOOLEAN_TRUE 0 0 0 1 ECU_ADDRESS 0x2040077 READ_WRITE /end MEASUREMENT
/begin MEASUREMENT DigitalInputs.IN_DIG_16.Task1 "" UBYTE IS_BOOLEAN_TRUE 0 0 0 1 ECU_ADDRESS 0x2040078 READ_WRITE /end MEASUREMENT
/begin MEASUREMENT DigitalInputs.IN_DIG_18.Task1 "" UBYTE IS_BOOLEAN_TRUE 0 0 0 1 ECU_ADDRESS 0x2040079 READ_WRITE /end MEASUREMENT
/begin MEASUREMENT DigitalInputs.IN_DIG_19.Task1 "" UBYTE IS_BOOLEAN_TRUE 0 0 0 1 ECU_ADDRESS 0x204007A READ_WRITE /end MEASUREMENT
/begin MEASUREMENT DigitalInputs.IN_DIG_20.Task1 "" UBYTE IS_BOOLEAN_TRUE 0 0 0 1 ECU_ADDRESS 0x204007B READ_WRITE /end MEASUREMENT
/begin MEASUREMENT DigitalInputs.IN_DIG_21.Task1 "" UBYTE IS_BOOLEAN_TRUE 0 0 0 1 ECU_ADDRESS 0x204007C READ_WRITE /end MEASUREMENT
/begin MEASUREMENT DigitalInputs.IN_DIG_22.Task1 "" UBYTE IS_BOOLEAN_TRUE 0 0 0 1 ECU_ADDRESS 0x204007D READ_WRITE /end MEASUREMENT
/begin MEASUREMENT DigitalInputs.IN_DIG_23.Task1 "" UBYTE IS_BOOLEAN_TRUE 0 0 0 1 ECU_ADDRESS 0x204007E READ_WRITE /end MEASUREMENT
/begin MEASUREMENT DigitalInputs.IN_DIG_24.Task1 "" UBYTE IS_BOOLEAN_TRUE 0 0 0 1 ECU_ADDRESS 0x204007F READ_WRITE /end MEASUREMENT
/begin MEASUREMENT DigitalInputs.IN_DIG_25.Task1 "" UBYTE IS_BOOLEAN_TRUE 0 0 0 1 ECU_ADDRESS 0x2040080 READ_WRITE /end MEASUREMENT
/begin MEASUREMENT DigitalInputs.IN_DIG_27.Task1 "" UBYTE IS_BOOLEAN_TRUE 0 0 0 1 ECU_ADDRESS 0x2040081 READ_WRITE /end MEASUREMENT
/begin MEASUREMENT DigitalInputs.IN_DIG_28.Task1 "" UBYTE IS_BOOLEAN_TRUE 0 0 0 1 ECU_ADDRESS 0x2040082 READ_WRITE /end MEASUREMENT
/begin MEASUREMENT DigitalInputs.IN_DIG_29.Task1 "" UBYTE IS_BOOLEAN_TRUE 0 0 0 1 ECU_ADDRESS 0x2040083 READ_WRITE /end MEASUREMENT
/begin MEASUREMENT DigitalInputs.IN_DIG_30.Task1 "" UBYTE IS_BOOLEAN_TRUE 0 0 0 1 ECU_ADDRESS 0x2040084 READ_WRITE /end MEASUREMENT
/begin MEASUREMENT DigitalInputs.IN_DIG_31.Task1 "" UBYTE IS_BOOLEAN_TRUE 0 0 0 1 ECU_ADDRESS 0x2040085 READ_WRITE /end MEASUREMENT
/begin MEASUREMENT DigitalInputs.IN_DIG_32.Task1 "" UBYTE IS_BOOLEAN_TRUE 0 0 0 1 ECU_ADDRESS 0x2040086 READ_WRITE /end MEASUREMENT
/begin MEASUREMENT DigitalInputs.IN_DIG_33.Task1 "" UBYTE IS_BOOLEAN_TRUE 0 0 0 1 ECU_ADDRESS 0x2040087 READ_WRITE /end MEASUREMENT
/begin MEASUREMENT DigitalInputs.IN_DIG_34.Task1 "" UBYTE IS_BOOLEAN_TRUE 0 0 0 1 ECU_ADDRESS 0x2040088 READ_WRITE /end MEASUREMENT
/begin MEASUREMENT DigitalInputs.IN_DIG_37.Task1 "" UBYTE IS_BOOLEAN_TRUE 0 0 0 1 ECU_ADDRESS 0x2040089 READ_WRITE /end MEASUREMENT
/begin MEASUREMENT DigitalInputs.IN_DIG_38.Task1 "" UBYTE IS_BOOLEAN_TRUE 0 0 0 1 ECU_ADDRESS 0x204008A READ_WRITE /end MEASUREMENT
/begin MEASUREMENT DigitalInputs.IN_DIG_39.Task1 "" UBYTE IS_BOOLEAN_TRUE 0 0 0 1 ECU_ADDRESS 0x204008B READ_WRITE /end MEASUREMENT
/begin MEASUREMENT DigitalInputs.IN_DIG_41.Task1 "" UBYTE IS_BOOLEAN_TRUE 0 0 0 1 ECU_ADDRESS 0x204008C READ_WRITE /end MEASUREMENT
/begin MEASUREMENT DigitalInputs.IN_DIG_42.Task1 "" UBYTE IS_BOOLEAN_TRUE 0 0 0 1 ECU_ADDRESS 0x204008D READ_WRITE /end MEASUREMENT
/begin MEASUREMENT DigitalInputs.IN_DIG_43.Task1 "" UBYTE IS_BOOLEAN_TRUE 0 0 0 1 ECU_ADDRESS 0x204008E READ_WRITE /end MEASUREMENT
/begin MEASUREMENT DigitalInputs.IN_DIG_44.Task1 "" UBYTE IS_BOOLEAN_TRUE 0 0 0 1 ECU_ADDRESS 0x204008F READ_WRITE /end MEASUREMENT
/begin MEASUREMENT DigitalInputs.IN_DIG_45.Task1 "" UBYTE IS_BOOLEAN_TRUE 0 0 0 1 ECU_ADDRESS 0x2040090 READ_WRITE /end MEASUREMENT
/begin MEASUREMENT DigitalInputs.IN_DIG_46.Task1 "" UBYTE IS_BOOLEAN_TRUE 0 0 0 1 ECU_ADDRESS 0x2040091 READ_WRITE /end MEASUREMENT
/begin MEASUREMENT DigitalInputs.IN_DIG_48.Task1 "" UBYTE IS_BOOLEAN_TRUE 0 0 0 1 ECU_ADDRESS 0x2040092 READ_WRITE /end MEASUREMENT
/begin MEASUREMENT DigitalInputs.IN_DIG_49.Task1 "" UBYTE IS_BOOLEAN_TRUE 0 0 0 1 ECU_ADDRESS 0x2040093 READ_WRITE /end MEASUREMENT
/begin MEASUREMENT DigitalInputs.IN_DIG_50.Task1 "" UBYTE IS_BOOLEAN_TRUE 0 0 0 1 ECU_ADDRESS 0x2040094 READ_WRITE /end MEASUREMENT
/begin MEASUREMENT IN_DIG_02_DriverDoor.Task1 "" UBYTE IS_BOOLEAN_TRUE 0 0 0 1 ECU_ADDRESS 0x2040095 READ_WRITE /end MEASUREMENT
/begin MEASUREMENT IN_DIG_10_CabinLight.Task1 "" UBYTE IS_BOOLEAN_TRUE 0 0 0 1 ECU_ADDRESS 0x2040096 READ_WRITE /end MEASUREMENT
/begin MEASUREMENT IN_DIG_17_Cabin_Lock.Task1 "" UBYTE IS_BOOLEAN_TRUE 0 0 0 1 ECU_ADDRESS 0x2040097 READ_WRITE /end MEASUREMENT
/begin MEASUREMENT IN_DIG_26_HazardSwitch.Task1 "" UBYTE IS_BOOLEAN_TRUE 0 0 0 1 ECU_ADDRESS 0x2040098 READ_WRITE /end MEASUREMENT
/begin MEASUREMENT IN_DIG_35_PassengerDoor.Task1 "" UBYTE IS_BOOLEAN_TRUE 0 0 0 1 ECU_ADDRESS 0x2040099 READ_WRITE /end MEASUREMENT
/begin MEASUREMENT IN_DIG_36_KL15.Task1 "" UBYTE IS_BOOLEAN_TRUE 0 0 0 1 ECU_ADDRESS 0x204009A READ_WRITE /end MEASUREMENT
/begin MEASUREMENT IN_DIG_40_KL58.Task1 "" UBYTE IS_BOOLEAN_TRUE 0 0 0 1 ECU_ADDRESS 0x204009B READ_WRITE /end MEASUREMENT
/begin MEASUREMENT IN_DigitalInputs.IN_DIG_01.Task1 "" UBYTE IS_BOOLEAN_TRUE 0 0 0 1 ECU_ADDRESS 0x204009C READ_WRITE /end MEASUREMENT
/begin MEASUREMENT IN_DigitalInputs.IN_DIG_01.Task2 "" UBYTE IS_BOOLEAN_TRUE 0 0 0 1 ECU_ADDRESS 0x2040000 READ_WRITE /end MEASUREMENT
/begin MEASUREMENT IN_DigitalInputs.IN_DIG_01.Task3 "" UBYTE IS_BOOLEAN_TRUE 0 0 0 1 ECU_ADDRESS 0x2040001 READ_WRITE /end MEASUREMENT
/begin MEASUREMENT IN_DigitalInputs.IN_DIG_01.Task4 "" UBYTE IS_BOOLEAN_TRUE 0 0 0 1 ECU_ADDRESS 0x2040002 READ_WRITE /end MEASUREMENT
/begin MEASUREMENT IN_DigitalInputs.IN_DIG_01.Task5 "" UBYTE IS_BOOLEAN_TRUE 0 0 0 1 ECU_ADDRESS 0x2040003 READ_WRITE /end MEASUREMENT
/begin MEASUREMENT IN_DigitalInputs.IN_DIG_01.Task6 "" UBYTE IS_BOOLEAN_TRUE 0 0 0 1 ECU_ADDRESS 0x2040004 READ_WRITE /end MEASUREMENT
/begin MEASUREMENT DigitalOutputsSTATIC.OUT_01_TD.Task1 "PWR_HSS_SENSE_04, ISO, LM, TD" UBYTE IS_BOOLEAN_TRUE 0 0 0 1 ECU_ADDRESS 0x204009D READ_WRITE /end MEASUREMENT
/begin MEASUREMENT DigitalOutputsSTATIC.OUT_04_TD.Task1 "PWR_HSS_SENSE_04, ISO, LM, TD" UBYTE IS_BOOLEAN_TRUE 0 0 0 1 ECU_ADDRESS 0x204009E READ_WRITE /end MEASUREMENT
/begin MEASUREMENT DigitalOutputsSTATIC.OUT_01_TD_START.Task1 "TD" UBYTE IS_BOOLEAN_TRUE 0 0 0 1 ECU_ADDRESS 0x2048011 READ_WRITE /end MEASUREMENT
/begin MEASUREMENT DigitalOutputsSTATIC.OUT_04.Task1 "PWR_HSS_SENSE_04, ISO, TD" UBYTE IS_BOOLEAN_TRUE 0 0 0 1 ECU_ADDRESS 0x2048012 READ_WRITE /end MEASUREMENT
/begin MEASUREMENT DigitalOutputsSTATIC.OUT_04_TD_START.Task1 "TD" UBYTE IS_BOOLEAN_TRUE 0 0 0 1 ECU_ADDRESS 0x2048013 READ_WRITE /end MEASUREMENT
/begin MEASUREMENT OUT_DigitalOutputsSTATIC.OUT_01.Task1 "PWR_HSS_SENSE_04, ISO, TD" UBYTE IS_BOOLEAN_TRUE 0 0 0 1 ECU_ADDRESS 0x2048014 READ_WRITE /end MEASUREMENT
/begin MEASUREMENT DIAG_DigitalOutputsSTATIC.OUT_01_DIAG.Task1 "Diagnosis Input" UWORD COMP_DEFAULT 0 0 0 65535 ECU_ADDRESS 0x2040012 READ_WRITE /end MEASUREMENT
/begin MEASUREMENT DigitalOutputsSTATIC.OUT_01_TD_DIAG.Task1 "Diagnostic Input" UWORD COMP_DEFAULT 0 0 0 65535 ECU_ADDRESS 0x2040014 READ_WRITE /end MEASUREMENT
/begin MEASUREMENT DigitalOutputsSTATIC.OUT_04_DIAG.Task1 "Diagnosis Input" UWORD COMP_DEFAULT 0 0 0 65535 ECU_ADDRESS 0x2040016 READ_WRITE /end MEASUREMENT
/begin MEASUREMENT DigitalOutputsSTATIC.OUT_04_TD_DIAG.Task1 "Diagnosis Input" UWORD COMP_DEFAULT 0 0 0 65535 ECU_ADDRESS 0x2040018 READ_WRITE /end MEASUREMENT
/begin MEASUREMENT DigitalOutputPWM.OUT_20_TD.Task1 "PWR_HSS_SENSE_04, ISO, LM, TD" UBYTE IS_BOOLEAN_TRUE 0 0 0 1 ECU_ADDRESS 0x204009F READ_WRITE /end MEASUREMENT
/begin MEASUREMENT DigitalOutputPWM.OUT_20_PWM.Task1 "PWR_HSS_PWM_06" UBYTE COMP_DEFAULT 0 0 0 255 ECU_ADDRESS 0x2048015 READ_WRITE /end MEASUREMENT
/begin MEASUREMENT DigitalOutputPWM.OUT_20_TD_START.Task1 "TD" UBYTE IS_BOOLEAN_TRUE 0 0 0 1 ECU_ADDRESS 0x2048016 READ_WRITE /end MEASUREMENT
/begin MEASUREMENT DigitalOutputPWM.OUT_20_PWM_DIAG.Task1 "Diagnosis Input" UWORD COMP_DEFAULT 0 0 0 65535 ECU_ADDRESS 0x204001A READ_WRITE /end MEASUREMENT
/begin MEASUREMENT DigitalOutputPWM.OUT_20_TD_DIAG.Task1 "Diagnosis Input" UWORD COMP_DEFAULT 0 0 0 65535 ECU_ADDRESS 0x204001C READ_WRITE /end MEASUREMENT
/begin MEASUREMENT NVMModelRelatedData.NVMVariables2.DeviceState.Task1 "3.1.2.1.1 DeviceState" UWORD COMP_DEFAULT 0 0 0 65535 ECU_ADDRESS 0x20400A2 READ_WRITE /end MEASUREMENT
/begin MEASUREMENT NVMVariables2.Var1.Task1 "" ULONG COMP_DEFAULT 0 0 0 4294967295 ECU_ADDRESS 0x204801C READ_WRITE /end MEASUREMENT
/begin MEASUREMENT NVMVariables2.Var2.Task1 "" ULONG COMP_DEFAULT 0 0 0 4294967295 ECU_ADDRESS 0x2048020 READ_WRITE /end MEASUREMENT
/begin MEASUREMENT NVMModelRelatedData.NVMVariables2.StoreVariablesToNVM.Task1 "3.1.2.2.1 StoreVariablesToNVM<VariableId>" UBYTE IS_BOOLEAN_TRUE 0 0 0 1 ECU_ADDRESS 0x2048024 READ_WRITE /end MEASUREMENT
/begin MEASUREMENT NVMModelRelatedData.NVMVariables3.DeviceState.Task1 "3.1.2.1.1 DeviceState" UWORD COMP_DEFAULT 0 0 0 65535 ECU_ADDRESS 0x20400A4 READ_WRITE /end MEASUREMENT
/begin MEASUREMENT NVMModelRelatedData.NVMVariables3.Val_4.Task1 "" ULONG COMP_DEFAULT 0 0 0 4294967295 ECU_ADDRESS 0x2048028 READ_WRITE /end MEASUREMENT
/begin MEASUREMENT NVMModelRelatedData.NVMVariables3.Val_3.Task1 "" UWORD COMP_DEFAULT 0 0 0 65535 ECU_ADDRESS 0x204802C READ_WRITE /end MEASUREMENT
/begin MEASUREMENT NVMModelRelatedData.NVMVariables3.Val_1.Task1 "" UBYTE IS_BOOLEAN_TRUE 0 0 0 1 ECU_ADDRESS 0x204802E READ_WRITE /end MEASUREMENT
/begin MEASUREMENT NVMModelRelatedData.NVMVariables3.Val_2.Task1 "" UBYTE COMP_DEFAULT 0 0 0 255 ECU_ADDRESS 0x204802F READ_WRITE /end MEASUREMENT
/begin MEASUREMENT NVMModelRelatedData.NVMVariables3.Val_5.Task1 "" UBYTE COMP_DEFAULT 0 0 0 255 ECU_ADDRESS 0x2048030 READ_WRITE /end MEASUREMENT
/begin MEASUREMENT NVMVariables4.DeviceState.Task1 "3.1.2.1.1 DeviceState" UWORD COMP_DEFAULT 0 0 0 65535 ECU_ADDRESS 0x20400A6 READ_WRITE /end MEASUREMENT
/begin MEASUREMENT NVMVariables4.Var4_DINT.Task1 "" SLONG COMP_DEFAULT 0 0 -2147483648 2147483647 ECU_ADDRESS 0x2048034 READ_WRITE /end MEASUREMENT
/begin MEASUREMENT NVMVariables4.Var4_INT.Task1 "" SWORD COMP_DEFAULT 0 0 -32768 32767 ECU_ADDRESS 0x2048038 READ_WRITE /end MEASUREMENT
/begin MEASUREMENT NVMVariables4.Var4_SINT.Task1 "" SBYTE COMP_DEFAULT 0 0 -128 127 ECU_ADDRESS 0x204803A READ_WRITE /end MEASUREMENT
/begin MEASUREMENT NVMModelRelatedData.NVMVariables.DeviceState.Task1 "3.1.2.1.1 DeviceState" UWORD COMP_DEFAULT 0 0 0 65535 ECU_ADDRESS 0x20400A0 READ_WRITE /end MEASUREMENT
/begin MEASUREMENT NVMModelRelatedData.NVMVariables.Variable_u16.Task1 "" UWORD COMP_DEFAULT 0 0 0 65535 ECU_ADDRESS 0x2048018 READ_WRITE /end MEASUREMENT
/begin MEASUREMENT NVMModelRelatedData.NVMVariables.Variable_bo.Task1 "" UBYTE IS_BOOLEAN_TRUE 0 0 0 1 ECU_ADDRESS 0x204801A READ_WRITE /end MEASUREMENT
/begin MEASUREMENT NVMModelRelatedData.NVMParameter.DeviceState.Task1 "3.2.2.1.1 DeviceState" UWORD COMP_DEFAULT 0 0 0 65535 ECU_ADDRESS 0x20400A8 READ_WRITE /end MEASUREMENT
/begin MEASUREMENT NVMModelRelatedData.NVMParameter.Variable_01.Task1 "" UWORD COMP_DEFAULT 0 0 0 65535 ECU_ADDRESS 0x20400AA READ_WRITE /end MEASUREMENT
/begin MEASUREMENT NVMModelRelatedData.NVMParameter.Variable_02.Task1 "" UWORD COMP_DEFAULT 0 0 0 65535 ECU_ADDRESS 0x20400AC READ_WRITE /end MEASUREMENT
/begin MEASUREMENT NVMModelRelatedData.NVMParameter.Variable_00.Task1 "" UBYTE COMP_DEFAULT 0 0 0 255 ECU_ADDRESS 0x20400AE READ_WRITE /end MEASUREMENT
/begin MEASUREMENT RAMDevice.EEprom_Value.Task1 "" ULONG COMP_DEFAULT 0 0 0 4294967295 ECU_ADDRESS 0x204803C READ_WRITE /end MEASUREMENT
/begin MEASUREMENT RAMDevice.EEprom_Var3_Val4.Task1 "" ULONG COMP_DEFAULT 0 0 0 4294967295 ECU_ADDRESS 0x2048040 READ_WRITE /end MEASUREMENT
/begin MEASUREMENT RAMDevice.RAMDevice_udint.Task1 "" ULONG COMP_DEFAULT 0 0 0 4294967295 ECU_ADDRESS 0x2048044 READ_WRITE /end MEASUREMENT
/begin MEASUREMENT RAMDevice.TypeDINT.Task1 "" SLONG COMP_DEFAULT 0 0 -2147483648 2147483647 ECU_ADDRESS 0x2048048 READ_WRITE /end MEASUREMENT
/begin MEASUREMENT RAMDevice.TypeREAL.Task1 "" FLOAT32_IEEE COMP_DEFAULT 0 0 -3.4E+38 3.4E+38 ECU_ADDRESS 0x204804C READ_WRITE /end MEASUREMENT
/begin MEASUREMENT RAMDevice.DT_Year.Task1 "" UWORD COMP_DEFAULT 0 0 0 65535 ECU_ADDRESS 0x2048050 READ_WRITE /end MEASUREMENT
/begin MEASUREMENT RAMDevice.RAMDevice_uint.Task1 "" UWORD COMP_DEFAULT 0 0 0 65535 ECU_ADDRESS 0x2048052 READ_WRITE /end MEASUREMENT
/begin MEASUREMENT RAMDevice.TypeINT.Task1 "" SWORD COMP_DEFAULT 0 0 -32768 32767 ECU_ADDRESS 0x2048054 READ_WRITE /end MEASUREMENT
/begin MEASUREMENT RAMDevice.DM4RX_BusOff_GeneralError.Task1 "" UBYTE IS_BOOLEAN_TRUE 0 0 0 1 ECU_ADDRESS 0x2048056 READ_WRITE /end MEASUREMENT
/begin MEASUREMENT RAMDevice.DT_Day.Task1 "" UBYTE COMP_DEFAULT 0 0 0 255 ECU_ADDRESS 0x2048057 READ_WRITE /end MEASUREMENT
/begin MEASUREMENT RAMDevice.DT_Hours.Task1 "" UBYTE COMP_DEFAULT 0 0 0 255 ECU_ADDRESS 0x2048058 READ_WRITE /end MEASUREMENT
/begin MEASUREMENT RAMDevice.DT_Minutes.Task1 "" UBYTE COMP_DEFAULT 0 0 0 255 ECU_ADDRESS 0x2048059 READ_WRITE /end MEASUREMENT
/begin MEASUREMENT RAMDevice.DT_Month.Task1 "" UBYTE COMP_DEFAULT 0 0 0 255 ECU_ADDRESS 0x204805A READ_WRITE /end MEASUREMENT
/begin MEASUREMENT RAMDevice.DT_Seconds.Task1 "" UBYTE COMP_DEFAULT 0 0 0 255 ECU_ADDRESS 0x204805B READ_WRITE /end MEASUREMENT
/begin MEASUREMENT RAMDevice.RAMDevice_usint.Task1 "" UBYTE COMP_DEFAULT 0 0 0 255 ECU_ADDRESS 0x204805C READ_WRITE /end MEASUREMENT
/begin MEASUREMENT RAMDevice.RoutineCtrl_Response.Task1 "" UBYTE COMP_DEFAULT 0 0 0 255 ECU_ADDRESS 0x204805D READ_WRITE /end MEASUREMENT
/begin MEASUREMENT RAMDevice.TypeSINT.Task1 "" SBYTE COMP_DEFAULT 0 0 -128 127 ECU_ADDRESS 0x204805E READ_WRITE /end MEASUREMENT
/begin MEASUREMENT DEMDiagnosticEventManager.DeviceState.Task1 "3.1.3.1.1 DeviceState" UWORD COMP_DEFAULT 0 0 0 65535 ECU_ADDRESS 0x20400B6 READ_WRITE /end MEASUREMENT
/begin MEASUREMENT DEMDiagnosticEventManager.DateAndTime.Task1 "3.1.3.2.10 DateAndTime" ULONG COMP_DEFAULT 0 0 0 4294967295 ECU_ADDRESS 0x2048068 READ_WRITE /end MEASUREMENT
/begin MEASUREMENT DEMDiagnosticEventManager.Distance.Task1 "3.1.3.2.8 Distance" ULONG COMP_DEFAULT 0 0 0 4294967295 ECU_ADDRESS 0x204806C READ_WRITE /end MEASUREMENT
/begin MEASUREMENT DEMDiagnosticEventManager.FreezeFrame1.Task1 "3.1.3.2.11 FreezeFrame " UWORD COMP_DEFAULT 0 0 0 65535 ECU_ADDRESS 0x2048070 READ_WRITE /end MEASUREMENT
/begin MEASUREMENT DEMDiagnosticEventManager.FreezeFrame10.Task1 "3.1.3.2.11 FreezeFrame " UWORD COMP_DEFAULT 0 0 0 65535 ECU_ADDRESS 0x2048072 READ_WRITE /end MEASUREMENT
/begin MEASUREMENT DEMDiagnosticEventManager.FreezeFrame2.Task1 "3.1.3.2.11 FreezeFrame " UWORD COMP_DEFAULT 0 0 0 65535 ECU_ADDRESS 0x2048074 READ_WRITE /end MEASUREMENT
/begin MEASUREMENT DEMDiagnosticEventManager.FreezeFrame3.Task1 "3.1.3.2.11 FreezeFrame " UWORD COMP_DEFAULT 0 0 0 65535 ECU_ADDRESS 0x2048076 READ_WRITE /end MEASUREMENT
/begin MEASUREMENT DEMDiagnosticEventManager.FreezeFrame4.Task1 "3.1.3.2.11 FreezeFrame " UWORD COMP_DEFAULT 0 0 0 65535 ECU_ADDRESS 0x2048078 READ_WRITE /end MEASUREMENT
/begin MEASUREMENT DEMDiagnosticEventManager.FreezeFrame5.Task1 "3.1.3.2.11 FreezeFrame " UWORD COMP_DEFAULT 0 0 0 65535 ECU_ADDRESS 0x204807A READ_WRITE /end MEASUREMENT
/begin MEASUREMENT DEMDiagnosticEventManager.FreezeFrame6.Task1 "3.1.3.2.11 FreezeFrame " UWORD COMP_DEFAULT 0 0 0 65535 ECU_ADDRESS 0x204807C READ_WRITE /end MEASUREMENT
/begin MEASUREMENT DEMDiagnosticEventManager.FreezeFrame7.Task1 "3.1.3.2.11 FreezeFrame " UWORD COMP_DEFAULT 0 0 0 65535 ECU_ADDRESS 0x204807E READ_WRITE /end MEASUREMENT
/begin MEASUREMENT DEMDiagnosticEventManager.FreezeFrame8.Task1 "3.1.3.2.11 FreezeFrame " UWORD COMP_DEFAULT 0 0 0 65535 ECU_ADDRESS 0x2048080 READ_WRITE /end MEASUREMENT
/begin MEASUREMENT DEMDiagnosticEventManager.FreezeFrame9.Task1 "3.1.3.2.11 FreezeFrame " UWORD COMP_DEFAULT 0 0 0 65535 ECU_ADDRESS 0x2048082 READ_WRITE /end MEASUREMENT
/begin MEASUREMENT DEMDiagnosticEventManager.EnableCondition00.Task1 "3.1.3.2.2 EnableCondition" UBYTE IS_BOOLEAN_TRUE 0 0 0 1 ECU_ADDRESS 0x2048084 READ_WRITE /end MEASUREMENT
/begin MEASUREMENT DEMDiagnosticEventManager.OperationCycle.Task1 "3.1.3.2.1 OperationCycle" UBYTE IS_BOOLEAN_TRUE 0 0 0 1 ECU_ADDRESS 0x2048085 READ_WRITE /end MEASUREMENT
/begin MEASUREMENT DEMDiagnosticEventManager.StorageCondition00.Task1 "3.1.3.2.3 StorageCondition" UBYTE IS_BOOLEAN_TRUE 0 0 0 1 ECU_ADDRESS 0x2048086 READ_WRITE /end MEASUREMENT
/begin MEASUREMENT DEMDiagnosticEventManager.DEMList.DTC_01_01_PF_GetStatus.Task1 "" UBYTE COMP_DEFAULT 0 0 0 255 ECU_ADDRESS 0x20400B0 READ_WRITE /end MEASUREMENT
/begin MEASUREMENT DEMDiagnosticEventManager.DEMList.DTC_02_02_AF_GetStatus.Task1 "" UBYTE COMP_DEFAULT 0 0 0 255 ECU_ADDRESS 0x20400B1 READ_WRITE /end MEASUREMENT
/begin MEASUREMENT DEMDiagnosticEventManager.DEMList.DTC_03_03_RF_GetStatus.Task1 "" UBYTE COMP_DEFAULT 0 0 0 255 ECU_ADDRESS 0x20400B2 READ_WRITE /end MEASUREMENT
/begin MEASUREMENT DEMDiagnosticEventManager.DEMList.DTC_04_04_MF_GetStatus.Task1 "" UBYTE COMP_DEFAULT 0 0 0 255 ECU_ADDRESS 0x20400B3 READ_WRITE /end MEASUREMENT
/begin MEASUREMENT DEMDiagnosticEventManager.DEMList.DTC_05_05_AllOn_GetStatus.Task1 "" UBYTE COMP_DEFAULT 0 0 0 255 ECU_ADDRESS 0x20400B4 READ_WRITE /end MEASUREMENT
/begin MEASUREMENT DEMDiagnosticEventManager.DEMList.DTC_06_06_Loff_AllFlash_GetStatus.Task1 "" UBYTE COMP_DEFAULT 0 0 0 255 ECU_ADDRESS 0x20400B5 READ_WRITE /end MEASUREMENT
/begin MEASUREMENT DEMDiagnosticEventManager.DEMList.DTC_01_01_PF.Task1 "" UBYTE COMP_DEFAULT 0 0 0 255 ECU_ADDRESS 0x2048060 READ_WRITE /end MEASUREMENT
/begin MEASUREMENT DEMDiagnosticEventManager.DEMList.DTC_02_02_AF.Task1 "" UBYTE COMP_DEFAULT 0 0 0 255 ECU_ADDRESS 0x2048061 READ_WRITE /end MEASUREMENT
/begin MEASUREMENT DEMDiagnosticEventManager.DEMList.DTC_03_03_RF.Task1 "" UBYTE COMP_DEFAULT 0 0 0 255 ECU_ADDRESS 0x2048062 READ_WRITE /end MEASUREMENT
/begin MEASUREMENT DEMDiagnosticEventManager.DEMList.DTC_04_04_MF.Task1 "" UBYTE COMP_DEFAULT 0 0 0 255 ECU_ADDRESS 0x2048063 READ_WRITE /end MEASUREMENT
/begin MEASUREMENT DEMDiagnosticEventManager.DEMList.DTC_05_05_AllOn.Task1 "" UBYTE COMP_DEFAULT 0 0 0 255 ECU_ADDRESS 0x2048064 READ_WRITE /end MEASUREMENT
/begin MEASUREMENT DEMDiagnosticEventManager.DEMList.DTC_06_06_Loff_AllFlash.Task1 "" UBYTE COMP_DEFAULT 0 0 0 255 ECU_ADDRESS 0x2048065 READ_WRITE /end MEASUREMENT
/begin MEASUREMENT DEMDiagnosticEventManager.DEMList.DTC_1234_22.Task1 "" UBYTE COMP_DEFAULT 0 0 0 255 ECU_ADDRESS 0x2048066 READ_WRITE /end MEASUREMENT
/begin MEASUREMENT DEMDiagnosticEventManager.DEMList.DTC_86868_6.Task1 "" UBYTE COMP_DEFAULT 0 0 0 255 ECU_ADDRESS 0x2048067 READ_WRITE /end MEASUREMENT
/begin MEASUREMENT DtcList.DTCList.f_DTClistSPN.Task1 "" ULONG COMP_DEFAULT 0 0 0 4294967295 ECU_ADDRESS 0x20400B8 READ_WRITE MATRIX_DIM 10 /end MEASUREMENT
/begin MEASUREMENT DtcList.DTCList.f_DTClistNumOfEntries.Task1 "" UWORD COMP_DEFAULT 0 0 0 65535 ECU_ADDRESS 0x20400E0 READ_WRITE /end MEASUREMENT
/begin MEASUREMENT DtcList.DTCList.DTClistType.Task1 "" UBYTE COMP_DEFAULT 0 0 0 1 ECU_ADDRESS 0x20400E2 READ_WRITE MATRIX_DIM 10 /end MEASUREMENT
/begin MEASUREMENT DtcList.DTCList.f_DTClistECUaddress.Task1 "" UBYTE COMP_DEFAULT 0 0 0 255 ECU_ADDRESS 0x20400EC READ_WRITE MATRIX_DIM 10 /end MEASUREMENT
/begin MEASUREMENT DtcList.DTCList.f_DTClistFirstEntry.Task1 "" UBYTE IS_BOOLEAN_TRUE 0 0 0 1 ECU_ADDRESS 0x20400F6 READ_WRITE /end MEASUREMENT
/begin MEASUREMENT DtcList.DTCList.f_DTClistFMI.Task1 "" UBYTE COMP_DEFAULT 0 0 0 255 ECU_ADDRESS 0x20400F7 READ_WRITE MATRIX_DIM 10 /end MEASUREMENT
/begin MEASUREMENT DtcList.DTCList.f_DTClistLastEntry.Task1 "" UBYTE IS_BOOLEAN_TRUE 0 0 0 1 ECU_ADDRESS 0x2040101 READ_WRITE /end MEASUREMENT
/begin MEASUREMENT DtcList.DTCList.f_DTClistOCC.Task1 "" UBYTE COMP_DEFAULT 0 0 0 255 ECU_ADDRESS 0x2040102 READ_WRITE MATRIX_DIM 10 /end MEASUREMENT
/begin MEASUREMENT DtcList.DTCList.f_DTClistPrio.Task1 "" UBYTE COMP_DEFAULT 0 0 0 255 ECU_ADDRESS 0x204010C READ_WRITE MATRIX_DIM 10 /end MEASUREMENT
/begin MEASUREMENT DtcList.DTCList.f_DTClistECUaddrMask.Task1 "" UBYTE COMP_DEFAULT 0 0 0 255 ECU_ADDRESS 0x2048088 READ_WRITE /end MEASUREMENT
/begin MEASUREMENT DtcList.DTCList.f_DTClistEna.Task1 "" UBYTE IS_BOOLEAN_TRUE 0 0 0 1 ECU_ADDRESS 0x2048089 READ_WRITE /end MEASUREMENT
/begin MEASUREMENT DtcList.DTCList.f_DTClistNextEntry.Task1 "" UBYTE IS_BOOLEAN_TRUE 0 0 0 1 ECU_ADDRESS 0x204808A READ_WRITE /end MEASUREMENT
/begin MEASUREMENT DtcList.DTCList.f_DTClistPrevEntry.Task1 "" UBYTE IS_BOOLEAN_TRUE 0 0 0 1 ECU_ADDRESS 0x204808B READ_WRITE /end MEASUREMENT
/begin MEASUREMENT DtcList.DTCList.f_DTClistStatusMask.Task1 "" UBYTE COMP_DEFAULT 0 0 0 255 ECU_ADDRESS 0x204808C READ_WRITE /end MEASUREMENT
/begin MEASUREMENT DtcList.DTCList.SelectCANChannel.Task1 "" UBYTE COMP_DEFAULT 0 0 0 255 ECU_ADDRESS 0x204808D READ_WRITE /end MEASUREMENT
/begin MEASUREMENT DM4RXMainDevice.Spn.Task1 "" ULONG COMP_DEFAULT 0 0 0 4294967295 ECU_ADDRESS 0x2040118 READ_WRITE /end MEASUREMENT
/begin MEASUREMENT DM4RXMainDevice.FaultIndication.Task1 "" UBYTE IS_BOOLEAN_TRUE 0 0 0 1 ECU_ADDRESS 0x204011C READ_WRITE /end MEASUREMENT
/begin MEASUREMENT DM4RXMainDevice.FirstEntry.Task1 "" UBYTE IS_BOOLEAN_TRUE 0 0 0 1 ECU_ADDRESS 0x204011D READ_WRITE /end MEASUREMENT
/begin MEASUREMENT DM4RXMainDevice.Fmi.Task1 "" UBYTE COMP_DEFAULT 0 0 0 255 ECU_ADDRESS 0x204011E READ_WRITE /end MEASUREMENT
/begin MEASUREMENT DM4RXMainDevice.LastEntry.Task1 "" UBYTE IS_BOOLEAN_TRUE 0 0 0 1 ECU_ADDRESS 0x204011F READ_WRITE /end MEASUREMENT
/begin MEASUREMENT DM4RXMainDevice.NumberOfDtcs.Task1 "" UBYTE COMP_DEFAULT 0 0 0 255 ECU_ADDRESS 0x2040120 READ_WRITE /end MEASUREMENT
/begin MEASUREMENT DM4RXMainDevice.OccCount.Task1 "" UBYTE COMP_DEFAULT 0 0 0 255 ECU_ADDRESS 0x2040121 READ_WRITE /end MEASUREMENT
/begin MEASUREMENT DM4RXMainDevice.EcuAddress.Task1 "" UBYTE COMP_DEFAULT 0 0 0 255 ECU_ADDRESS 0x204808E READ_WRITE /end MEASUREMENT
/begin MEASUREMENT DM4RXMainDevice.NextEntry.Task1 "" UBYTE IS_BOOLEAN_TRUE 0 0 0 1 ECU_ADDRESS 0x204808F READ_WRITE /end MEASUREMENT
/begin MEASUREMENT DM4RXMainDevice.PreviousEntry.Task1 "" UBYTE IS_BOOLEAN_TRUE 0 0 0 1 ECU_ADDRESS 0x2048090 READ_WRITE /end MEASUREMENT
/begin MEASUREMENT DM4RXMainDevice.SAEJ1939Format.Task1 "" UBYTE IS_BOOLEAN_TRUE 0 0 0 1 ECU_ADDRESS 0x2048091 READ_WRITE /end MEASUREMENT
/begin MEASUREMENT UDSServices.RejectDiagnosticAccess.Task1 "" UBYTE IS_BOOLEAN_TRUE 0 0 0 1 ECU_ADDRESS 0x2048093 READ_WRITE /end MEASUREMENT
/begin MEASUREMENT UDSServices.RoutineControlService.RoutineCtrl1.RequestRoutineResults.Task1 "3.1.2.2.1.3 RequestRoutineResults" UBYTE IS_BOOLEAN_TRUE 0 0 0 1 ECU_ADDRESS 0x2040124 READ_WRITE /end MEASUREMENT
/begin MEASUREMENT UDSServices.RoutineControlService.RoutineCtrl1.StartRoutine.Task1 "3.1.2.2.1.1 StartRoutine" UBYTE IS_BOOLEAN_TRUE 0 0 0 1 ECU_ADDRESS 0x2040125 READ_WRITE /end MEASUREMENT
/begin MEASUREMENT UDSServices.RoutineControlService.RoutineCtrl1.StopRoutine.Task1 "3.1.2.2.1.2 StopRoutine" UBYTE IS_BOOLEAN_TRUE 0 0 0 1 ECU_ADDRESS 0x2040126 READ_WRITE /end MEASUREMENT
/begin MEASUREMENT UDSServices.RoutineControlService.RoutineCtrl1.u8Response.Task1 "" UBYTE COMP_DEFAULT 0 0 0 255 ECU_ADDRESS 0x2040127 READ_WRITE /end MEASUREMENT
/begin MEASUREMENT UDSServices.RoutineControlService.RoutineCtrl1.ResponseCode.Task1 "3.1.2.2.2.1 ResponseCode" UBYTE COMP_DEFAULT 0 0 0 255 ECU_ADDRESS 0x2048092 READ_WRITE /end MEASUREMENT
/begin MEASUREMENT DCAN.BusOffState.Task1 "" UBYTE IS_BOOLEAN_TRUE 0 0 0 1 ECU_ADDRESS 0x2040144 READ_WRITE /end MEASUREMENT
/begin MEASUREMENT IN_DCAN.RX_Gen.Test1.MessageState.Task1 "3.2.2.1.1 MessageState" UWORD COMP_DEFAULT 0 0 0 65535 ECU_ADDRESS 0x2040128 READ_WRITE /end MEASUREMENT
/begin MEASUREMENT IN_DCAN.RX_Gen.Test1.Val1.Task1 "" UBYTE COMP_DEFAULT 0 0 0 255 ECU_ADDRESS 0x204012A READ_WRITE /end MEASUREMENT
/begin MEASUREMENT OUT_DCAN.RX_Gen.Test1.MessageEnable.Task1 "3.2.2.2.1 MessageEnable" UBYTE IS_BOOLEAN_TRUE 0 0 0 1 ECU_ADDRESS 0x2048094 READ_WRITE /end MEASUREMENT
/begin MEASUREMENT DCAN.TX_Gen.DGenTx_4.MessageState.Task1 "3.3.2.1.1 MessageState" UWORD COMP_DEFAULT 0 0 0 65535 ECU_ADDRESS 0x204012C READ_WRITE /end MEASUREMENT
/begin MEASUREMENT DCAN.TX_Gen.DGenTx_4.Val1.Task1 "" ULONG COMP_DEFAULT 0 0 0 4294967295 ECU_ADDRESS 0x204809C READ_WRITE /end MEASUREMENT
/begin MEASUREMENT DCAN.TX_Gen.DGenTx_4.MessageEnable.Task1 "3.3.2.2.1 MessageEnable" UBYTE IS_BOOLEAN_TRUE 0 0 0 1 ECU_ADDRESS 0x20480A0 READ_WRITE /end MEASUREMENT
/begin MEASUREMENT DCAN.TX_Gen.DGenTX_3.Val1.Task1 "" UWORD COMP_DEFAULT 0 0 0 65535 ECU_ADDRESS 0x20480A4 READ_WRITE /end MEASUREMENT
/begin MEASUREMENT DCAN.TX_Gen.DGenTX_3.Val2.Task1 "" UWORD COMP_DEFAULT 0 0 0 65535 ECU_ADDRESS 0x20480A6 READ_WRITE /end MEASUREMENT
/begin MEASUREMENT DCAN.TX_Gen.DGenTX_3.Val3.Task1 "" UWORD COMP_DEFAULT 0 0 0 65535 ECU_ADDRESS 0x20480A8 READ_WRITE /end MEASUREMENT
/begin MEASUREMENT DCAN.TX_Gen.DGenTX_3.Val4.Task1 "" UWORD COMP_DEFAULT 0 0 0 65535 ECU_ADDRESS 0x20480AA READ_WRITE /end MEASUREMENT
/begin MEASUREMENT DCAN.TX_Gen.DGenTX_3.MessageEnable.Task1 "3.3.2.2.1 MessageEnable" UBYTE IS_BOOLEAN_TRUE 0 0 0 1 ECU_ADDRESS 0x20480AC READ_WRITE /end MEASUREMENT
/begin MEASUREMENT DCAN.TX_Gen.DGenTX_2.Val1.Task1 "" UWORD COMP_DEFAULT 0 0 0 65535 ECU_ADDRESS 0x20480AE READ_WRITE /end MEASUREMENT
/begin MEASUREMENT DCAN.TX_Gen.DGenTX_2.Val2.Task1 "" UWORD COMP_DEFAULT 0 0 0 65535 ECU_ADDRESS 0x20480B0 READ_WRITE /end MEASUREMENT
/begin MEASUREMENT DCAN.TX_Gen.DGenTX_2.Val3.Task1 "" UWORD COMP_DEFAULT 0 0 0 65535 ECU_ADDRESS 0x20480B2 READ_WRITE /end MEASUREMENT
/begin MEASUREMENT DCAN.TX_Gen.DGenTX_2.MessageEnable.Task1 "3.3.2.2.1 MessageEnable" UBYTE IS_BOOLEAN_TRUE 0 0 0 1 ECU_ADDRESS 0x20480B4 READ_WRITE /end MEASUREMENT
/begin MEASUREMENT IN_DCAN.TX_Gen.GenericTxMessage.MessageState.Task1 "3.3.2.1.1 MessageState" UWORD COMP_DEFAULT 0 0 0 65535 ECU_ADDRESS 0x204012E READ_WRITE /end MEASUREMENT
/begin MEASUREMENT OUT_DCAN.TX_Gen.GenericTxMessage.Val5.Task1 "" ULONG COMP_DEFAULT 0 0 0 4294967295 ECU_ADDRESS 0x20480B8 READ_WRITE /end MEASUREMENT
/begin MEASUREMENT DCAN.TX_Gen.GenericTxMessage.CycleTime.Task1 "3.3.2.2.2 CycleTime" UWORD COMP_DEFAULT 0 0 0 65535 ECU_ADDRESS 0x20480BC READ_WRITE /end MEASUREMENT
/begin MEASUREMENT OUT_DCAN.TX_Gen.GenericTxMessage.MessageEnable.Task1 "3.3.2.2.1 MessageEnable" UBYTE IS_BOOLEAN_TRUE 0 0 0 1 ECU_ADDRESS 0x20480BE READ_WRITE /end MEASUREMENT
/begin MEASUREMENT OUT_DCAN.TX_Gen.GenericTxMessage.Val1.Task1 "" UBYTE COMP_DEFAULT 0 0 0 255 ECU_ADDRESS 0x20480BF READ_WRITE /end MEASUREMENT
/begin MEASUREMENT OUT_DCAN.TX_Gen.GenericTxMessage.Val2.Task1 "" UBYTE COMP_DEFAULT 0 0 0 255 ECU_ADDRESS 0x20480C0 READ_WRITE /end MEASUREMENT
/begin MEASUREMENT OUT_DCAN.TX_Gen.GenericTxMessage.Val3.Task1 "" UBYTE COMP_DEFAULT 0 0 0 255 ECU_ADDRESS 0x20480C1 READ_WRITE /end MEASUREMENT
/begin MEASUREMENT OUT_DCAN.TX_Gen.GenericTxMessage.Val4.Task1 "" UBYTE COMP_DEFAULT 0 0 0 255 ECU_ADDRESS 0x20480C2 READ_WRITE /end MEASUREMENT
/begin MEASUREMENT DCAN.TX_Gen.DGenTx_5.ui_Val_02.Task1 "" UWORD COMP_DEFAULT 0 0 0 65535 ECU_ADDRESS 0x2048098 READ_WRITE /end MEASUREMENT
/begin MEASUREMENT DCAN.TX_Gen.DGenTx_5.MessageEnable.Task1 "3.3.2.2.1 MessageEnable" UBYTE IS_BOOLEAN_TRUE 0 0 0 1 ECU_ADDRESS 0x204809A READ_WRITE /end MEASUREMENT
/begin MEASUREMENT DCAN.TX_Gen.DGenTx_5.usi_Val_01.Task1 "" UBYTE COMP_DEFAULT 0 0 0 255 ECU_ADDRESS 0x204809B READ_WRITE /end MEASUREMENT
/begin MEASUREMENT DCAN.GenericDM1TxMessage.DeviceState.Task1 "" UWORD COMP_DEFAULT 0 0 0 65535 ECU_ADDRESS 0x2040130 READ_WRITE /end MEASUREMENT
/begin MEASUREMENT DCAN.GenericDM1TxMessage.DeviceEnable.Task1 "3.1.2.2.1 DeviceEnable" UBYTE IS_BOOLEAN_TRUE 0 0 0 1 ECU_ADDRESS 0x20480C4 READ_WRITE /end MEASUREMENT
/begin MEASUREMENT DCAN.GenericDM2TxMessage.Device_State.Task1 "" UWORD COMP_DEFAULT 0 0 0 65535 ECU_ADDRESS 0x2040132 READ_WRITE /end MEASUREMENT
/begin MEASUREMENT DCAN.GenericDM2TxMessage.Device_Enable.Task1 "" UBYTE IS_BOOLEAN_TRUE 0 0 0 1 ECU_ADDRESS 0x20480C5 READ_WRITE /end MEASUREMENT
/begin MEASUREMENT DCAN.GenericDM3RxMessage.Device_State.Task1 "" UWORD COMP_DEFAULT 0 0 0 65535 ECU_ADDRESS 0x2040134 READ_WRITE /end MEASUREMENT
/begin MEASUREMENT DCAN.GenericDM3RxMessage.Device_Enable.Task1 "" UBYTE IS_BOOLEAN_TRUE 0 0 0 1 ECU_ADDRESS 0x20480C6 READ_WRITE /end MEASUREMENT
/begin MEASUREMENT DCAN.GenericDM11RXMessage.DeviceState.Task1 "" UWORD COMP_DEFAULT 0 0 0 65535 ECU_ADDRESS 0x2040136 READ_WRITE /end MEASUREMENT
/begin MEASUREMENT DCAN.GenericDM11RXMessage.DeviceEnable.Task1 "" UBYTE IS_BOOLEAN_TRUE 0 0 0 1 ECU_ADDRESS 0x20480C7 READ_WRITE /end MEASUREMENT
/begin MEASUREMENT DCAN.GenericDM13RXMessage.DeviceState.Task1 "" UWORD COMP_DEFAULT 0 0 0 65535 ECU_ADDRESS 0x2040138 READ_WRITE /end MEASUREMENT
/begin MEASUREMENT DCAN.GenericDM13RXMessage.CurrentDataLink.Task1 "" UBYTE IS_BOOLEAN_TRUE 0 0 0 1 ECU_ADDRESS 0x204013A READ_WRITE /end MEASUREMENT
/begin MEASUREMENT DCAN.GenericDM13RXMessage.DataChangeIndicator.Task1 "" UBYTE IS_BOOLEAN_TRUE 0 0 0 1 ECU_ADDRESS 0x204013B READ_WRITE /end MEASUREMENT
/begin MEASUREMENT DCAN.GenericDM13RXMessage.ISO9141.Task1 "" UBYTE IS_BOOLEAN_TRUE 0 0 0 1 ECU_ADDRESS 0x204013C READ_WRITE /end MEASUREMENT
/begin MEASUREMENT DCAN.GenericDM13RXMessage.J1587.Task1 "" UBYTE IS_BOOLEAN_TRUE 0 0 0 1 ECU_ADDRESS 0x204013D READ_WRITE /end MEASUREMENT
/begin MEASUREMENT DCAN.GenericDM13RXMessage.J1850.Task1 "" UBYTE IS_BOOLEAN_TRUE 0 0 0 1 ECU_ADDRESS 0x204013E READ_WRITE /end MEASUREMENT
/begin MEASUREMENT DCAN.GenericDM13RXMessage.J1922.Task1 "" UBYTE IS_BOOLEAN_TRUE 0 0 0 1 ECU_ADDRESS 0x204013F READ_WRITE /end MEASUREMENT
/begin MEASUREMENT DCAN.GenericDM13RXMessage.Network1.Task1 "" UBYTE IS_BOOLEAN_TRUE 0 0 0 1 ECU_ADDRESS 0x2040140 READ_WRITE /end MEASUREMENT
/begin MEASUREMENT DCAN.GenericDM13RXMessage.Network2.Task1 "" UBYTE IS_BOOLEAN_TRUE 0 0 0 1 ECU_ADDRESS 0x2040141 READ_WRITE /end MEASUREMENT
/begin MEASUREMENT DCAN.GenericDM13RXMessage.Network3.Task1 "" UBYTE IS_BOOLEAN_TRUE 0 0 0 1 ECU_ADDRESS 0x2040142 READ_WRITE /end MEASUREMENT
/begin MEASUREMENT DCAN.GenericDM13RXMessage.OtherManufacturer.Task1 "" UBYTE IS_BOOLEAN_TRUE 0 0 0 1 ECU_ADDRESS 0x2040143 READ_WRITE /end MEASUREMENT
/begin MEASUREMENT DCAN.GenericDM13RXMessage.DeviceEnable.Task1 "" UBYTE IS_BOOLEAN_TRUE 0 0 0 1 ECU_ADDRESS 0x20480C8 READ_WRITE /end MEASUREMENT
/begin MEASUREMENT DCAN.GenericDM13RXMessage.CurrentDataLink_DIAG.Task1 "Diagnosis Input" UWORD COMP_DEFAULT 0 0 0 65535 ECU_ADDRESS 0x204001E READ_WRITE /end MEASUREMENT
/begin MEASUREMENT DCAN.GenericDM13RXMessage.ISO9141_DIAG.Task1 "Diagnosis Input" UWORD COMP_DEFAULT 0 0 0 65535 ECU_ADDRESS 0x2040020 READ_WRITE /end MEASUREMENT
/begin MEASUREMENT DCAN.GenericDM13RXMessage.J1587_DIAG.Task1 "Diagnosis Input" UWORD COMP_DEFAULT 0 0 0 65535 ECU_ADDRESS 0x2040022 READ_WRITE /end MEASUREMENT
/begin MEASUREMENT DCAN.GenericDM13RXMessage.J1850_DIAG.Task1 "Diagnosis Input" UWORD COMP_DEFAULT 0 0 0 65535 ECU_ADDRESS 0x2040024 READ_WRITE /end MEASUREMENT
/begin MEASUREMENT DCAN.GenericDM13RXMessage.J1922_DIAG.Task1 "Diagnosis Input" UWORD COMP_DEFAULT 0 0 0 65535 ECU_ADDRESS 0x2040026 READ_WRITE /end MEASUREMENT
/begin MEASUREMENT DCAN.GenericDM13RXMessage.Network1_DIAG.Task1 "Diagnosis Input" UWORD COMP_DEFAULT 0 0 0 65535 ECU_ADDRESS 0x2040028 READ_WRITE /end MEASUREMENT
/begin MEASUREMENT DCAN.GenericDM13RXMessage.Network2_DIAG.Task1 "Diagnosis Input" UWORD COMP_DEFAULT 0 0 0 65535 ECU_ADDRESS 0x204002A READ_WRITE /end MEASUREMENT
/begin MEASUREMENT DCAN.GenericDM13RXMessage.Network3_DIAG.Task1 "Diagnosis Input" UWORD COMP_DEFAULT 0 0 0 65535 ECU_ADDRESS 0x204002C READ_WRITE /end MEASUREMENT
/begin MEASUREMENT DCAN.GenericDM13RXMessage.OtherManufacturer_DIAG.Task1 "Diagnosis Input" UWORD COMP_DEFAULT 0 0 0 65535 ECU_ADDRESS 0x204002E READ_WRITE /end MEASUREMENT
/begin MEASUREMENT IN_ACAN.TX_Gen.ACAN_TX_01.MessageState.Task1 "3.3.2.1.1 MessageState" UWORD COMP_DEFAULT 0 0 0 65535 ECU_ADDRESS 0x2040146 READ_WRITE /end MEASUREMENT
/begin MEASUREMENT OUT_ACAN.TX_Gen.ACAN_TX_01.MessageEnable.Task1 "3.3.2.2.1 MessageEnable" UBYTE IS_BOOLEAN_TRUE 0 0 0 1 ECU_ADDRESS 0x20480CC READ_WRITE /end MEASUREMENT
/begin MEASUREMENT OUT_ACAN.TX_Gen.ACAN_TX_01.Val1.Task1 "" UBYTE COMP_DEFAULT 0 0 0 255 ECU_ADDRESS 0x20480CD READ_WRITE /end MEASUREMENT
/begin MEASUREMENT ACAN.GenericGatewayMessage.MessageEnable.Task1 "3.1.2.2.1 MessageEnable" UBYTE IS_BOOLEAN_TRUE 0 0 0 1 ECU_ADDRESS 0x20480CE READ_WRITE /end MEASUREMENT
/begin MEASUREMENT PCAN.BusOffState.Task1 "3.1.2.1.4 BusOffState" UBYTE IS_BOOLEAN_TRUE 0 0 0 1 ECU_ADDRESS 0x204033A READ_WRITE /end MEASUREMENT
/begin MEASUREMENT PCAN.TX_GEN.PGenTX_2.MessageState.Task1 "3.3.2.1.1 MessageState" UWORD COMP_DEFAULT 0 0 0 65535 ECU_ADDRESS 0x2040148 READ_WRITE /end MEASUREMENT
/begin MEASUREMENT PCAN.TX_GEN.PGenTX_2.Val_1.Task1 "" ULONG COMP_DEFAULT 0 0 0 4294967295 ECU_ADDRESS 0x20480D4 READ_WRITE /end MEASUREMENT
/begin MEASUREMENT PCAN.TX_GEN.PGenTX_1.MessageState.Task1 "3.3.2.1.1 MessageState" UWORD COMP_DEFAULT 0 0 0 65535 ECU_ADDRESS 0x204014A READ_WRITE /end MEASUREMENT
/begin MEASUREMENT PCAN.TX_GEN.PGenTX_1.MessageEnable.Task1 "3.3.2.2.1 MessageEnable" UBYTE IS_BOOLEAN_TRUE 0 0 0 1 ECU_ADDRESS 0x20480D8 READ_WRITE /end MEASUREMENT
/begin MEASUREMENT PCAN.TX_GEN.PGenTX_1.Val_1.Task1 "" UBYTE COMP_DEFAULT 0 0 0 255 ECU_ADDRESS 0x20480D9 READ_WRITE /end MEASUREMENT
/begin MEASUREMENT PCAN.TX_GEN.PGenTX_1.Val_2.Task1 "" UBYTE COMP_DEFAULT 0 0 0 255 ECU_ADDRESS 0x20480DA READ_WRITE /end MEASUREMENT
/begin MEASUREMENT PCAN.TX_GEN.PGenTX_3.ui_Val_02.Task1 "" UWORD COMP_DEFAULT 0 0 0 65535 ECU_ADDRESS 0x20480D0 READ_WRITE /end MEASUREMENT
/begin MEASUREMENT PCAN.TX_GEN.PGenTX_3.MessageEnable.Task1 "3.3.2.2.1 MessageEnable" UBYTE IS_BOOLEAN_TRUE 0 0 0 1 ECU_ADDRESS 0x20480D2 READ_WRITE /end MEASUREMENT
/begin MEASUREMENT PCAN.TX_GEN.PGenTX_3.usi_Val_01.Task1 "" UBYTE COMP_DEFAULT 0 0 0 255 ECU_ADDRESS 0x20480D3 READ_WRITE /end MEASUREMENT
/begin MEASUREMENT PCAN.PGNRX.GenericPGRx2.MessageState.Task1 "" UWORD COMP_DEFAULT 0 0 0 65535 ECU_ADDRESS 0x204028A READ_WRITE /end MEASUREMENT
/begin MEASUREMENT PCAN.PGNRX.GenericPGRx2.DataChangeIndicator.Task1 "" UBYTE IS_BOOLEAN_TRUE 0 0 0 1 ECU_ADDRESS 0x204028C READ_WRITE /end MEASUREMENT
/begin MEASUREMENT PCAN.PGNRX.GenericPGRx2.ValArray.Task1 "" UBYTE COMP_DEFAULT 0 0 0 255 ECU_ADDRESS 0x204028D READ_WRITE MATRIX_DIM 50 /end MEASUREMENT
/begin MEASUREMENT PCAN.PGNRX.GenericPGRx2.MessageEnable.Task1 "" UBYTE IS_BOOLEAN_TRUE 0 0 0 1 ECU_ADDRESS 0x20480DD READ_WRITE /end MEASUREMENT
/begin MEASUREMENT PCAN.PGNRX.GenericPGRx4.Val_10.Task1 "" ULONG COMP_DEFAULT 0 0 0 4294967295 ECU_ADDRESS 0x20402C0 READ_WRITE /end MEASUREMENT
/begin MEASUREMENT PCAN.PGNRX.GenericPGRx4.Val_8.Task1 "" ULONG COMP_DEFAULT 0 0 0 4294967295 ECU_ADDRESS 0x20402C4 READ_WRITE /end MEASUREMENT
/begin MEASUREMENT PCAN.PGNRX.GenericPGRx4.Val_9.Task1 "" ULONG COMP_DEFAULT 0 0 0 4294967295 ECU_ADDRESS 0x20402C8 READ_WRITE /end MEASUREMENT
/begin MEASUREMENT PCAN.PGNRX.GenericPGRx4.MessageState.Task1 "" UWORD COMP_DEFAULT 0 0 0 65535 ECU_ADDRESS 0x20402CC READ_WRITE /end MEASUREMENT
/begin MEASUREMENT PCAN.PGNRX.GenericPGRx4.Val_6.Task1 "" UWORD COMP_DEFAULT 0 0 0 65535 ECU_ADDRESS 0x20402CE READ_WRITE /end MEASUREMENT
/begin MEASUREMENT PCAN.PGNRX.GenericPGRx4.Val_7.Task1 "" UWORD COMP_DEFAULT 0 0 0 65535 ECU_ADDRESS 0x20402D0 READ_WRITE /end MEASUREMENT
/begin MEASUREMENT PCAN.PGNRX.GenericPGRx4.DataChangeIndicator.Task1 "" UBYTE IS_BOOLEAN_TRUE 0 0 0 1 ECU_ADDRESS 0x20402D2 READ_WRITE /end MEASUREMENT
/begin MEASUREMENT PCAN.PGNRX.GenericPGRx4.Val_1.Task1 "" UBYTE COMP_DEFAULT 0 0 0 255 ECU_ADDRESS 0x20402D3 READ_WRITE /end MEASUREMENT
/begin MEASUREMENT PCAN.PGNRX.GenericPGRx4.Val_2.Task1 "" UBYTE COMP_DEFAULT 0 0 0 255 ECU_ADDRESS 0x20402D4 READ_WRITE /end MEASUREMENT
/begin MEASUREMENT PCAN.PGNRX.GenericPGRx4.Val_3.Task1 "" UBYTE IS_BOOLEAN_TRUE 0 0 0 1 ECU_ADDRESS 0x20402D5 READ_WRITE /end MEASUREMENT
/begin MEASUREMENT PCAN.PGNRX.GenericPGRx4.Val_4.Task1 "" UBYTE COMP_DEFAULT 0 0 0 255 ECU_ADDRESS 0x20402D6 READ_WRITE /end MEASUREMENT
/begin MEASUREMENT PCAN.PGNRX.GenericPGRx4.Val_5.Task1 "" UBYTE COMP_DEFAULT 0 0 0 255 ECU_ADDRESS 0x20402D7 READ_WRITE /end MEASUREMENT
/begin MEASUREMENT PCAN.PGNRX.GenericPGRx4.MessageEnable.Task1 "" UBYTE IS_BOOLEAN_TRUE 0 0 0 1 ECU_ADDRESS 0x20480DE READ_WRITE /end MEASUREMENT
/begin MEASUREMENT PCAN.PGNRX.GenericPGRx3.MessageState.Task1 "" UWORD COMP_DEFAULT 0 0 0 65535 ECU_ADDRESS 0x20402D8 READ_WRITE /end MEASUREMENT
/begin MEASUREMENT PCAN.PGNRX.GenericPGRx3.DataChangeIndicator.Task1 "" UBYTE IS_BOOLEAN_TRUE 0 0 0 1 ECU_ADDRESS 0x20402DA READ_WRITE /end MEASUREMENT
/begin MEASUREMENT PCAN.PGNRX.GenericPGRx3.ValArray.Task1 "" UBYTE COMP_DEFAULT 0 0 0 255 ECU_ADDRESS 0x20402DB READ_WRITE MATRIX_DIM 50 /end MEASUREMENT
/begin MEASUREMENT PCAN.PGNRX.GenericPGRx3.MessageEnable.Task1 "" UBYTE IS_BOOLEAN_TRUE 0 0 0 1 ECU_ADDRESS 0x20480DF READ_WRITE /end MEASUREMENT
/begin MEASUREMENT PCAN.PGNRX.GenericPGRx1.EcuHwId__FillLevel.Task1 "" UWORD COMP_DEFAULT 0 0 0 65535 ECU_ADDRESS 0x204014C READ_WRITE /end MEASUREMENT
/begin MEASUREMENT PCAN.PGNRX.GenericPGRx1.EcuLocation__FillLevel.Task1 "" UWORD COMP_DEFAULT 0 0 0 65535 ECU_ADDRESS 0x204014E READ_WRITE /end MEASUREMENT
/begin MEASUREMENT PCAN.PGNRX.GenericPGRx1.EcuManuName__FillLevel.Task1 "" UWORD COMP_DEFAULT 0 0 0 65535 ECU_ADDRESS 0x2040150 READ_WRITE /end MEASUREMENT
/begin MEASUREMENT PCAN.PGNRX.GenericPGRx1.EcuPartNumner__FillLevel.Task1 "" UWORD COMP_DEFAULT 0 0 0 65535 ECU_ADDRESS 0x2040152 READ_WRITE /end MEASUREMENT
/begin MEASUREMENT PCAN.PGNRX.GenericPGRx1.EcuSerNumber__FillLevel.Task1 "" UWORD COMP_DEFAULT 0 0 0 65535 ECU_ADDRESS 0x2040154 READ_WRITE /end MEASUREMENT
/begin MEASUREMENT PCAN.PGNRX.GenericPGRx1.MessageState.Task1 "" UWORD COMP_DEFAULT 0 0 0 65535 ECU_ADDRESS 0x2040156 READ_WRITE /end MEASUREMENT
/begin MEASUREMENT PCAN.PGNRX.GenericPGRx1.DataChangeIndicator.Task1 "" UBYTE IS_BOOLEAN_TRUE 0 0 0 1 ECU_ADDRESS 0x2040158 READ_WRITE /end MEASUREMENT
/begin MEASUREMENT PCAN.PGNRX.GenericPGRx1.EcuHwId.Task1 "" UBYTE COMP_DEFAULT 0 0 0 255 ECU_ADDRESS 0x2040159 READ_WRITE MATRIX_DIM 61 /end MEASUREMENT
/begin MEASUREMENT PCAN.PGNRX.GenericPGRx1.EcuLocation.Task1 "" UBYTE COMP_DEFAULT 0 0 0 255 ECU_ADDRESS 0x2040196 READ_WRITE MATRIX_DIM 61 /end MEASUREMENT
/begin MEASUREMENT PCAN.PGNRX.GenericPGRx1.EcuManuName.Task1 "" UBYTE COMP_DEFAULT 0 0 0 255 ECU_ADDRESS 0x20401D3 READ_WRITE MATRIX_DIM 61 /end MEASUREMENT
/begin MEASUREMENT PCAN.PGNRX.GenericPGRx1.EcuPartNumner.Task1 "" UBYTE COMP_DEFAULT 0 0 0 255 ECU_ADDRESS 0x2040210 READ_WRITE MATRIX_DIM 61 /end MEASUREMENT
/begin MEASUREMENT PCAN.PGNRX.GenericPGRx1.EcuSerNumber.Task1 "" UBYTE COMP_DEFAULT 0 0 0 255 ECU_ADDRESS 0x204024D READ_WRITE MATRIX_DIM 61 /end MEASUREMENT
/begin MEASUREMENT PCAN.PGNRX.GenericPGRx1.MessageEnable.Task1 "" UBYTE IS_BOOLEAN_TRUE 0 0 0 1 ECU_ADDRESS 0x20480DC READ_WRITE /end MEASUREMENT
/begin MEASUREMENT PCAN.PGNTX.GenericPGTx1.MessageState.Task1 "" UWORD COMP_DEFAULT 0 0 0 65535 ECU_ADDRESS 0x2040312 READ_WRITE /end MEASUREMENT
/begin MEASUREMENT PCAN.PGNTX.GenericPGTx1.Val_2.Task1 "" ULONG COMP_DEFAULT 0 0 0 4294967295 ECU_ADDRESS 0x204810C READ_WRITE /end MEASUREMENT
/begin MEASUREMENT PCAN.PGNTX.GenericPGTx1.MessageEnable.Task1 "" UBYTE IS_BOOLEAN_TRUE 0 0 0 1 ECU_ADDRESS 0x2048110 READ_WRITE /end MEASUREMENT
/begin MEASUREMENT PCAN.PGNTX.GenericPGTx1.Val_1.Task1 "" UBYTE COMP_DEFAULT 0 0 0 255 ECU_ADDRESS 0x2048111 READ_WRITE /end MEASUREMENT
/begin MEASUREMENT PCAN.PGNTX.GenericPGTx1.Val_3.Task1 "" UBYTE COMP_DEFAULT 0 0 0 255 ECU_ADDRESS 0x2048112 READ_WRITE MATRIX_DIM 50 /end MEASUREMENT
/begin MEASUREMENT PCAN.PGNTX.GenericPGTx2.MessageState.Task1 "" UWORD COMP_DEFAULT 0 0 0 65535 ECU_ADDRESS 0x2040314 READ_WRITE /end MEASUREMENT
/begin MEASUREMENT PCAN.PGNTX.GenericPGTx2.MessageEnable.Task1 "" UBYTE IS_BOOLEAN_TRUE 0 0 0 1 ECU_ADDRESS 0x2048144 READ_WRITE /end MEASUREMENT
/begin MEASUREMENT PCAN.PGNTX.GenericPGTx2.ValArray.Task1 "" UBYTE COMP_DEFAULT 0 0 0 255 ECU_ADDRESS 0x2048145 READ_WRITE MATRIX_DIM 20 /end MEASUREMENT
/begin MEASUREMENT PCAN.PGNTX.GenericPGTx3.MessageState.Task1 "" UWORD COMP_DEFAULT 0 0 0 65535 ECU_ADDRESS 0x2040310 READ_WRITE /end MEASUREMENT
/begin MEASUREMENT PCAN.PGNTX.GenericPGTx3.Val1.Task1 "" ULONG COMP_DEFAULT 0 0 0 4294967295 ECU_ADDRESS 0x20480E0 READ_WRITE /end MEASUREMENT
/begin MEASUREMENT PCAN.PGNTX.GenericPGTx3.Val10.Task1 "" ULONG COMP_DEFAULT 0 0 0 4294967295 ECU_ADDRESS 0x20480E4 READ_WRITE /end MEASUREMENT
/begin MEASUREMENT PCAN.PGNTX.GenericPGTx3.Val2.Task1 "" ULONG COMP_DEFAULT 0 0 0 4294967295 ECU_ADDRESS 0x20480E8 READ_WRITE /end MEASUREMENT
/begin MEASUREMENT PCAN.PGNTX.GenericPGTx3.Val3.Task1 "" ULONG COMP_DEFAULT 0 0 0 4294967295 ECU_ADDRESS 0x20480EC READ_WRITE /end MEASUREMENT
/begin MEASUREMENT PCAN.PGNTX.GenericPGTx3.Val4.Task1 "" ULONG COMP_DEFAULT 0 0 0 4294967295 ECU_ADDRESS 0x20480F0 READ_WRITE /end MEASUREMENT
/begin MEASUREMENT PCAN.PGNTX.GenericPGTx3.Val5.Task1 "" ULONG COMP_DEFAULT 0 0 0 4294967295 ECU_ADDRESS 0x20480F4 READ_WRITE /end MEASUREMENT
/begin MEASUREMENT PCAN.PGNTX.GenericPGTx3.Val6.Task1 "" ULONG COMP_DEFAULT 0 0 0 4294967295 ECU_ADDRESS 0x20480F8 READ_WRITE /end MEASUREMENT
/begin MEASUREMENT PCAN.PGNTX.GenericPGTx3.Val7.Task1 "" ULONG COMP_DEFAULT 0 0 0 4294967295 ECU_ADDRESS 0x20480FC READ_WRITE /end MEASUREMENT
/begin MEASUREMENT PCAN.PGNTX.GenericPGTx3.Val8.Task1 "" ULONG COMP_DEFAULT 0 0 0 4294967295 ECU_ADDRESS 0x2048100 READ_WRITE /end MEASUREMENT
/begin MEASUREMENT PCAN.PGNTX.GenericPGTx3.Val9.Task1 "" ULONG COMP_DEFAULT 0 0 0 4294967295 ECU_ADDRESS 0x2048104 READ_WRITE /end MEASUREMENT
/begin MEASUREMENT PCAN.PGNTX.GenericPGTx3.MessageEnable.Task1 "" UBYTE IS_BOOLEAN_TRUE 0 0 0 1 ECU_ADDRESS 0x2048108 READ_WRITE /end MEASUREMENT
/begin MEASUREMENT PCAN.GenericDM1RxSA00.MessageState.Task1 "3.1.2.1.1 DeviceState" UWORD COMP_DEFAULT 0 0 0 65535 ECU_ADDRESS 0x2040320 READ_WRITE /end MEASUREMENT
/begin MEASUREMENT PCAN.GenericDM1RxSA00.ActiveDTC.Task1 "3.1.2.1.2 ActiveDtc" UBYTE IS_BOOLEAN_TRUE 0 0 0 1 ECU_ADDRESS 0x2040322 READ_WRITE /end MEASUREMENT
/begin MEASUREMENT PCAN.GenericDM1RxSA00.AmberWarningLamp.Task1 "3.1.2.1.5 AmberWarningLamp" UBYTE IS_BOOLEAN_TRUE 0 0 0 1 ECU_ADDRESS 0x2040323 READ_WRITE /end MEASUREMENT
/begin MEASUREMENT PCAN.GenericDM1RxSA00.AmberWarningLampFlash.Task1 "3.1.2.1.5 AmberWarningLamp" UBYTE COMP_DEFAULT 0 0 0 255 ECU_ADDRESS 0x2040324 READ_WRITE /end MEASUREMENT
/begin MEASUREMENT PCAN.GenericDM1RxSA00.ProtectLamp.Task1 "3.1.2.1.6 ProtectLamp" UBYTE IS_BOOLEAN_TRUE 0 0 0 1 ECU_ADDRESS 0x2040325 READ_WRITE /end MEASUREMENT
/begin MEASUREMENT PCAN.GenericDM1RxSA00.RedStopLamp.Task1 "3.1.2.1.4 RedStopLamp" UBYTE IS_BOOLEAN_TRUE 0 0 0 1 ECU_ADDRESS 0x2040326 READ_WRITE /end MEASUREMENT
/begin MEASUREMENT PCAN.GenericDM1RxSA00.UndefinedActiveDtc.Task1 "3.2.2.1.1 UndefinedActiveDtc" UBYTE IS_BOOLEAN_TRUE 0 0 0 1 ECU_ADDRESS 0x2040327 READ_WRITE /end MEASUREMENT
/begin MEASUREMENT PCAN.GenericDM1RxSA00.MessageEnable.Task1 "3.1.2.2.1 DeviceEnable" UBYTE IS_BOOLEAN_TRUE 0 0 0 1 ECU_ADDRESS 0x204815C READ_WRITE /end MEASUREMENT
/begin MEASUREMENT PCAN.GenericDM1RxSA00.AmberWarningLampFlash_DIAG.Task1 "Diagnosis Input" UWORD COMP_DEFAULT 0 0 0 65535 ECU_ADDRESS 0x2040030 READ_WRITE /end MEASUREMENT
/begin MEASUREMENT GenericDM1RxSA19.GenericDTCFilter.SPN_3_3.Task1 "" UBYTE IS_BOOLEAN_TRUE 0 0 0 1 ECU_ADDRESS 0x2040318 READ_WRITE /end MEASUREMENT
/begin MEASUREMENT GenericDM1RxSA19.GenericDTCFilter.SPN_4_4.Task1 "" UBYTE IS_BOOLEAN_TRUE 0 0 0 1 ECU_ADDRESS 0x2040319 READ_WRITE /end MEASUREMENT
/begin MEASUREMENT GenericDM1RxSA19.GenericDTCFilter.SPN_5_5.Task1 "" UBYTE IS_BOOLEAN_TRUE 0 0 0 1 ECU_ADDRESS 0x204031A READ_WRITE /end MEASUREMENT
/begin MEASUREMENT GenericDM1RxSA19.GenericDTCFilter.SPN_6_6.Task1 "" UBYTE IS_BOOLEAN_TRUE 0 0 0 1 ECU_ADDRESS 0x204031B READ_WRITE /end MEASUREMENT
/begin MEASUREMENT GenericDM1RxSA32.GenericDTCFilter.SPN_7_7.Task1 "" UBYTE IS_BOOLEAN_TRUE 0 0 0 1 ECU_ADDRESS 0x204031C READ_WRITE /end MEASUREMENT
/begin MEASUREMENT GenericDM1RxSA32.GenericDTCFilter.SPN_7_7__Priority.Task1 "" UBYTE COMP_DEFAULT 0 0 0 255 ECU_ADDRESS 0x204031D READ_WRITE /end MEASUREMENT
/begin MEASUREMENT GenericDM1RxSA32.GenericDTCFilter.SPN_8_8.Task1 "" UBYTE IS_BOOLEAN_TRUE 0 0 0 1 ECU_ADDRESS 0x204031E READ_WRITE /end MEASUREMENT
/begin MEASUREMENT GenericDM1RxSA32.GenericDTCFilter.SPN_8_8__Priority.Task1 "" UBYTE COMP_DEFAULT 0 0 0 255 ECU_ADDRESS 0x204031F READ_WRITE /end MEASUREMENT
/begin MEASUREMENT GenericDM1RxSA00.GenericDTCFilter.SPN_1_1.Task1 "" UBYTE IS_BOOLEAN_TRUE 0 0 0 1 ECU_ADDRESS 0x2040316 READ_WRITE /end MEASUREMENT
/begin MEASUREMENT GenericDM1RxSA00.GenericDTCFilter.SPN_2_2.Task1 "" UBYTE IS_BOOLEAN_TRUE 0 0 0 1 ECU_ADDRESS 0x2040317 READ_WRITE /end MEASUREMENT
/begin MEASUREMENT PCAN.GenericDM1RxSA19.MessageState.Task1 "3.1.2.1.1 DeviceState" UWORD COMP_DEFAULT 0 0 0 65535 ECU_ADDRESS 0x2040328 READ_WRITE /end MEASUREMENT
/begin MEASUREMENT PCAN.GenericDM1RxSA19.ActiveDTC.Task1 "3.1.2.1.2 ActiveDtc" UBYTE IS_BOOLEAN_TRUE 0 0 0 1 ECU_ADDRESS 0x204032A READ_WRITE /end MEASUREMENT
/begin MEASUREMENT PCAN.GenericDM1RxSA19.AmberWarningLamp.Task1 "3.1.2.1.5 AmberWarningLamp" UBYTE IS_BOOLEAN_TRUE 0 0 0 1 ECU_ADDRESS 0x204032B READ_WRITE /end MEASUREMENT
/begin MEASUREMENT PCAN.GenericDM1RxSA19.AmberWarningLampFlash.Task1 "3.1.2.1.5 AmberWarningLamp" UBYTE COMP_DEFAULT 0 0 0 255 ECU_ADDRESS 0x204032C READ_WRITE /end MEASUREMENT
/begin MEASUREMENT PCAN.GenericDM1RxSA19.ProtectLamp.Task1 "3.1.2.1.6 ProtectLamp" UBYTE IS_BOOLEAN_TRUE 0 0 0 1 ECU_ADDRESS 0x204032D READ_WRITE /end MEASUREMENT
/begin MEASUREMENT PCAN.GenericDM1RxSA19.RedStopLamp.Task1 "3.1.2.1.4 RedStopLamp" UBYTE IS_BOOLEAN_TRUE 0 0 0 1 ECU_ADDRESS 0x204032E READ_WRITE /end MEASUREMENT
/begin MEASUREMENT PCAN.GenericDM1RxSA19.UndefinedActiveDtc.Task1 "3.2.2.1.1 UndefinedActiveDtc" UBYTE IS_BOOLEAN_TRUE 0 0 0 1 ECU_ADDRESS 0x204032F READ_WRITE /end MEASUREMENT
/begin MEASUREMENT PCAN.GenericDM1RxSA19.MessageEnable.Task1 "3.1.2.2.1 DeviceEnable" UBYTE IS_BOOLEAN_TRUE 0 0 0 1 ECU_ADDRESS 0x204815D READ_WRITE /end MEASUREMENT
/begin MEASUREMENT PCAN.GenericDM1RxSA19.AmberWarningLampFlash_DIAG.Task1 "Diagnosis Input" UWORD COMP_DEFAULT 0 0 0 65535 ECU_ADDRESS 0x2040032 READ_WRITE /end MEASUREMENT
/begin MEASUREMENT PCAN.GenericDM1RxSA32.MessageState.Task1 "3.1.2.1.1 DeviceState" UWORD COMP_DEFAULT 0 0 0 65535 ECU_ADDRESS 0x2040330 READ_WRITE /end MEASUREMENT
/begin MEASUREMENT PCAN.GenericDM1RxSA32.ActiveDTC.Task1 "3.1.2.1.2 ActiveDtc" UBYTE IS_BOOLEAN_TRUE 0 0 0 1 ECU_ADDRESS 0x2040332 READ_WRITE /end MEASUREMENT
/begin MEASUREMENT PCAN.GenericDM1RxSA32.MalfunctionIndicatorLamp.Task1 "3.1.2.1.3 MalfunctionIndicatorLamp" UBYTE IS_BOOLEAN_TRUE 0 0 0 1 ECU_ADDRESS 0x2040333 READ_WRITE /end MEASUREMENT
/begin MEASUREMENT PCAN.GenericDM1RxSA32.MalfunctionIndicatorLampFlash.Task1 "3.1.2.1.3 MalfunctionIndicatorLamp" UBYTE COMP_DEFAULT 0 0 0 255 ECU_ADDRESS 0x2040334 READ_WRITE /end MEASUREMENT
/begin MEASUREMENT PCAN.GenericDM1RxSA32.UndefinedActiveDtc.Task1 "3.2.2.1.1 UndefinedActiveDtc" UBYTE IS_BOOLEAN_TRUE 0 0 0 1 ECU_ADDRESS 0x2040335 READ_WRITE /end MEASUREMENT
/begin MEASUREMENT PCAN.GenericDM1RxSA32.MessageEnable.Task1 "3.1.2.2.1 DeviceEnable" UBYTE IS_BOOLEAN_TRUE 0 0 0 1 ECU_ADDRESS 0x204815E READ_WRITE /end MEASUREMENT
/begin MEASUREMENT PCAN.GenericDM1RxSA32.SwitchDtcMode.Task1 "" UBYTE COMP_DEFAULT 0 0 0 255 ECU_ADDRESS 0x204815F READ_WRITE /end MEASUREMENT
/begin MEASUREMENT PCAN.GenericDM1RxSA32.SwitchRecMode.Task1 "" UBYTE COMP_DEFAULT 0 0 0 255 ECU_ADDRESS 0x2048160 READ_WRITE /end MEASUREMENT
/begin MEASUREMENT PCAN.GenericDM1TxMessage.DeviceState.Task1 "" UWORD COMP_DEFAULT 0 0 0 65535 ECU_ADDRESS 0x2040336 READ_WRITE /end MEASUREMENT
/begin MEASUREMENT PCAN.GenericDM1TxMessage.DeviceEnable.Task1 "3.1.2.2.1 DeviceEnable" UBYTE IS_BOOLEAN_TRUE 0 0 0 1 ECU_ADDRESS 0x2048161 READ_WRITE /end MEASUREMENT
/begin MEASUREMENT PCAN.GenericDM4REQ.DeviceState.Task1 "" UWORD COMP_DEFAULT 0 0 0 65535 ECU_ADDRESS 0x2040338 READ_WRITE /end MEASUREMENT
/begin MEASUREMENT PCAN.GenericDM4REQ.DeviceEnable.Task1 "" UBYTE IS_BOOLEAN_TRUE 0 0 0 1 ECU_ADDRESS 0x2048162 READ_WRITE /end MEASUREMENT
/begin MEASUREMENT PCAN.GenericDM4REQ.RequestDM4.Task1 "" UBYTE IS_BOOLEAN_TRUE 0 0 0 1 ECU_ADDRESS 0x2048163 READ_WRITE /end MEASUREMENT
/begin MEASUREMENT IN_ICAN.IGenRx.I_Test1.MessageState.Task1 "" UWORD COMP_DEFAULT 0 0 0 65535 ECU_ADDRESS 0x204033C READ_WRITE /end MEASUREMENT
/begin MEASUREMENT IN_ICAN.IGenRx.I_Test1.Val_1.Task1 "" UBYTE COMP_DEFAULT 0 0 0 255 ECU_ADDRESS 0x204033E READ_WRITE /end MEASUREMENT
/begin MEASUREMENT OUT_ICAN.IGenRx.I_Test1.MessageEnable.Task1 "" UBYTE IS_BOOLEAN_TRUE 0 0 0 1 ECU_ADDRESS 0x2048164 READ_WRITE /end MEASUREMENT
/begin MEASUREMENT OUT_ICAN.IGenTx.I_Tes1.MessageEnable.Task1 "" UBYTE IS_BOOLEAN_TRUE 0 0 0 1 ECU_ADDRESS 0x2048165 READ_WRITE /end MEASUREMENT
/begin MEASUREMENT OUT_ICAN.IGenTx.I_Tes1.Val_1.Task1 "" UBYTE COMP_DEFAULT 0 0 0 255 ECU_ADDRESS 0x2048166 READ_WRITE /end MEASUREMENT
/begin MEASUREMENT ICAN.IPGNRX.PGRxMessage_1.Val_1.Task1 "" ULONG COMP_DEFAULT 0 0 0 4294967295 ECU_ADDRESS 0x2040340 READ_WRITE /end MEASUREMENT
/begin MEASUREMENT ICAN.IPGNRX.PGRxMessage_1.Val_2.Task1 "" ULONG COMP_DEFAULT 0 0 0 4294967295 ECU_ADDRESS 0x2040344 READ_WRITE /end MEASUREMENT
/begin MEASUREMENT ICAN.IPGNRX.PGRxMessage_1.Message_State.Task1 "" UWORD COMP_DEFAULT 0 0 0 65535 ECU_ADDRESS 0x2040348 READ_WRITE /end MEASUREMENT
/begin MEASUREMENT ICAN.IPGNRX.PGRxMessage_1.DataChangeIndicator.Task1 "" UBYTE IS_BOOLEAN_TRUE 0 0 0 1 ECU_ADDRESS 0x204034A READ_WRITE /end MEASUREMENT
/begin MEASUREMENT ICAN.IPGNRX.PGRxMessage_1.Message_Enable.Task1 "" UBYTE IS_BOOLEAN_TRUE 0 0 0 1 ECU_ADDRESS 0x2048167 READ_WRITE /end MEASUREMENT
/begin MEASUREMENT ICAN.ICANDM1RxSA19.MessageState.Task1 "3.1.2.1.1 DeviceState" UWORD COMP_DEFAULT 0 0 0 65535 ECU_ADDRESS 0x2040350 READ_WRITE /end MEASUREMENT
/begin MEASUREMENT ICAN.ICANDM1RxSA19.ActiveDTC.Task1 "3.1.2.1.2 ActiveDtc" UBYTE IS_BOOLEAN_TRUE 0 0 0 1 ECU_ADDRESS 0x2040352 READ_WRITE /end MEASUREMENT
/begin MEASUREMENT ICAN.ICANDM1RxSA19.AmberWarningLamp.Task1 "3.1.2.1.5 AmberWarningLamp" UBYTE IS_BOOLEAN_TRUE 0 0 0 1 ECU_ADDRESS 0x2040353 READ_WRITE /end MEASUREMENT
/begin MEASUREMENT ICAN.ICANDM1RxSA19.AmberWarningLampFlash.Task1 "3.1.2.1.5 AmberWarningLamp" UBYTE COMP_DEFAULT 0 0 0 255 ECU_ADDRESS 0x2040354 READ_WRITE /end MEASUREMENT
/begin MEASUREMENT ICAN.ICANDM1RxSA19.UndefinedActiveDtc.Task1 "3.2.2.1.1 UndefinedActiveDtc" UBYTE IS_BOOLEAN_TRUE 0 0 0 1 ECU_ADDRESS 0x2040355 READ_WRITE /end MEASUREMENT
/begin MEASUREMENT ICAN.ICANDM1RxSA19.MessageEnable.Task1 "3.1.2.2.1 DeviceEnable" UBYTE IS_BOOLEAN_TRUE 0 0 0 1 ECU_ADDRESS 0x2048168 READ_WRITE /end MEASUREMENT
/begin MEASUREMENT ICAN.ICANDM1RxSA19.AmberWarningLamp_DIAG.Task1 "Diagnosis Input" UWORD COMP_DEFAULT 0 0 0 65535 ECU_ADDRESS 0x2040034 READ_WRITE /end MEASUREMENT
/begin MEASUREMENT ICAN.ICANDM1RxSA19.AmberWarningLampFlash_DIAG.Task1 "Diagnosis Input" UWORD COMP_DEFAULT 0 0 0 65535 ECU_ADDRESS 0x2040036 READ_WRITE /end MEASUREMENT
/begin MEASUREMENT ICANDM1RxSA19.GenericDTCFilter.SPN_1_FMI_1.Task1 "" UBYTE IS_BOOLEAN_TRUE 0 0 0 1 ECU_ADDRESS 0x204034C READ_WRITE /end MEASUREMENT
/begin MEASUREMENT ICANDM1RxSA19.GenericDTCFilter.SPN_5_FMI_10.Task1 "" UBYTE IS_BOOLEAN_TRUE 0 0 0 1 ECU_ADDRESS 0x204034D READ_WRITE /end MEASUREMENT
/begin MEASUREMENT ICANDM1RxSA19.GenericDTCFilter.SPN_6_FMI_1.Task1 "" UBYTE IS_BOOLEAN_TRUE 0 0 0 1 ECU_ADDRESS 0x204034E READ_WRITE /end MEASUREMENT
/begin MEASUREMENT ICAN.ICANDM1RxSAF1.MessageState.Task1 "3.1.2.1.1 DeviceState" UWORD COMP_DEFAULT 0 0 0 65535 ECU_ADDRESS 0x2040356 READ_WRITE /end MEASUREMENT
/begin MEASUREMENT ICAN.ICANDM1RxSAF1.ActiveDTC.Task1 "3.1.2.1.2 ActiveDtc" UBYTE IS_BOOLEAN_TRUE 0 0 0 1 ECU_ADDRESS 0x2040358 READ_WRITE /end MEASUREMENT
/begin MEASUREMENT ICAN.ICANDM1RxSAF1.AmberWarningLamp.Task1 "3.1.2.1.5 AmberWarningLamp" UBYTE IS_BOOLEAN_TRUE 0 0 0 1 ECU_ADDRESS 0x2040359 READ_WRITE /end MEASUREMENT
/begin MEASUREMENT ICAN.ICANDM1RxSAF1.AmberWarningLampFlash.Task1 "3.1.2.1.5 AmberWarningLamp" UBYTE COMP_DEFAULT 0 0 0 255 ECU_ADDRESS 0x204035A READ_WRITE /end MEASUREMENT
/begin MEASUREMENT ICAN.ICANDM1RxSAF1.MalfunctionIndicatorLamp.Task1 "3.1.2.1.3 MalfunctionIndicatorLamp" UBYTE IS_BOOLEAN_TRUE 0 0 0 1 ECU_ADDRESS 0x204035B READ_WRITE /end MEASUREMENT
/begin MEASUREMENT ICAN.ICANDM1RxSAF1.MalfunctionIndicatorLampFlash.Task1 "3.1.2.1.3 MalfunctionIndicatorLamp" UBYTE COMP_DEFAULT 0 0 0 255 ECU_ADDRESS 0x204035C READ_WRITE /end MEASUREMENT
/begin MEASUREMENT ICAN.ICANDM1RxSAF1.ProtectLamp.Task1 "3.1.2.1.6 ProtectLamp" UBYTE IS_BOOLEAN_TRUE 0 0 0 1 ECU_ADDRESS 0x204035D READ_WRITE /end MEASUREMENT
/begin MEASUREMENT ICAN.ICANDM1RxSAF1.ProtectLampFlash.Task1 "3.1.2.1.6 ProtectLamp" UBYTE COMP_DEFAULT 0 0 0 255 ECU_ADDRESS 0x204035E READ_WRITE /end MEASUREMENT
/begin MEASUREMENT ICAN.ICANDM1RxSAF1.RedStopLamp.Task1 "3.1.2.1.4 RedStopLamp" UBYTE IS_BOOLEAN_TRUE 0 0 0 1 ECU_ADDRESS 0x204035F READ_WRITE /end MEASUREMENT
/begin MEASUREMENT ICAN.ICANDM1RxSAF1.RedStopLampFlash.Task1 "3.1.2.1.4 RedStopLamp" UBYTE COMP_DEFAULT 0 0 0 255 ECU_ADDRESS 0x2040360 READ_WRITE /end MEASUREMENT
/begin MEASUREMENT ICAN.ICANDM1RxSAF1.UndefinedActiveDtc.Task1 "3.2.2.1.1 UndefinedActiveDtc" UBYTE IS_BOOLEAN_TRUE 0 0 0 1 ECU_ADDRESS 0x2040361 READ_WRITE /end MEASUREMENT
/begin MEASUREMENT ICAN.ICANDM1RxSAF1.MessageEnable.Task1 "3.1.2.2.1 DeviceEnable" UBYTE IS_BOOLEAN_TRUE 0 0 0 1 ECU_ADDRESS 0x2048169 READ_WRITE /end MEASUREMENT
/begin MEASUREMENT ICAN.ICANDM1RxSAF1.AmberWarningLamp_DIAG.Task1 "Diagnosis Input" UWORD COMP_DEFAULT 0 0 0 65535 ECU_ADDRESS 0x2040038 READ_WRITE /end MEASUREMENT
/begin MEASUREMENT ICAN.ICANDM1RxSAF1.AmberWarningLampFlash_DIAG.Task1 "Diagnosis Input" UWORD COMP_DEFAULT 0 0 0 65535 ECU_ADDRESS 0x204003A READ_WRITE /end MEASUREMENT
/begin MEASUREMENT ICAN.ICANDM1RxSAF1.MalfunctionIndicatorLamp_DIAG.Task1 "Diagnosis Input" UWORD COMP_DEFAULT 0 0 0 65535 ECU_ADDRESS 0x204003C READ_WRITE /end MEASUREMENT
/begin MEASUREMENT ICAN.ICANDM1RxSAF1.MalfunctionIndicatorLampFlash_DIAG.Task1 "Diagnosis Input" UWORD COMP_DEFAULT 0 0 0 65535 ECU_ADDRESS 0x204003E READ_WRITE /end MEASUREMENT
/begin MEASUREMENT ICAN.ICANDM1RxSAF1.ProtectLamp_DIAG.Task1 "Diagnosis Input" UWORD COMP_DEFAULT 0 0 0 65535 ECU_ADDRESS 0x2040040 READ_WRITE /end MEASUREMENT
/begin MEASUREMENT ICAN.ICANDM1RxSAF1.ProtectLampFlash_DIAG.Task1 "Diagnosis Input" UWORD COMP_DEFAULT 0 0 0 65535 ECU_ADDRESS 0x2040042 READ_WRITE /end MEASUREMENT
/begin MEASUREMENT ICAN.ICANDM1RxSAF1.RedStopLamp_DIAG.Task1 "Diagnosis Input" UWORD COMP_DEFAULT 0 0 0 65535 ECU_ADDRESS 0x2040044 READ_WRITE /end MEASUREMENT
/begin MEASUREMENT ICAN.ICANDM1RxSAF1.RedStopLampFlash_DIAG.Task1 "Diagnosis Input" UWORD COMP_DEFAULT 0 0 0 65535 ECU_ADDRESS 0x2040046 READ_WRITE /end MEASUREMENT
/begin MEASUREMENT FMSCAN.BusActivityState.Task1 "3.1.2.1.5 BusActivityState" UBYTE IS_BOOLEAN_TRUE 0 0 0 1 ECU_ADDRESS 0x204036E READ_WRITE /end MEASUREMENT
/begin MEASUREMENT FMSCAN.TX_GEN.FMSGenTX_1.MessageState.Task1 "3.3.2.1.1 MessageState" UWORD COMP_DEFAULT 0 0 0 65535 ECU_ADDRESS 0x2040364 READ_WRITE /end MEASUREMENT
/begin MEASUREMENT FMSCAN.TX_GEN.FMSGenTX_1.MessageEnable.Task1 "3.3.2.2.1 MessageEnable" UBYTE IS_BOOLEAN_TRUE 0 0 0 1 ECU_ADDRESS 0x204816A READ_WRITE /end MEASUREMENT
/begin MEASUREMENT FMSCAN.TX_GEN.FMSGenTX_1.Val_1.Task1 "" UBYTE COMP_DEFAULT 0 0 0 255 ECU_ADDRESS 0x204816B READ_WRITE /end MEASUREMENT
/begin MEASUREMENT FMSCAN.GenericDM1RxSA11.MessageState.Task1 "3.1.2.1.1 DeviceState" UWORD COMP_DEFAULT 0 0 0 65535 ECU_ADDRESS 0x2040366 READ_WRITE /end MEASUREMENT
/begin MEASUREMENT FMSCAN.GenericDM1RxSA11.ActiveDTC.Task1 "3.1.2.1.2 ActiveDtc" UBYTE IS_BOOLEAN_TRUE 0 0 0 1 ECU_ADDRESS 0x2040368 READ_WRITE /end MEASUREMENT
/begin MEASUREMENT FMSCAN.GenericDM1RxSA11.AmberWarningLamp.Task1 "3.1.2.1.5 AmberWarningLamp" UBYTE IS_BOOLEAN_TRUE 0 0 0 1 ECU_ADDRESS 0x2040369 READ_WRITE /end MEASUREMENT
/begin MEASUREMENT FMSCAN.GenericDM1RxSA11.AmberWarningLampFlash.Task1 "3.1.2.1.5 AmberWarningLamp" UBYTE COMP_DEFAULT 0 0 0 255 ECU_ADDRESS 0x204036A READ_WRITE /end MEASUREMENT
/begin MEASUREMENT FMSCAN.GenericDM1RxSA11.UndefinedActiveDtc.Task1 "3.2.2.1.1 UndefinedActiveDtc" UBYTE IS_BOOLEAN_TRUE 0 0 0 1 ECU_ADDRESS 0x204036B READ_WRITE /end MEASUREMENT
/begin MEASUREMENT FMSCAN.GenericDM1RxSA11.MessageEnable.Task1 "3.1.2.2.1 DeviceEnable" UBYTE IS_BOOLEAN_TRUE 0 0 0 1 ECU_ADDRESS 0x204816C READ_WRITE /end MEASUREMENT
/begin MEASUREMENT FMSCAN.GenericDM1TxMessage.DeviceState.Task1 "" UWORD COMP_DEFAULT 0 0 0 65535 ECU_ADDRESS 0x204036C READ_WRITE /end MEASUREMENT
/begin MEASUREMENT FMSCAN.GenericDM1TxMessage.DeviceEnable.Task1 "3.1.2.2.1 DeviceEnable" UBYTE IS_BOOLEAN_TRUE 0 0 0 1 ECU_ADDRESS 0x204816D READ_WRITE /end MEASUREMENT
/begin MEASUREMENT DRCAN.TX_GEN.DRGenTX_1.MessageState.Task1 "3.3.2.1.1 MessageState" UWORD COMP_DEFAULT 0 0 0 65535 ECU_ADDRESS 0x2040370 READ_WRITE /end MEASUREMENT
/begin MEASUREMENT DRCAN.TX_GEN.DRGenTX_1.MessageEnable.Task1 "3.3.2.2.1 MessageEnable" UBYTE IS_BOOLEAN_TRUE 0 0 0 1 ECU_ADDRESS 0x204816E READ_WRITE /end MEASUREMENT
/begin MEASUREMENT DRCAN.TX_GEN.DRGenTX_1.Val_1.Task1 "" UBYTE COMP_DEFAULT 0 0 0 255 ECU_ADDRESS 0x204816F READ_WRITE /end MEASUREMENT
/begin MEASUREMENT HCAN.TX_GEN.HGenTX_1.MessageState.Task1 "3.3.2.1.1 MessageState" UWORD COMP_DEFAULT 0 0 0 65535 ECU_ADDRESS 0x2040372 READ_WRITE /end MEASUREMENT
/begin MEASUREMENT HCAN.TX_GEN.HGenTX_1.MessageEnable.Task1 "3.3.2.2.1 MessageEnable" UBYTE IS_BOOLEAN_TRUE 0 0 0 1 ECU_ADDRESS 0x2048170 READ_WRITE /end MEASUREMENT
/begin MEASUREMENT HCAN.TX_GEN.HGenTX_1.Val_1.Task1 "" UBYTE COMP_DEFAULT 0 0 0 255 ECU_ADDRESS 0x2048171 READ_WRITE /end MEASUREMENT
/begin MEASUREMENT HCAN.TX_GEN.HGenTX_1.Val_2.Task1 "" UBYTE COMP_DEFAULT 0 0 0 255 ECU_ADDRESS 0x2048172 READ_WRITE /end MEASUREMENT
/begin MEASUREMENT STIMD.CanValue.Task1 "" SLONG COMP_DEFAULT 0 0 -2147483648 2147483647 ECU_ADDRESS 0x2040374 READ_WRITE /end MEASUREMENT
/begin MEASUREMENT STIMD.EEprom_Value.Task1 "" ULONG COMP_DEFAULT 0 0 0 4294967295 ECU_ADDRESS 0x2040378 READ_WRITE /end MEASUREMENT
/begin MEASUREMENT STIMD.TypeReal.Task1 "" FLOAT32_IEEE COMP_DEFAULT 0 0 -3.4E+38 3.4E+38 ECU_ADDRESS 0x204037C READ_WRITE /end MEASUREMENT
/begin MEASUREMENT STIMD.TypeTest.Task1 "" SLONG COMP_DEFAULT 0 0 -2147483648 2147483647 ECU_ADDRESS 0x2040380 READ_WRITE /end MEASUREMENT
/begin MEASUREMENT STIMD.DTC_activation.Task1 "" UWORD COMP_DEFAULT 0 0 0 65535 ECU_ADDRESS 0x2040384 READ_WRITE /end MEASUREMENT
/begin MEASUREMENT STIMD.GenTxCycleTime.Task1 "" UWORD COMP_DEFAULT 0 0 0 65535 ECU_ADDRESS 0x2040386 READ_WRITE /end MEASUREMENT
/begin MEASUREMENT STIMD.Accel_Enable.Task1 "" UBYTE IS_BOOLEAN_TRUE 0 0 0 1 ECU_ADDRESS 0x2040388 READ_WRITE /end MEASUREMENT
/begin MEASUREMENT STIMD.Alarm_boSetAlarm.Task1 "" UBYTE IS_BOOLEAN_TRUE 0 0 0 1 ECU_ADDRESS 0x2040389 READ_WRITE /end MEASUREMENT
/begin MEASUREMENT STIMD.Alarm_usiMinutes.Task1 "" UBYTE COMP_DEFAULT 0 0 0 255 ECU_ADDRESS 0x204038A READ_WRITE /end MEASUREMENT
/begin MEASUREMENT STIMD.Alarm_usiSeconds.Task1 "" UBYTE COMP_DEFAULT 0 0 0 255 ECU_ADDRESS 0x204038B READ_WRITE /end MEASUREMENT
/begin MEASUREMENT STIMD.D_DM1TX.Task1 "" UBYTE IS_BOOLEAN_TRUE 0 0 0 1 ECU_ADDRESS 0x204038C READ_WRITE /end MEASUREMENT
/begin MEASUREMENT STIMD.DM11_enable.Task1 "" UBYTE IS_BOOLEAN_TRUE 0 0 0 1 ECU_ADDRESS 0x204038D READ_WRITE /end MEASUREMENT
/begin MEASUREMENT STIMD.DM13_enable.Task1 "" UBYTE IS_BOOLEAN_TRUE 0 0 0 1 ECU_ADDRESS 0x204038E READ_WRITE /end MEASUREMENT
/begin MEASUREMENT STIMD.DM1RX_enable.Task1 "" UBYTE IS_BOOLEAN_TRUE 0 0 0 1 ECU_ADDRESS 0x204038F READ_WRITE /end MEASUREMENT
/begin MEASUREMENT STIMD.DM1RX_SwitchDtcMode.Task1 "" UBYTE COMP_DEFAULT 0 0 0 255 ECU_ADDRESS 0x2040390 READ_WRITE /end MEASUREMENT
/begin MEASUREMENT STIMD.DM1RX_SwitchRecMode.Task1 "" UBYTE COMP_DEFAULT 0 0 0 255 ECU_ADDRESS 0x2040391 READ_WRITE /end MEASUREMENT
/begin MEASUREMENT STIMD.DM2_enable.Task1 "" UBYTE IS_BOOLEAN_TRUE 0 0 0 1 ECU_ADDRESS 0x2040392 READ_WRITE /end MEASUREMENT
/begin MEASUREMENT STIMD.DM3_enable.Task1 "" UBYTE IS_BOOLEAN_TRUE 0 0 0 1 ECU_ADDRESS 0x2040393 READ_WRITE /end MEASUREMENT
/begin MEASUREMENT STIMD.DM4RX_Device_Enable.Task1 "" UBYTE IS_BOOLEAN_TRUE 0 0 0 1 ECU_ADDRESS 0x2040394 READ_WRITE /end MEASUREMENT
/begin MEASUREMENT STIMD.DM4RX_EcuAddress.Task1 "" UBYTE COMP_DEFAULT 0 0 0 255 ECU_ADDRESS 0x2040395 READ_WRITE /end MEASUREMENT
/begin MEASUREMENT STIMD.DM4RX_Next.Task1 "" UBYTE IS_BOOLEAN_TRUE 0 0 0 1 ECU_ADDRESS 0x2040396 READ_WRITE /end MEASUREMENT
/begin MEASUREMENT STIMD.DM4RX_Previous.Task1 "" UBYTE IS_BOOLEAN_TRUE 0 0 0 1 ECU_ADDRESS 0x2040397 READ_WRITE /end MEASUREMENT
/begin MEASUREMENT STIMD.DM4RX_RequestDm4.Task1 "" UBYTE IS_BOOLEAN_TRUE 0 0 0 1 ECU_ADDRESS 0x2040398 READ_WRITE /end MEASUREMENT
/begin MEASUREMENT STIMD.DM4RX_SaeFormat.Task1 "" UBYTE IS_BOOLEAN_TRUE 0 0 0 1 ECU_ADDRESS 0x2040399 READ_WRITE /end MEASUREMENT
/begin MEASUREMENT STIMD.DTC_enable.Task1 "" UBYTE IS_BOOLEAN_TRUE 0 0 0 1 ECU_ADDRESS 0x204039A READ_WRITE /end MEASUREMENT
/begin MEASUREMENT STIMD.DTC_EnableCon00.Task1 "" UBYTE IS_BOOLEAN_TRUE 0 0 0 1 ECU_ADDRESS 0x204039B READ_WRITE /end MEASUREMENT
/begin MEASUREMENT STIMD.DTC_StorageCon00.Task1 "" UBYTE IS_BOOLEAN_TRUE 0 0 0 1 ECU_ADDRESS 0x204039C READ_WRITE /end MEASUREMENT
/begin MEASUREMENT STIMD.EEprom_Enable.Task1 "" UBYTE IS_BOOLEAN_TRUE 0 0 0 1 ECU_ADDRESS 0x204039D READ_WRITE /end MEASUREMENT
/begin MEASUREMENT STIMD.EEprom_Trigger.Task1 "" UBYTE IS_BOOLEAN_TRUE 0 0 0 1 ECU_ADDRESS 0x204039E READ_WRITE /end MEASUREMENT
/begin MEASUREMENT STIMD.F_DM1TX.Task1 "" UBYTE IS_BOOLEAN_TRUE 0 0 0 1 ECU_ADDRESS 0x204039F READ_WRITE /end MEASUREMENT
/begin MEASUREMENT STIMD.FmsCanEnable.Task1 "" UBYTE IS_BOOLEAN_TRUE 0 0 0 1 ECU_ADDRESS 0x20403A0 READ_WRITE /end MEASUREMENT
/begin MEASUREMENT STIMD.ListDtcEcuAddrMask.Task1 "" UBYTE COMP_DEFAULT 0 0 0 255 ECU_ADDRESS 0x20403A1 READ_WRITE /end MEASUREMENT
/begin MEASUREMENT STIMD.ListDtcEnable.Task1 "" UBYTE IS_BOOLEAN_TRUE 0 0 0 1 ECU_ADDRESS 0x20403A2 READ_WRITE /end MEASUREMENT
/begin MEASUREMENT STIMD.ListDtcNextEntry.Task1 "" UBYTE IS_BOOLEAN_TRUE 0 0 0 1 ECU_ADDRESS 0x20403A3 READ_WRITE /end MEASUREMENT
/begin MEASUREMENT STIMD.ListDtcPrevEntry.Task1 "" UBYTE IS_BOOLEAN_TRUE 0 0 0 1 ECU_ADDRESS 0x20403A4 READ_WRITE /end MEASUREMENT
/begin MEASUREMENT STIMD.ListDtcSelectCanChannel.Task1 "" UBYTE COMP_DEFAULT 0 0 0 255 ECU_ADDRESS 0x20403A5 READ_WRITE /end MEASUREMENT
/begin MEASUREMENT STIMD.ListDtcStatusMask.Task1 "" UBYTE COMP_DEFAULT 0 0 0 255 ECU_ADDRESS 0x20403A6 READ_WRITE /end MEASUREMENT
/begin MEASUREMENT STIMD.OUT_enable.Task1 "" UBYTE IS_BOOLEAN_TRUE 0 0 0 1 ECU_ADDRESS 0x20403A7 READ_WRITE /end MEASUREMENT
/begin MEASUREMENT STIMD.OUT_TdActivation.Task1 "" UBYTE IS_BOOLEAN_TRUE 0 0 0 1 ECU_ADDRESS 0x20403A8 READ_WRITE /end MEASUREMENT
/begin MEASUREMENT STIMD.OUT_value.Task1 "" UBYTE COMP_DEFAULT 0 0 0 255 ECU_ADDRESS 0x20403A9 READ_WRITE /end MEASUREMENT
/begin MEASUREMENT STIMD.P_DM1TX.Task1 "" UBYTE IS_BOOLEAN_TRUE 0 0 0 1 ECU_ADDRESS 0x20403AA READ_WRITE /end MEASUREMENT
/begin MEASUREMENT STIMD.PCanEnable.Task1 "" UBYTE IS_BOOLEAN_TRUE 0 0 0 1 ECU_ADDRESS 0x20403AB READ_WRITE /end MEASUREMENT
/begin MEASUREMENT STIMD.TimeDateSet.Task1 "" UBYTE IS_BOOLEAN_TRUE 0 0 0 1 ECU_ADDRESS 0x20403AC READ_WRITE /end MEASUREMENT
/begin MEASUREMENT STIMD.TimeSourceSelect.Task1 "" UBYTE IS_BOOLEAN_TRUE 0 0 0 1 ECU_ADDRESS 0x20403AD READ_WRITE /end MEASUREMENT
/begin MEASUREMENT STIMD.TSU_enable.Task1 "" UBYTE IS_BOOLEAN_TRUE 0 0 0 1 ECU_ADDRESS 0x20403AE READ_WRITE /end MEASUREMENT
/begin MEASUREMENT STIMD.TSU_Source.Task1 "" UBYTE IS_BOOLEAN_TRUE 0 0 0 1 ECU_ADDRESS 0x20403AF READ_WRITE /end MEASUREMENT
/begin MEASUREMENT TSUD.TotalDistance.Task1 "" ULONG COMP_DEFAULT 0 0 0 4294967295 ECU_ADDRESS 0x20403B0 READ_WRITE /end MEASUREMENT
/begin MEASUREMENT TSUD.TripADistance.Task1 "" ULONG COMP_DEFAULT 0 0 0 4294967295 ECU_ADDRESS 0x20403B4 READ_WRITE /end MEASUREMENT
/begin MEASUREMENT TSUD.TripBDistance.Task1 "" ULONG COMP_DEFAULT 0 0 0 4294967295 ECU_ADDRESS 0x20403B8 READ_WRITE /end MEASUREMENT
/begin MEASUREMENT TSUD.DeviceState.Task1 "" UWORD COMP_DEFAULT 0 0 0 65535 ECU_ADDRESS 0x20403BC READ_WRITE /end MEASUREMENT
/begin MEASUREMENT TSUD.PulseNumber.Task1 "" UWORD COMP_DEFAULT 0 0 0 65535 ECU_ADDRESS 0x20403BE READ_WRITE /end MEASUREMENT
/begin MEASUREMENT TSUD.ShaftSpeed.Task1 "" UWORD COMP_DEFAULT 0 0 0 65535 ECU_ADDRESS 0x20403C0 READ_WRITE /end MEASUREMENT
/begin MEASUREMENT TSUD.VehicleSpeed.Task1 "" UWORD COMP_DEFAULT 0 0 0 65535 ECU_ADDRESS 0x20403C2 READ_WRITE /end MEASUREMENT
/begin MEASUREMENT TSUD.DrivingState.Task1 "" UBYTE IS_BOOLEAN_TRUE 0 0 0 1 ECU_ADDRESS 0x20403C4 READ_WRITE /end MEASUREMENT
/begin MEASUREMENT TSUD.GetDiagWriteOdometer.Task1 "" UBYTE IS_BOOLEAN_TRUE 0 0 0 1 ECU_ADDRESS 0x20403C5 READ_WRITE /end MEASUREMENT
/begin MEASUREMENT TSUD.KFactor.Task1 "" ULONG COMP_DEFAULT 0 0 0 4294967295 ECU_ADDRESS 0x2048174 READ_WRITE /end MEASUREMENT
/begin MEASUREMENT TSUD.DeviceEnable.Task1 "" UBYTE IS_BOOLEAN_TRUE 0 0 0 1 ECU_ADDRESS 0x2048178 READ_WRITE /end MEASUREMENT
/begin MEASUREMENT TSUD.SetDiagWriteOdoResponse.Task1 "" UBYTE COMP_DEFAULT 0 0 0 255 ECU_ADDRESS 0x2048179 READ_WRITE /end MEASUREMENT
/begin MEASUREMENT TSUD.SourceOfCalculation.Task1 "" UBYTE COMP_DEFAULT 0 0 0 255 ECU_ADDRESS 0x204817A READ_WRITE /end MEASUREMENT
/begin MEASUREMENT TSUD.TripAReset.Task1 "" UBYTE IS_BOOLEAN_TRUE 0 0 0 1 ECU_ADDRESS 0x204817B READ_WRITE /end MEASUREMENT
/begin MEASUREMENT TSUD.TripBReset.Task1 "" UBYTE IS_BOOLEAN_TRUE 0 0 0 1 ECU_ADDRESS 0x204817C READ_WRITE /end MEASUREMENT
/begin MEASUREMENT TSUD.KFactor_DIAG.Task1 "Diagnostic Input" UWORD COMP_DEFAULT 0 0 0 65535 ECU_ADDRESS 0x2040048 READ_WRITE /end MEASUREMENT
/begin MEASUREMENT TSUD.SetDiagWriteOdoResponse_DIAG.Task1 "Diagnostic Input" UWORD COMP_DEFAULT 0 0 0 65535 ECU_ADDRESS 0x204004A READ_WRITE /end MEASUREMENT
/begin MEASUREMENT TSUD.ShaftSpeed_DIAG.Task1 "Diagnostic Input" UWORD COMP_DEFAULT 0 0 0 65535 ECU_ADDRESS 0x204004C READ_WRITE /end MEASUREMENT
/begin MEASUREMENT TSUD.SourceOfCalculation_DIAG.Task1 "Diagnostic Input" UWORD COMP_DEFAULT 0 0 0 65535 ECU_ADDRESS 0x204004E READ_WRITE /end MEASUREMENT
/begin MEASUREMENT TSUD.TotalDistance_DIAG.Task1 "Diagnostic Input" UWORD COMP_DEFAULT 0 0 0 65535 ECU_ADDRESS 0x2040050 READ_WRITE /end MEASUREMENT
/begin MEASUREMENT TSUD.TripADistance_DIAG.Task1 "Diagnostic Input" UWORD COMP_DEFAULT 0 0 0 65535 ECU_ADDRESS 0x2040052 READ_WRITE /end MEASUREMENT
/begin MEASUREMENT TSUD.TripBDistance_DIAG.Task1 "Diagnostic Input" UWORD COMP_DEFAULT 0 0 0 65535 ECU_ADDRESS 0x2040054 READ_WRITE /end MEASUREMENT
/begin MEASUREMENT TSUD.VehicleSpeed_DIAG.Task1 "Diagnostic Input" UWORD COMP_DEFAULT 0 0 0 65535 ECU_ADDRESS 0x2040056 READ_WRITE /end MEASUREMENT
/begin MEASUREMENT InertianSensorDevice.AccelerometerSubdevice.Ax.Task1 "" SWORD COMP_DEFAULT 0 0 -32768 32767 ECU_ADDRESS 0x20403C8 READ_WRITE /end MEASUREMENT
/begin MEASUREMENT InertianSensorDevice.AccelerometerSubdevice.Ay.Task1 "" SWORD COMP_DEFAULT 0 0 -32768 32767 ECU_ADDRESS 0x20403CA READ_WRITE /end MEASUREMENT
/begin MEASUREMENT InertianSensorDevice.AccelerometerSubdevice.Az.Task1 "" SWORD COMP_DEFAULT 0 0 -32768 32767 ECU_ADDRESS 0x20403CC READ_WRITE /end MEASUREMENT
/begin MEASUREMENT InertianSensorDevice.AccelerometerSubdevice.DeviceState.Task1 "" UWORD COMP_DEFAULT 0 0 0 65535 ECU_ADDRESS 0x20403CE READ_WRITE /end MEASUREMENT
/begin MEASUREMENT InertianSensorDevice.AccelerometerSubdevice.DeviceEnable.Task1 "" UBYTE IS_BOOLEAN_TRUE 0 0 0 1 ECU_ADDRESS 0x2048180 READ_WRITE /end MEASUREMENT
/begin CHARACTERISTIC Variable_00 "Variable_00:  " VALUE 0x8910 LC_A_UINT8 0 COMP_DEFAULT 0 255 /end CHARACTERISTIC
/begin CHARACTERISTIC Variable_01 "Variable_01:  " VALUE 0x8912 LC_A_UINT16 0 COMP_DEFAULT 0 65535 /end CHARACTERISTIC
/begin CHARACTERISTIC Variable_02 "Variable_02:  " VALUE 0x8914 LC_A_UINT16 0 COMP_DEFAULT 0 65535 /end CHARACTERISTIC
/begin GROUP SYSTEM.Alarm_Devices.Alarm "Alarm"
 /begin ANNOTATION ANNOTATION_LABEL "Instance" ANNOTATION_ORIGIN "Group" /begin ANNOTATION_TEXT "0" /end ANNOTATION_TEXT /end ANNOTATION
 /begin ANNOTATION ANNOTATION_LABEL "TaskCycleTime" ANNOTATION_ORIGIN "Group" /begin ANNOTATION_TEXT "0" /end ANNOTATION_TEXT /end ANNOTATION
 /begin ANNOTATION ANNOTATION_LABEL "TimeResolution" ANNOTATION_ORIGIN "Group" /begin ANNOTATION_TEXT "0" /end ANNOTATION_TEXT /end ANNOTATION
 /begin REF_MEASUREMENT AlarmDevices.Alarm.CurrentAlarmTime.Task1 AlarmDevices.Alarm.AlarmElapsed.Task1 AlarmDevices.Alarm.NewAlarmTime.Task1 AlarmDevices.Alarm.SetAlarm.Task1 AlarmDevices.Alarm.CurrentAlarmTime_DIAG.Task1 AlarmDevices.Alarm.SetAlarm_DIAG.Task1 /end REF_MEASUREMENT
/end GROUP
/begin GROUP SYSTEM.Alarm_Devices "Alarm Devices"
 /begin ANNOTATION ANNOTATION_LABEL "Instance" ANNOTATION_ORIGIN "Group" /begin ANNOTATION_TEXT "0" /end ANNOTATION_TEXT /end ANNOTATION
 /begin ANNOTATION ANNOTATION_LABEL "TaskCycleTime" ANNOTATION_ORIGIN "Group" /begin ANNOTATION_TEXT "0" /end ANNOTATION_TEXT /end ANNOTATION
 /begin ANNOTATION ANNOTATION_LABEL "TimeResolution" ANNOTATION_ORIGIN "Group" /begin ANNOTATION_TEXT "0" /end ANNOTATION_TEXT /end ANNOTATION
 /begin SUB_GROUP SYSTEM.Alarm_Devices.Alarm /end SUB_GROUP
/end GROUP
/begin GROUP SYSTEM.Date_and_Time "Date and Time"
 /begin ANNOTATION ANNOTATION_LABEL "Instance" ANNOTATION_ORIGIN "Group" /begin ANNOTATION_TEXT "0" /end ANNOTATION_TEXT /end ANNOTATION
 /begin ANNOTATION ANNOTATION_LABEL "TaskCycleTime" ANNOTATION_ORIGIN "Group" /begin ANNOTATION_TEXT "0" /end ANNOTATION_TEXT /end ANNOTATION
 /begin ANNOTATION ANNOTATION_LABEL "TimeResolution" ANNOTATION_ORIGIN "Group" /begin ANNOTATION_TEXT "0" /end ANNOTATION_TEXT /end ANNOTATION
 /begin REF_MEASUREMENT DateandTime.LocalTime.Task1 DateandTime.SystemTime.Task1 DateandTime.TicksCount.Task1 DateandTime.NewSystemTime.Task1 DateandTime.HourOffset.Task1 DateandTime.MinuteOffset.Task1 DateandTime.SetTime.Task1 DateandTime.LocalTime_DIAG.Task1 DateandTime.SetTime_DIAG.Task1 DateandTime.SystemTime_DIAG.Task1 /end REF_MEASUREMENT
/end GROUP
/begin GROUP SYSTEM.Model_Control "Model Control"
 /begin ANNOTATION ANNOTATION_LABEL "Instance" ANNOTATION_ORIGIN "Group" /begin ANNOTATION_TEXT "0" /end ANNOTATION_TEXT /end ANNOTATION
 /begin ANNOTATION ANNOTATION_LABEL "TaskCycleTime" ANNOTATION_ORIGIN "Group" /begin ANNOTATION_TEXT "0" /end ANNOTATION_TEXT /end ANNOTATION
 /begin ANNOTATION ANNOTATION_LABEL "TimeResolution" ANNOTATION_ORIGIN "Group" /begin ANNOTATION_TEXT "0" /end ANNOTATION_TEXT /end ANNOTATION
 /begin REF_MEASUREMENT OUT_ModelControl.ModelHold.Task1 /end REF_MEASUREMENT
/end GROUP
/begin GROUP SYSTEM.Digital_Inputs "Digital Inputs"
 /begin ANNOTATION ANNOTATION_LABEL "Instance" ANNOTATION_ORIGIN "Group" /begin ANNOTATION_TEXT "0" /end ANNOTATION_TEXT /end ANNOTATION
 /begin ANNOTATION ANNOTATION_LABEL "TaskCycleTime" ANNOTATION_ORIGIN "Group" /begin ANNOTATION_TEXT "0" /end ANNOTATION_TEXT /end ANNOTATION
 /begin ANNOTATION ANNOTATION_LABEL "TimeResolution" ANNOTATION_ORIGIN "Group" /begin ANNOTATION_TEXT "0" /end ANNOTATION_TEXT /end ANNOTATION
 /begin REF_MEASUREMENT DigitalInputs.IN_DIG_03.Task1 DigitalInputs.IN_DIG_04.Task1 DigitalInputs.IN_DIG_05.Task1 DigitalInputs.IN_DIG_06.Task1 DigitalInputs.IN_DIG_07.Task1 DigitalInputs.IN_DIG_08.Task1 DigitalInputs.IN_DIG_09.Task1 DigitalInputs.IN_DIG_11.Task1 DigitalInputs.IN_DIG_12.Task1 DigitalInputs.IN_DIG_13.Task1 DigitalInputs.IN_DIG_14.Task1 DigitalInputs.IN_DIG_15.Task1 DigitalInputs.IN_DIG_16.Task1 DigitalInputs.IN_DIG_18.Task1 DigitalInputs.IN_DIG_19.Task1 DigitalInputs.IN_DIG_20.Task1 DigitalInputs.IN_DIG_21.Task1 DigitalInputs.IN_DIG_22.Task1 DigitalInputs.IN_DIG_23.Task1 DigitalInputs.IN_DIG_24.Task1 DigitalInputs.IN_DIG_25.Task1 DigitalInputs.IN_DIG_27.Task1 DigitalInputs.IN_DIG_28.Task1 DigitalInputs.IN_DIG_29.Task1 DigitalInputs.IN_DIG_30.Task1 DigitalInputs.IN_DIG_31.Task1 DigitalInputs.IN_DIG_32.Task1 DigitalInputs.IN_DIG_33.Task1 DigitalInputs.IN_DIG_34.Task1 DigitalInputs.IN_DIG_37.Task1 DigitalInputs.IN_DIG_38.Task1 DigitalInputs.IN_DIG_39.Task1 DigitalInputs.IN_DIG_41.Task1 DigitalInputs.IN_DIG_42.Task1 DigitalInputs.IN_DIG_43.Task1 DigitalInputs.IN_DIG_44.Task1 DigitalInputs.IN_DIG_45.Task1 DigitalInputs.IN_DIG_46.Task1 DigitalInputs.IN_DIG_48.Task1 DigitalInputs.IN_DIG_49.Task1 DigitalInputs.IN_DIG_50.Task1 IN_DIG_02_DriverDoor.Task1 IN_DIG_10_CabinLight.Task1 IN_DIG_17_Cabin_Lock.Task1 IN_DIG_26_HazardSwitch.Task1 IN_DIG_35_PassengerDoor.Task1 IN_DIG_36_KL15.Task1 IN_DIG_40_KL58.Task1 IN_DigitalInputs.IN_DIG_01.Task1 IN_DigitalInputs.IN_DIG_01.Task2 IN_DigitalInputs.IN_DIG_01.Task3 IN_DigitalInputs.IN_DIG_01.Task4 IN_DigitalInputs.IN_DIG_01.Task5 IN_DigitalInputs.IN_DIG_01.Task6 /end REF_MEASUREMENT
/end GROUP
/begin GROUP SYSTEM.Digital_Outputs__STATIC_ "Digital Outputs (STATIC)"
 /begin ANNOTATION ANNOTATION_LABEL "Instance" ANNOTATION_ORIGIN "Group" /begin ANNOTATION_TEXT "0" /end ANNOTATION_TEXT /end ANNOTATION
 /begin ANNOTATION ANNOTATION_LABEL "TaskCycleTime" ANNOTATION_ORIGIN "Group" /begin ANNOTATION_TEXT "0" /end ANNOTATION_TEXT /end ANNOTATION
 /begin ANNOTATION ANNOTATION_LABEL "TimeResolution" ANNOTATION_ORIGIN "Group" /begin ANNOTATION_TEXT "0" /end ANNOTATION_TEXT /end ANNOTATION
 /begin REF_MEASUREMENT DigitalOutputsSTATIC.OUT_01_TD.Task1 DigitalOutputsSTATIC.OUT_04_TD.Task1 DigitalOutputsSTATIC.OUT_01_TD_START.Task1 DigitalOutputsSTATIC.OUT_04.Task1 DigitalOutputsSTATIC.OUT_04_TD_START.Task1 OUT_DigitalOutputsSTATIC.OUT_01.Task1 DIAG_DigitalOutputsSTATIC.OUT_01_DIAG.Task1 DigitalOutputsSTATIC.OUT_01_TD_DIAG.Task1 DigitalOutputsSTATIC.OUT_04_DIAG.Task1 DigitalOutputsSTATIC.OUT_04_TD_DIAG.Task1 /end REF_MEASUREMENT
/end GROUP
/begin GROUP SYSTEM.Digital_Output__PWM_ "Digital Output (PWM)"
 /begin ANNOTATION ANNOTATION_LABEL "Instance" ANNOTATION_ORIGIN "Group" /begin ANNOTATION_TEXT "0" /end ANNOTATION_TEXT /end ANNOTATION
 /begin ANNOTATION ANNOTATION_LABEL "TaskCycleTime" ANNOTATION_ORIGIN "Group" /begin ANNOTATION_TEXT "0" /end ANNOTATION_TEXT /end ANNOTATION
 /begin ANNOTATION ANNOTATION_LABEL "TimeResolution" ANNOTATION_ORIGIN "Group" /begin ANNOTATION_TEXT "0" /end ANNOTATION_TEXT /end ANNOTATION
 /begin REF_MEASUREMENT DigitalOutputPWM.OUT_20_TD.Task1 DigitalOutputPWM.OUT_20_PWM.Task1 DigitalOutputPWM.OUT_20_TD_START.Task1 DigitalOutputPWM.OUT_20_PWM_DIAG.Task1 DigitalOutputPWM.OUT_20_TD_DIAG.Task1 /end REF_MEASUREMENT
/end GROUP
/begin GROUP SYSTEM.NVM_Model_Related_Data._0x00004020__NVM_Variables2_ "0x00004020 (NVM Variables2)"
 /begin ANNOTATION ANNOTATION_LABEL "Instance" ANNOTATION_ORIGIN "Group" /begin ANNOTATION_TEXT "1" /end ANNOTATION_TEXT /end ANNOTATION
 /begin ANNOTATION ANNOTATION_LABEL "TaskCycleTime" ANNOTATION_ORIGIN "Group" /begin ANNOTATION_TEXT "0" /end ANNOTATION_TEXT /end ANNOTATION
 /begin ANNOTATION ANNOTATION_LABEL "TimeResolution" ANNOTATION_ORIGIN "Group" /begin ANNOTATION_TEXT "0" /end ANNOTATION_TEXT /end ANNOTATION
 /begin REF_MEASUREMENT NVMModelRelatedData.NVMVariables2.DeviceState.Task1 NVMVariables2.Var1.Task1 NVMVariables2.Var2.Task1 NVMModelRelatedData.NVMVariables2.StoreVariablesToNVM.Task1 /end REF_MEASUREMENT
/end GROUP
/begin GROUP SYSTEM.NVM_Model_Related_Data._0x00004040__NVM_Variables3_ "0x00004040 (NVM Variables3)"
 /begin ANNOTATION ANNOTATION_LABEL "Instance" ANNOTATION_ORIGIN "Group" /begin ANNOTATION_TEXT "2" /end ANNOTATION_TEXT /end ANNOTATION
 /begin ANNOTATION ANNOTATION_LABEL "TaskCycleTime" ANNOTATION_ORIGIN "Group" /begin ANNOTATION_TEXT "0" /end ANNOTATION_TEXT /end ANNOTATION
 /begin ANNOTATION ANNOTATION_LABEL "TimeResolution" ANNOTATION_ORIGIN "Group" /begin ANNOTATION_TEXT "0" /end ANNOTATION_TEXT /end ANNOTATION
 /begin REF_MEASUREMENT NVMModelRelatedData.NVMVariables3.DeviceState.Task1 NVMModelRelatedData.NVMVariables3.Val_4.Task1 NVMModelRelatedData.NVMVariables3.Val_3.Task1 NVMModelRelatedData.NVMVariables3.Val_1.Task1 NVMModelRelatedData.NVMVariables3.Val_2.Task1 NVMModelRelatedData.NVMVariables3.Val_5.Task1 /end REF_MEASUREMENT
/end GROUP
/begin GROUP SYSTEM.NVM_Model_Related_Data._0x00004060__NVM_Variables4_ "0x00004060 (NVM Variables4)"
 /begin ANNOTATION ANNOTATION_LABEL "Instance" ANNOTATION_ORIGIN "Group" /begin ANNOTATION_TEXT "3" /end ANNOTATION_TEXT /end ANNOTATION
 /begin ANNOTATION ANNOTATION_LABEL "TaskCycleTime" ANNOTATION_ORIGIN "Group" /begin ANNOTATION_TEXT "0" /end ANNOTATION_TEXT /end ANNOTATION
 /begin ANNOTATION ANNOTATION_LABEL "TimeResolution" ANNOTATION_ORIGIN "Group" /begin ANNOTATION_TEXT "0" /end ANNOTATION_TEXT /end ANNOTATION
 /begin REF_MEASUREMENT NVMVariables4.DeviceState.Task1 NVMVariables4.Var4_DINT.Task1 NVMVariables4.Var4_INT.Task1 NVMVariables4.Var4_SINT.Task1 /end REF_MEASUREMENT
/end GROUP
/begin GROUP SYSTEM.NVM_Model_Related_Data._0x00004000__NVM_Variables_ "0x00004000 (NVM Variables)"
 /begin ANNOTATION ANNOTATION_LABEL "Instance" ANNOTATION_ORIGIN "Group" /begin ANNOTATION_TEXT "0" /end ANNOTATION_TEXT /end ANNOTATION
 /begin ANNOTATION ANNOTATION_LABEL "TaskCycleTime" ANNOTATION_ORIGIN "Group" /begin ANNOTATION_TEXT "0" /end ANNOTATION_TEXT /end ANNOTATION
 /begin ANNOTATION ANNOTATION_LABEL "TimeResolution" ANNOTATION_ORIGIN "Group" /begin ANNOTATION_TEXT "0" /end ANNOTATION_TEXT /end ANNOTATION
 /begin REF_MEASUREMENT NVMModelRelatedData.NVMVariables.DeviceState.Task1 NVMModelRelatedData.NVMVariables.Variable_u16.Task1 NVMModelRelatedData.NVMVariables.Variable_bo.Task1 /end REF_MEASUREMENT
/end GROUP
/begin GROUP SYSTEM.NVM_Model_Related_Data._0x0000A000__NVM_Parameter_ "0x0000A000 (NVM Parameter)"
 /begin ANNOTATION ANNOTATION_LABEL "Instance" ANNOTATION_ORIGIN "Group" /begin ANNOTATION_TEXT "0" /end ANNOTATION_TEXT /end ANNOTATION
 /begin ANNOTATION ANNOTATION_LABEL "TaskCycleTime" ANNOTATION_ORIGIN "Group" /begin ANNOTATION_TEXT "0" /end ANNOTATION_TEXT /end ANNOTATION
 /begin ANNOTATION ANNOTATION_LABEL "TimeResolution" ANNOTATION_ORIGIN "Group" /begin ANNOTATION_TEXT "0" /end ANNOTATION_TEXT /end ANNOTATION
 /begin REF_MEASUREMENT NVMModelRelatedData.NVMParameter.DeviceState.Task1 NVMModelRelatedData.NVMParameter.Variable_01.Task1 NVMModelRelatedData.NVMParameter.Variable_02.Task1 NVMModelRelatedData.NVMParameter.Variable_00.Task1 /end REF_MEASUREMENT
/end GROUP
/begin GROUP SYSTEM.NVM_Model_Related_Data "NVM Model Related Data"
 /begin ANNOTATION ANNOTATION_LABEL "Instance" ANNOTATION_ORIGIN "Group" /begin ANNOTATION_TEXT "0" /end ANNOTATION_TEXT /end ANNOTATION
 /begin ANNOTATION ANNOTATION_LABEL "TaskCycleTime" ANNOTATION_ORIGIN "Group" /begin ANNOTATION_TEXT "0" /end ANNOTATION_TEXT /end ANNOTATION
 /begin ANNOTATION ANNOTATION_LABEL "TimeResolution" ANNOTATION_ORIGIN "Group" /begin ANNOTATION_TEXT "0" /end ANNOTATION_TEXT /end ANNOTATION
 /begin SUB_GROUP SYSTEM.NVM_Model_Related_Data._0x00004020__NVM_Variables2_ SYSTEM.NVM_Model_Related_Data._0x00004040__NVM_Variables3_ SYSTEM.NVM_Model_Related_Data._0x00004060__NVM_Variables4_ SYSTEM.NVM_Model_Related_Data._0x00004000__NVM_Variables_ SYSTEM.NVM_Model_Related_Data._0x0000A000__NVM_Parameter_ /end SUB_GROUP
/end GROUP
/begin GROUP SYSTEM.RAM_Device "RAM Device"
 /begin ANNOTATION ANNOTATION_LABEL "Instance" ANNOTATION_ORIGIN "Group" /begin ANNOTATION_TEXT "0" /end ANNOTATION_TEXT /end ANNOTATION
 /begin ANNOTATION ANNOTATION_LABEL "TaskCycleTime" ANNOTATION_ORIGIN "Group" /begin ANNOTATION_TEXT "0" /end ANNOTATION_TEXT /end ANNOTATION
 /begin ANNOTATION ANNOTATION_LABEL "TimeResolution" ANNOTATION_ORIGIN "Group" /begin ANNOTATION_TEXT "0" /end ANNOTATION_TEXT /end ANNOTATION
 /begin REF_MEASUREMENT RAMDevice.EEprom_Value.Task1 RAMDevice.EEprom_Var3_Val4.Task1 RAMDevice.RAMDevice_udint.Task1 RAMDevice.TypeDINT.Task1 RAMDevice.TypeREAL.Task1 RAMDevice.DT_Year.Task1 RAMDevice.RAMDevice_uint.Task1 RAMDevice.TypeINT.Task1 RAMDevice.DM4RX_BusOff_GeneralError.Task1 RAMDevice.DT_Day.Task1 RAMDevice.DT_Hours.Task1 RAMDevice.DT_Minutes.Task1 RAMDevice.DT_Month.Task1 RAMDevice.DT_Seconds.Task1 RAMDevice.RAMDevice_usint.Task1 RAMDevice.RoutineCtrl_Response.Task1 RAMDevice.TypeSINT.Task1 /end REF_MEASUREMENT
/end GROUP
/begin GROUP SYSTEM.DEM_Diagnostic_Event_Manager.DEM_List "DEM List"
 /begin ANNOTATION ANNOTATION_LABEL "Instance" ANNOTATION_ORIGIN "Group" /begin ANNOTATION_TEXT "0" /end ANNOTATION_TEXT /end ANNOTATION
 /begin ANNOTATION ANNOTATION_LABEL "TaskCycleTime" ANNOTATION_ORIGIN "Group" /begin ANNOTATION_TEXT "0" /end ANNOTATION_TEXT /end ANNOTATION
 /begin ANNOTATION ANNOTATION_LABEL "TimeResolution" ANNOTATION_ORIGIN "Group" /begin ANNOTATION_TEXT "0" /end ANNOTATION_TEXT /end ANNOTATION
 /begin REF_MEASUREMENT DEMDiagnosticEventManager.DEMList.DTC_01_01_PF_GetStatus.Task1 DEMDiagnosticEventManager.DEMList.DTC_02_02_AF_GetStatus.Task1 DEMDiagnosticEventManager.DEMList.DTC_03_03_RF_GetStatus.Task1 DEMDiagnosticEventManager.DEMList.DTC_04_04_MF_GetStatus.Task1 DEMDiagnosticEventManager.DEMList.DTC_05_05_AllOn_GetStatus.Task1 DEMDiagnosticEventManager.DEMList.DTC_06_06_Loff_AllFlash_GetStatus.Task1 DEMDiagnosticEventManager.DEMList.DTC_01_01_PF.Task1 DEMDiagnosticEventManager.DEMList.DTC_02_02_AF.Task1 DEMDiagnosticEventManager.DEMList.DTC_03_03_RF.Task1 DEMDiagnosticEventManager.DEMList.DTC_04_04_MF.Task1 DEMDiagnosticEventManager.DEMList.DTC_05_05_AllOn.Task1 DEMDiagnosticEventManager.DEMList.DTC_06_06_Loff_AllFlash.Task1 DEMDiagnosticEventManager.DEMList.DTC_1234_22.Task1 DEMDiagnosticEventManager.DEMList.DTC_86868_6.Task1 /end REF_MEASUREMENT
/end GROUP
/begin GROUP SYSTEM.DEM_Diagnostic_Event_Manager "DEM Diagnostic Event Manager"
 /begin ANNOTATION ANNOTATION_LABEL "Instance" ANNOTATION_ORIGIN "Group" /begin ANNOTATION_TEXT "0" /end ANNOTATION_TEXT /end ANNOTATION
 /begin ANNOTATION ANNOTATION_LABEL "TaskCycleTime" ANNOTATION_ORIGIN "Group" /begin ANNOTATION_TEXT "0" /end ANNOTATION_TEXT /end ANNOTATION
 /begin ANNOTATION ANNOTATION_LABEL "TimeResolution" ANNOTATION_ORIGIN "Group" /begin ANNOTATION_TEXT "0" /end ANNOTATION_TEXT /end ANNOTATION
 /begin SUB_GROUP SYSTEM.DEM_Diagnostic_Event_Manager.DEM_List /end SUB_GROUP
 /begin REF_MEASUREMENT DEMDiagnosticEventManager.DeviceState.Task1 DEMDiagnosticEventManager.DateAndTime.Task1 DEMDiagnosticEventManager.Distance.Task1 DEMDiagnosticEventManager.FreezeFrame1.Task1 DEMDiagnosticEventManager.FreezeFrame10.Task1 DEMDiagnosticEventManager.FreezeFrame2.Task1 DEMDiagnosticEventManager.FreezeFrame3.Task1 DEMDiagnosticEventManager.FreezeFrame4.Task1 DEMDiagnosticEventManager.FreezeFrame5.Task1 DEMDiagnosticEventManager.FreezeFrame6.Task1 DEMDiagnosticEventManager.FreezeFrame7.Task1 DEMDiagnosticEventManager.FreezeFrame8.Task1 DEMDiagnosticEventManager.FreezeFrame9.Task1 DEMDiagnosticEventManager.EnableCondition00.Task1 DEMDiagnosticEventManager.OperationCycle.Task1 DEMDiagnosticEventManager.StorageCondition00.Task1 /end REF_MEASUREMENT
/end GROUP
/begin GROUP SYSTEM.DtcList.DTC_List "DTC List"
 /begin ANNOTATION ANNOTATION_LABEL "Instance" ANNOTATION_ORIGIN "Group" /begin ANNOTATION_TEXT "0" /end ANNOTATION_TEXT /end ANNOTATION
 /begin ANNOTATION ANNOTATION_LABEL "TaskCycleTime" ANNOTATION_ORIGIN "Group" /begin ANNOTATION_TEXT "0" /end ANNOTATION_TEXT /end ANNOTATION
 /begin ANNOTATION ANNOTATION_LABEL "TimeResolution" ANNOTATION_ORIGIN "Group" /begin ANNOTATION_TEXT "0" /end ANNOTATION_TEXT /end ANNOTATION
 /begin REF_MEASUREMENT DtcList.DTCList.f_DTClistSPN.Task1 DtcList.DTCList.f_DTClistNumOfEntries.Task1 DtcList.DTCList.DTClistType.Task1 DtcList.DTCList.f_DTClistECUaddress.Task1 DtcList.DTCList.f_DTClistFirstEntry.Task1 DtcList.DTCList.f_DTClistFMI.Task1 DtcList.DTCList.f_DTClistLastEntry.Task1 DtcList.DTCList.f_DTClistOCC.Task1 DtcList.DTCList.f_DTClistPrio.Task1 DtcList.DTCList.f_DTClistECUaddrMask.Task1 DtcList.DTCList.f_DTClistEna.Task1 DtcList.DTCList.f_DTClistNextEntry.Task1 DtcList.DTCList.f_DTClistPrevEntry.Task1 DtcList.DTCList.f_DTClistStatusMask.Task1 DtcList.DTCList.SelectCANChannel.Task1 /end REF_MEASUREMENT
/end GROUP
/begin GROUP SYSTEM.DtcList "DtcList"
 /begin ANNOTATION ANNOTATION_LABEL "Instance" ANNOTATION_ORIGIN "Group" /begin ANNOTATION_TEXT "0" /end ANNOTATION_TEXT /end ANNOTATION
 /begin ANNOTATION ANNOTATION_LABEL "TaskCycleTime" ANNOTATION_ORIGIN "Group" /begin ANNOTATION_TEXT "0" /end ANNOTATION_TEXT /end ANNOTATION
 /begin ANNOTATION ANNOTATION_LABEL "TimeResolution" ANNOTATION_ORIGIN "Group" /begin ANNOTATION_TEXT "0" /end ANNOTATION_TEXT /end ANNOTATION
 /begin SUB_GROUP SYSTEM.DtcList.DTC_List /end SUB_GROUP
/end GROUP
/begin GROUP SYSTEM.DM4RX_Main_Device "DM4RX Main Device"
 /begin ANNOTATION ANNOTATION_LABEL "Instance" ANNOTATION_ORIGIN "Group" /begin ANNOTATION_TEXT "0" /end ANNOTATION_TEXT /end ANNOTATION
 /begin ANNOTATION ANNOTATION_LABEL "TaskCycleTime" ANNOTATION_ORIGIN "Group" /begin ANNOTATION_TEXT "0" /end ANNOTATION_TEXT /end ANNOTATION
 /begin ANNOTATION ANNOTATION_LABEL "TimeResolution" ANNOTATION_ORIGIN "Group" /begin ANNOTATION_TEXT "0" /end ANNOTATION_TEXT /end ANNOTATION
 /begin REF_MEASUREMENT DM4RXMainDevice.Spn.Task1 DM4RXMainDevice.FaultIndication.Task1 DM4RXMainDevice.FirstEntry.Task1 DM4RXMainDevice.Fmi.Task1 DM4RXMainDevice.LastEntry.Task1 DM4RXMainDevice.NumberOfDtcs.Task1 DM4RXMainDevice.OccCount.Task1 DM4RXMainDevice.EcuAddress.Task1 DM4RXMainDevice.NextEntry.Task1 DM4RXMainDevice.PreviousEntry.Task1 DM4RXMainDevice.SAEJ1939Format.Task1 /end REF_MEASUREMENT
/end GROUP
/begin GROUP SYSTEM.UDS_Services.Routine_Control_Service.RoutineCtrl1 "RoutineCtrl1"
 /begin ANNOTATION ANNOTATION_LABEL "Instance" ANNOTATION_ORIGIN "Group" /begin ANNOTATION_TEXT "0" /end ANNOTATION_TEXT /end ANNOTATION
 /begin ANNOTATION ANNOTATION_LABEL "TaskCycleTime" ANNOTATION_ORIGIN "Group" /begin ANNOTATION_TEXT "0" /end ANNOTATION_TEXT /end ANNOTATION
 /begin ANNOTATION ANNOTATION_LABEL "TimeResolution" ANNOTATION_ORIGIN "Group" /begin ANNOTATION_TEXT "0" /end ANNOTATION_TEXT /end ANNOTATION
 /begin REF_MEASUREMENT UDSServices.RoutineControlService.RoutineCtrl1.RequestRoutineResults.Task1 UDSServices.RoutineControlService.RoutineCtrl1.StartRoutine.Task1 UDSServices.RoutineControlService.RoutineCtrl1.StopRoutine.Task1 UDSServices.RoutineControlService.RoutineCtrl1.u8Response.Task1 UDSServices.RoutineControlService.RoutineCtrl1.ResponseCode.Task1 /end REF_MEASUREMENT
/end GROUP
/begin GROUP SYSTEM.UDS_Services.Routine_Control_Service "Routine Control Service"
 /begin ANNOTATION ANNOTATION_LABEL "Instance" ANNOTATION_ORIGIN "Group" /begin ANNOTATION_TEXT "0" /end ANNOTATION_TEXT /end ANNOTATION
 /begin ANNOTATION ANNOTATION_LABEL "TaskCycleTime" ANNOTATION_ORIGIN "Group" /begin ANNOTATION_TEXT "0" /end ANNOTATION_TEXT /end ANNOTATION
 /begin ANNOTATION ANNOTATION_LABEL "TimeResolution" ANNOTATION_ORIGIN "Group" /begin ANNOTATION_TEXT "0" /end ANNOTATION_TEXT /end ANNOTATION
 /begin SUB_GROUP SYSTEM.UDS_Services.Routine_Control_Service.RoutineCtrl1 /end SUB_GROUP
/end GROUP
/begin GROUP SYSTEM.UDS_Services "UDS Services"
 /begin ANNOTATION ANNOTATION_LABEL "Instance" ANNOTATION_ORIGIN "Group" /begin ANNOTATION_TEXT "0" /end ANNOTATION_TEXT /end ANNOTATION
 /begin ANNOTATION ANNOTATION_LABEL "TaskCycleTime" ANNOTATION_ORIGIN "Group" /begin ANNOTATION_TEXT "0" /end ANNOTATION_TEXT /end ANNOTATION
 /begin ANNOTATION ANNOTATION_LABEL "TimeResolution" ANNOTATION_ORIGIN "Group" /begin ANNOTATION_TEXT "0" /end ANNOTATION_TEXT /end ANNOTATION
 /begin SUB_GROUP SYSTEM.UDS_Services.Routine_Control_Service /end SUB_GROUP
 /begin REF_MEASUREMENT UDSServices.RejectDiagnosticAccess.Task1 /end REF_MEASUREMENT
/end GROUP
/begin GROUP SYSTEM.D_CAN.Test1 "Test1"
 /begin ANNOTATION ANNOTATION_LABEL "Instance" ANNOTATION_ORIGIN "Group" /begin ANNOTATION_TEXT "0" /end ANNOTATION_TEXT /end ANNOTATION
 /begin ANNOTATION ANNOTATION_LABEL "TaskCycleTime" ANNOTATION_ORIGIN "Group" /begin ANNOTATION_TEXT "0" /end ANNOTATION_TEXT /end ANNOTATION
 /begin ANNOTATION ANNOTATION_LABEL "TimeResolution" ANNOTATION_ORIGIN "Group" /begin ANNOTATION_TEXT "0" /end ANNOTATION_TEXT /end ANNOTATION
 /begin REF_MEASUREMENT IN_DCAN.RX_Gen.Test1.MessageState.Task1 IN_DCAN.RX_Gen.Test1.Val1.Task1 OUT_DCAN.RX_Gen.Test1.MessageEnable.Task1 /end REF_MEASUREMENT
/end GROUP
/begin GROUP SYSTEM.D_CAN.D_GenTx_4 "D-GenTx_4"
 /begin ANNOTATION ANNOTATION_LABEL "Instance" ANNOTATION_ORIGIN "Group" /begin ANNOTATION_TEXT "1" /end ANNOTATION_TEXT /end ANNOTATION
 /begin ANNOTATION ANNOTATION_LABEL "TaskCycleTime" ANNOTATION_ORIGIN "Group" /begin ANNOTATION_TEXT "0" /end ANNOTATION_TEXT /end ANNOTATION
 /begin ANNOTATION ANNOTATION_LABEL "TimeResolution" ANNOTATION_ORIGIN "Group" /begin ANNOTATION_TEXT "0" /end ANNOTATION_TEXT /end ANNOTATION
 /begin REF_MEASUREMENT DCAN.TX_Gen.DGenTx_4.MessageState.Task1 DCAN.TX_Gen.DGenTx_4.Val1.Task1 DCAN.TX_Gen.DGenTx_4.MessageEnable.Task1 /end REF_MEASUREMENT
/end GROUP
/begin GROUP SYSTEM.D_CAN.D_GenTX_3 "D-GenTX_3"
 /begin ANNOTATION ANNOTATION_LABEL "Instance" ANNOTATION_ORIGIN "Group" /begin ANNOTATION_TEXT "2" /end ANNOTATION_TEXT /end ANNOTATION
 /begin ANNOTATION ANNOTATION_LABEL "TaskCycleTime" ANNOTATION_ORIGIN "Group" /begin ANNOTATION_TEXT "0" /end ANNOTATION_TEXT /end ANNOTATION
 /begin ANNOTATION ANNOTATION_LABEL "TimeResolution" ANNOTATION_ORIGIN "Group" /begin ANNOTATION_TEXT "0" /end ANNOTATION_TEXT /end ANNOTATION
 /begin REF_MEASUREMENT DCAN.TX_Gen.DGenTX_3.Val1.Task1 DCAN.TX_Gen.DGenTX_3.Val2.Task1 DCAN.TX_Gen.DGenTX_3.Val3.Task1 DCAN.TX_Gen.DGenTX_3.Val4.Task1 DCAN.TX_Gen.DGenTX_3.MessageEnable.Task1 /end REF_MEASUREMENT
/end GROUP
/begin GROUP SYSTEM.D_CAN.D_GenTX_2 "D-GenTX_2"
 /begin ANNOTATION ANNOTATION_LABEL "Instance" ANNOTATION_ORIGIN "Group" /begin ANNOTATION_TEXT "3" /end ANNOTATION_TEXT /end ANNOTATION
 /begin ANNOTATION ANNOTATION_LABEL "TaskCycleTime" ANNOTATION_ORIGIN "Group" /begin ANNOTATION_TEXT "0" /end ANNOTATION_TEXT /end ANNOTATION
 /begin ANNOTATION ANNOTATION_LABEL "TimeResolution" ANNOTATION_ORIGIN "Group" /begin ANNOTATION_TEXT "0" /end ANNOTATION_TEXT /end ANNOTATION
 /begin REF_MEASUREMENT DCAN.TX_Gen.DGenTX_2.Val1.Task1 DCAN.TX_Gen.DGenTX_2.Val2.Task1 DCAN.TX_Gen.DGenTX_2.Val3.Task1 DCAN.TX_Gen.DGenTX_2.MessageEnable.Task1 /end REF_MEASUREMENT
/end GROUP
/begin GROUP SYSTEM.D_CAN.Generic_Tx_Message "Generic Tx Message"
 /begin ANNOTATION ANNOTATION_LABEL "Instance" ANNOTATION_ORIGIN "Group" /begin ANNOTATION_TEXT "4" /end ANNOTATION_TEXT /end ANNOTATION
 /begin ANNOTATION ANNOTATION_LABEL "TaskCycleTime" ANNOTATION_ORIGIN "Group" /begin ANNOTATION_TEXT "0" /end ANNOTATION_TEXT /end ANNOTATION
 /begin ANNOTATION ANNOTATION_LABEL "TimeResolution" ANNOTATION_ORIGIN "Group" /begin ANNOTATION_TEXT "0" /end ANNOTATION_TEXT /end ANNOTATION
 /begin REF_MEASUREMENT IN_DCAN.TX_Gen.GenericTxMessage.MessageState.Task1 OUT_DCAN.TX_Gen.GenericTxMessage.Val5.Task1 DCAN.TX_Gen.GenericTxMessage.CycleTime.Task1 OUT_DCAN.TX_Gen.GenericTxMessage.MessageEnable.Task1 OUT_DCAN.TX_Gen.GenericTxMessage.Val1.Task1 OUT_DCAN.TX_Gen.GenericTxMessage.Val2.Task1 OUT_DCAN.TX_Gen.GenericTxMessage.Val3.Task1 OUT_DCAN.TX_Gen.GenericTxMessage.Val4.Task1 /end REF_MEASUREMENT
/end GROUP
/begin GROUP SYSTEM.D_CAN.D_GenTx_5 "D-GenTx_5"
 /begin ANNOTATION ANNOTATION_LABEL "Instance" ANNOTATION_ORIGIN "Group" /begin ANNOTATION_TEXT "0" /end ANNOTATION_TEXT /end ANNOTATION
 /begin ANNOTATION ANNOTATION_LABEL "TaskCycleTime" ANNOTATION_ORIGIN "Group" /begin ANNOTATION_TEXT "0" /end ANNOTATION_TEXT /end ANNOTATION
 /begin ANNOTATION ANNOTATION_LABEL "TimeResolution" ANNOTATION_ORIGIN "Group" /begin ANNOTATION_TEXT "0" /end ANNOTATION_TEXT /end ANNOTATION
 /begin REF_MEASUREMENT DCAN.TX_Gen.DGenTx_5.ui_Val_02.Task1 DCAN.TX_Gen.DGenTx_5.MessageEnable.Task1 DCAN.TX_Gen.DGenTx_5.usi_Val_01.Task1 /end REF_MEASUREMENT
/end GROUP
/begin GROUP SYSTEM.D_CAN.Generic_DM1_Tx_Message "Generic DM1 Tx Message"
 /begin ANNOTATION ANNOTATION_LABEL "Instance" ANNOTATION_ORIGIN "Group" /begin ANNOTATION_TEXT "0" /end ANNOTATION_TEXT /end ANNOTATION
 /begin ANNOTATION ANNOTATION_LABEL "TaskCycleTime" ANNOTATION_ORIGIN "Group" /begin ANNOTATION_TEXT "0" /end ANNOTATION_TEXT /end ANNOTATION
 /begin ANNOTATION ANNOTATION_LABEL "TimeResolution" ANNOTATION_ORIGIN "Group" /begin ANNOTATION_TEXT "0" /end ANNOTATION_TEXT /end ANNOTATION
 /begin REF_MEASUREMENT DCAN.GenericDM1TxMessage.DeviceState.Task1 DCAN.GenericDM1TxMessage.DeviceEnable.Task1 /end REF_MEASUREMENT
/end GROUP
/begin GROUP SYSTEM.D_CAN.Generic_DM2_Tx_Message "Generic DM2 Tx Message"
 /begin ANNOTATION ANNOTATION_LABEL "Instance" ANNOTATION_ORIGIN "Group" /begin ANNOTATION_TEXT "0" /end ANNOTATION_TEXT /end ANNOTATION
 /begin ANNOTATION ANNOTATION_LABEL "TaskCycleTime" ANNOTATION_ORIGIN "Group" /begin ANNOTATION_TEXT "0" /end ANNOTATION_TEXT /end ANNOTATION
 /begin ANNOTATION ANNOTATION_LABEL "TimeResolution" ANNOTATION_ORIGIN "Group" /begin ANNOTATION_TEXT "0" /end ANNOTATION_TEXT /end ANNOTATION
 /begin REF_MEASUREMENT DCAN.GenericDM2TxMessage.Device_State.Task1 DCAN.GenericDM2TxMessage.Device_Enable.Task1 /end REF_MEASUREMENT
/end GROUP
/begin GROUP SYSTEM.D_CAN.Generic_DM3_Rx_Message "Generic DM3 Rx Message"
 /begin ANNOTATION ANNOTATION_LABEL "Instance" ANNOTATION_ORIGIN "Group" /begin ANNOTATION_TEXT "0" /end ANNOTATION_TEXT /end ANNOTATION
 /begin ANNOTATION ANNOTATION_LABEL "TaskCycleTime" ANNOTATION_ORIGIN "Group" /begin ANNOTATION_TEXT "0" /end ANNOTATION_TEXT /end ANNOTATION
 /begin ANNOTATION ANNOTATION_LABEL "TimeResolution" ANNOTATION_ORIGIN "Group" /begin ANNOTATION_TEXT "0" /end ANNOTATION_TEXT /end ANNOTATION
 /begin REF_MEASUREMENT DCAN.GenericDM3RxMessage.Device_State.Task1 DCAN.GenericDM3RxMessage.Device_Enable.Task1 /end REF_MEASUREMENT
/end GROUP
/begin GROUP SYSTEM.D_CAN.Generic_DM11_RX_Message "Generic DM11 RX Message"
 /begin ANNOTATION ANNOTATION_LABEL "Instance" ANNOTATION_ORIGIN "Group" /begin ANNOTATION_TEXT "0" /end ANNOTATION_TEXT /end ANNOTATION
 /begin ANNOTATION ANNOTATION_LABEL "TaskCycleTime" ANNOTATION_ORIGIN "Group" /begin ANNOTATION_TEXT "0" /end ANNOTATION_TEXT /end ANNOTATION
 /begin ANNOTATION ANNOTATION_LABEL "TimeResolution" ANNOTATION_ORIGIN "Group" /begin ANNOTATION_TEXT "0" /end ANNOTATION_TEXT /end ANNOTATION
 /begin REF_MEASUREMENT DCAN.GenericDM11RXMessage.DeviceState.Task1 DCAN.GenericDM11RXMessage.DeviceEnable.Task1 /end REF_MEASUREMENT
/end GROUP
/begin GROUP SYSTEM.D_CAN.Generic_DM13_RX_Message "Generic DM13 RX Message"
 /begin ANNOTATION ANNOTATION_LABEL "Instance" ANNOTATION_ORIGIN "Group" /begin ANNOTATION_TEXT "0" /end ANNOTATION_TEXT /end ANNOTATION
 /begin ANNOTATION ANNOTATION_LABEL "TaskCycleTime" ANNOTATION_ORIGIN "Group" /begin ANNOTATION_TEXT "0" /end ANNOTATION_TEXT /end ANNOTATION
 /begin ANNOTATION ANNOTATION_LABEL "TimeResolution" ANNOTATION_ORIGIN "Group" /begin ANNOTATION_TEXT "0" /end ANNOTATION_TEXT /end ANNOTATION
 /begin REF_MEASUREMENT DCAN.GenericDM13RXMessage.DeviceState.Task1 DCAN.GenericDM13RXMessage.CurrentDataLink.Task1 DCAN.GenericDM13RXMessage.DataChangeIndicator.Task1 DCAN.GenericDM13RXMessage.ISO9141.Task1 DCAN.GenericDM13RXMessage.J1587.Task1 DCAN.GenericDM13RXMessage.J1850.Task1 DCAN.GenericDM13RXMessage.J1922.Task1 DCAN.GenericDM13RXMessage.Network1.Task1 DCAN.GenericDM13RXMessage.Network2.Task1 DCAN.GenericDM13RXMessage.Network3.Task1 DCAN.GenericDM13RXMessage.OtherManufacturer.Task1 DCAN.GenericDM13RXMessage.DeviceEnable.Task1 DCAN.GenericDM13RXMessage.CurrentDataLink_DIAG.Task1 DCAN.GenericDM13RXMessage.ISO9141_DIAG.Task1 DCAN.GenericDM13RXMessage.J1587_DIAG.Task1 DCAN.GenericDM13RXMessage.J1850_DIAG.Task1 DCAN.GenericDM13RXMessage.J1922_DIAG.Task1 DCAN.GenericDM13RXMessage.Network1_DIAG.Task1 DCAN.GenericDM13RXMessage.Network2_DIAG.Task1 DCAN.GenericDM13RXMessage.Network3_DIAG.Task1 DCAN.GenericDM13RXMessage.OtherManufacturer_DIAG.Task1 /end REF_MEASUREMENT
/end GROUP
/begin GROUP SYSTEM.D_CAN "D-CAN"
 /begin ANNOTATION ANNOTATION_LABEL "Instance" ANNOTATION_ORIGIN "Group" /begin ANNOTATION_TEXT "0" /end ANNOTATION_TEXT /end ANNOTATION
 /begin ANNOTATION ANNOTATION_LABEL "TaskCycleTime" ANNOTATION_ORIGIN "Group" /begin ANNOTATION_TEXT "0" /end ANNOTATION_TEXT /end ANNOTATION
 /begin ANNOTATION ANNOTATION_LABEL "TimeResolution" ANNOTATION_ORIGIN "Group" /begin ANNOTATION_TEXT "0" /end ANNOTATION_TEXT /end ANNOTATION
 /begin SUB_GROUP SYSTEM.D_CAN.Test1 SYSTEM.D_CAN.D_GenTx_4 SYSTEM.D_CAN.D_GenTX_3 SYSTEM.D_CAN.D_GenTX_2 SYSTEM.D_CAN.Generic_Tx_Message SYSTEM.D_CAN.D_GenTx_5 SYSTEM.D_CAN.Generic_DM1_Tx_Message SYSTEM.D_CAN.Generic_DM2_Tx_Message SYSTEM.D_CAN.Generic_DM3_Rx_Message SYSTEM.D_CAN.Generic_DM11_RX_Message SYSTEM.D_CAN.Generic_DM13_RX_Message /end SUB_GROUP
 /begin REF_MEASUREMENT DCAN.BusOffState.Task1 /end REF_MEASUREMENT
/end GROUP
/begin GROUP SYSTEM.A_CAN.ACAN_TX_01 "ACAN_TX_01"
 /begin ANNOTATION ANNOTATION_LABEL "Instance" ANNOTATION_ORIGIN "Group" /begin ANNOTATION_TEXT "0" /end ANNOTATION_TEXT /end ANNOTATION
 /begin ANNOTATION ANNOTATION_LABEL "TaskCycleTime" ANNOTATION_ORIGIN "Group" /begin ANNOTATION_TEXT "0" /end ANNOTATION_TEXT /end ANNOTATION
 /begin ANNOTATION ANNOTATION_LABEL "TimeResolution" ANNOTATION_ORIGIN "Group" /begin ANNOTATION_TEXT "0" /end ANNOTATION_TEXT /end ANNOTATION
 /begin REF_MEASUREMENT IN_ACAN.TX_Gen.ACAN_TX_01.MessageState.Task1 OUT_ACAN.TX_Gen.ACAN_TX_01.MessageEnable.Task1 OUT_ACAN.TX_Gen.ACAN_TX_01.Val1.Task1 /end REF_MEASUREMENT
/end GROUP
/begin GROUP SYSTEM.A_CAN.Generic_Gateway_Message "Generic Gateway Message"
 /begin ANNOTATION ANNOTATION_LABEL "Instance" ANNOTATION_ORIGIN "Group" /begin ANNOTATION_TEXT "0" /end ANNOTATION_TEXT /end ANNOTATION
 /begin ANNOTATION ANNOTATION_LABEL "TaskCycleTime" ANNOTATION_ORIGIN "Group" /begin ANNOTATION_TEXT "0" /end ANNOTATION_TEXT /end ANNOTATION
 /begin ANNOTATION ANNOTATION_LABEL "TimeResolution" ANNOTATION_ORIGIN "Group" /begin ANNOTATION_TEXT "0" /end ANNOTATION_TEXT /end ANNOTATION
 /begin REF_MEASUREMENT ACAN.GenericGatewayMessage.MessageEnable.Task1 /end REF_MEASUREMENT
/end GROUP
/begin GROUP SYSTEM.A_CAN "A-CAN"
 /begin ANNOTATION ANNOTATION_LABEL "Instance" ANNOTATION_ORIGIN "Group" /begin ANNOTATION_TEXT "0" /end ANNOTATION_TEXT /end ANNOTATION
 /begin ANNOTATION ANNOTATION_LABEL "TaskCycleTime" ANNOTATION_ORIGIN "Group" /begin ANNOTATION_TEXT "0" /end ANNOTATION_TEXT /end ANNOTATION
 /begin ANNOTATION ANNOTATION_LABEL "TimeResolution" ANNOTATION_ORIGIN "Group" /begin ANNOTATION_TEXT "0" /end ANNOTATION_TEXT /end ANNOTATION
 /begin SUB_GROUP SYSTEM.A_CAN.ACAN_TX_01 SYSTEM.A_CAN.Generic_Gateway_Message /end SUB_GROUP
/end GROUP
/begin GROUP SYSTEM.P_CAN.P_GenTX_2 "P-GenTX_2"
 /begin ANNOTATION ANNOTATION_LABEL "Instance" ANNOTATION_ORIGIN "Group" /begin ANNOTATION_TEXT "1" /end ANNOTATION_TEXT /end ANNOTATION
 /begin ANNOTATION ANNOTATION_LABEL "TaskCycleTime" ANNOTATION_ORIGIN "Group" /begin ANNOTATION_TEXT "0" /end ANNOTATION_TEXT /end ANNOTATION
 /begin ANNOTATION ANNOTATION_LABEL "TimeResolution" ANNOTATION_ORIGIN "Group" /begin ANNOTATION_TEXT "0" /end ANNOTATION_TEXT /end ANNOTATION
 /begin REF_MEASUREMENT PCAN.TX_GEN.PGenTX_2.MessageState.Task1 PCAN.TX_GEN.PGenTX_2.Val_1.Task1 /end REF_MEASUREMENT
/end GROUP
/begin GROUP SYSTEM.P_CAN.P_GenTX_1 "P-GenTX_1"
 /begin ANNOTATION ANNOTATION_LABEL "Instance" ANNOTATION_ORIGIN "Group" /begin ANNOTATION_TEXT "2" /end ANNOTATION_TEXT /end ANNOTATION
 /begin ANNOTATION ANNOTATION_LABEL "TaskCycleTime" ANNOTATION_ORIGIN "Group" /begin ANNOTATION_TEXT "0" /end ANNOTATION_TEXT /end ANNOTATION
 /begin ANNOTATION ANNOTATION_LABEL "TimeResolution" ANNOTATION_ORIGIN "Group" /begin ANNOTATION_TEXT "0" /end ANNOTATION_TEXT /end ANNOTATION
 /begin REF_MEASUREMENT PCAN.TX_GEN.PGenTX_1.MessageState.Task1 PCAN.TX_GEN.PGenTX_1.MessageEnable.Task1 PCAN.TX_GEN.PGenTX_1.Val_1.Task1 PCAN.TX_GEN.PGenTX_1.Val_2.Task1 /end REF_MEASUREMENT
/end GROUP
/begin GROUP SYSTEM.P_CAN.P_GenTX_3 "P-GenTX_3"
 /begin ANNOTATION ANNOTATION_LABEL "Instance" ANNOTATION_ORIGIN "Group" /begin ANNOTATION_TEXT "0" /end ANNOTATION_TEXT /end ANNOTATION
 /begin ANNOTATION ANNOTATION_LABEL "TaskCycleTime" ANNOTATION_ORIGIN "Group" /begin ANNOTATION_TEXT "0" /end ANNOTATION_TEXT /end ANNOTATION
 /begin ANNOTATION ANNOTATION_LABEL "TimeResolution" ANNOTATION_ORIGIN "Group" /begin ANNOTATION_TEXT "0" /end ANNOTATION_TEXT /end ANNOTATION
 /begin REF_MEASUREMENT PCAN.TX_GEN.PGenTX_3.ui_Val_02.Task1 PCAN.TX_GEN.PGenTX_3.MessageEnable.Task1 PCAN.TX_GEN.PGenTX_3.usi_Val_01.Task1 /end REF_MEASUREMENT
/end GROUP
/begin GROUP SYSTEM.P_CAN.Generic_PG_Rx2 "Generic PG Rx2"
 /begin ANNOTATION ANNOTATION_LABEL "Instance" ANNOTATION_ORIGIN "Group" /begin ANNOTATION_TEXT "1" /end ANNOTATION_TEXT /end ANNOTATION
 /begin ANNOTATION ANNOTATION_LABEL "TaskCycleTime" ANNOTATION_ORIGIN "Group" /begin ANNOTATION_TEXT "0" /end ANNOTATION_TEXT /end ANNOTATION
 /begin ANNOTATION ANNOTATION_LABEL "TimeResolution" ANNOTATION_ORIGIN "Group" /begin ANNOTATION_TEXT "0" /end ANNOTATION_TEXT /end ANNOTATION
 /begin REF_MEASUREMENT PCAN.PGNRX.GenericPGRx2.MessageState.Task1 PCAN.PGNRX.GenericPGRx2.DataChangeIndicator.Task1 PCAN.PGNRX.GenericPGRx2.ValArray.Task1 PCAN.PGNRX.GenericPGRx2.MessageEnable.Task1 /end REF_MEASUREMENT
/end GROUP
/begin GROUP SYSTEM.P_CAN.Generic_PG_Rx4 "Generic PG Rx4"
 /begin ANNOTATION ANNOTATION_LABEL "Instance" ANNOTATION_ORIGIN "Group" /begin ANNOTATION_TEXT "2" /end ANNOTATION_TEXT /end ANNOTATION
 /begin ANNOTATION ANNOTATION_LABEL "TaskCycleTime" ANNOTATION_ORIGIN "Group" /begin ANNOTATION_TEXT "0" /end ANNOTATION_TEXT /end ANNOTATION
 /begin ANNOTATION ANNOTATION_LABEL "TimeResolution" ANNOTATION_ORIGIN "Group" /begin ANNOTATION_TEXT "0" /end ANNOTATION_TEXT /end ANNOTATION
 /begin REF_MEASUREMENT PCAN.PGNRX.GenericPGRx4.Val_10.Task1 PCAN.PGNRX.GenericPGRx4.Val_8.Task1 PCAN.PGNRX.GenericPGRx4.Val_9.Task1 PCAN.PGNRX.GenericPGRx4.MessageState.Task1 PCAN.PGNRX.GenericPGRx4.Val_6.Task1 PCAN.PGNRX.GenericPGRx4.Val_7.Task1 PCAN.PGNRX.GenericPGRx4.DataChangeIndicator.Task1 PCAN.PGNRX.GenericPGRx4.Val_1.Task1 PCAN.PGNRX.GenericPGRx4.Val_2.Task1 PCAN.PGNRX.GenericPGRx4.Val_3.Task1 PCAN.PGNRX.GenericPGRx4.Val_4.Task1 PCAN.PGNRX.GenericPGRx4.Val_5.Task1 PCAN.PGNRX.GenericPGRx4.MessageEnable.Task1 /end REF_MEASUREMENT
/end GROUP
/begin GROUP SYSTEM.P_CAN.Generic_PG_Rx3 "Generic PG Rx3"
 /begin ANNOTATION ANNOTATION_LABEL "Instance" ANNOTATION_ORIGIN "Group" /begin ANNOTATION_TEXT "3" /end ANNOTATION_TEXT /end ANNOTATION
 /begin ANNOTATION ANNOTATION_LABEL "TaskCycleTime" ANNOTATION_ORIGIN "Group" /begin ANNOTATION_TEXT "0" /end ANNOTATION_TEXT /end ANNOTATION
 /begin ANNOTATION ANNOTATION_LABEL "TimeResolution" ANNOTATION_ORIGIN "Group" /begin ANNOTATION_TEXT "0" /end ANNOTATION_TEXT /end ANNOTATION
 /begin REF_MEASUREMENT PCAN.PGNRX.GenericPGRx3.MessageState.Task1 PCAN.PGNRX.GenericPGRx3.DataChangeIndicator.Task1 PCAN.PGNRX.GenericPGRx3.ValArray.Task1 PCAN.PGNRX.GenericPGRx3.MessageEnable.Task1 /end REF_MEASUREMENT
/end GROUP
/begin GROUP SYSTEM.P_CAN.Generic_PG_Rx1 "Generic PG Rx1"
 /begin ANNOTATION ANNOTATION_LABEL "Instance" ANNOTATION_ORIGIN "Group" /begin ANNOTATION_TEXT "0" /end ANNOTATION_TEXT /end ANNOTATION
 /begin ANNOTATION ANNOTATION_LABEL "TaskCycleTime" ANNOTATION_ORIGIN "Group" /begin ANNOTATION_TEXT "0" /end ANNOTATION_TEXT /end ANNOTATION
 /begin ANNOTATION ANNOTATION_LABEL "TimeResolution" ANNOTATION_ORIGIN "Group" /begin ANNOTATION_TEXT "0" /end ANNOTATION_TEXT /end ANNOTATION
 /begin REF_MEASUREMENT PCAN.PGNRX.GenericPGRx1.EcuHwId__FillLevel.Task1 PCAN.PGNRX.GenericPGRx1.EcuLocation__FillLevel.Task1 PCAN.PGNRX.GenericPGRx1.EcuManuName__FillLevel.Task1 PCAN.PGNRX.GenericPGRx1.EcuPartNumner__FillLevel.Task1 PCAN.PGNRX.GenericPGRx1.EcuSerNumber__FillLevel.Task1 PCAN.PGNRX.GenericPGRx1.MessageState.Task1 PCAN.PGNRX.GenericPGRx1.DataChangeIndicator.Task1 PCAN.PGNRX.GenericPGRx1.EcuHwId.Task1 PCAN.PGNRX.GenericPGRx1.EcuLocation.Task1 PCAN.PGNRX.GenericPGRx1.EcuManuName.Task1 PCAN.PGNRX.GenericPGRx1.EcuPartNumner.Task1 PCAN.PGNRX.GenericPGRx1.EcuSerNumber.Task1 PCAN.PGNRX.GenericPGRx1.MessageEnable.Task1 /end REF_MEASUREMENT
/end GROUP
/begin GROUP SYSTEM.P_CAN.Generic_PG_Tx1 "Generic PG Tx1"
 /begin ANNOTATION ANNOTATION_LABEL "Instance" ANNOTATION_ORIGIN "Group" /begin ANNOTATION_TEXT "1" /end ANNOTATION_TEXT /end ANNOTATION
 /begin ANNOTATION ANNOTATION_LABEL "TaskCycleTime" ANNOTATION_ORIGIN "Group" /begin ANNOTATION_TEXT "0" /end ANNOTATION_TEXT /end ANNOTATION
 /begin ANNOTATION ANNOTATION_LABEL "TimeResolution" ANNOTATION_ORIGIN "Group" /begin ANNOTATION_TEXT "0" /end ANNOTATION_TEXT /end ANNOTATION
 /begin REF_MEASUREMENT PCAN.PGNTX.GenericPGTx1.MessageState.Task1 PCAN.PGNTX.GenericPGTx1.Val_2.Task1 PCAN.PGNTX.GenericPGTx1.MessageEnable.Task1 PCAN.PGNTX.GenericPGTx1.Val_1.Task1 PCAN.PGNTX.GenericPGTx1.Val_3.Task1 /end REF_MEASUREMENT
/end GROUP
/begin GROUP SYSTEM.P_CAN.Generic_PG_Tx2 "Generic PG Tx2"
 /begin ANNOTATION ANNOTATION_LABEL "Instance" ANNOTATION_ORIGIN "Group" /begin ANNOTATION_TEXT "2" /end ANNOTATION_TEXT /end ANNOTATION
 /begin ANNOTATION ANNOTATION_LABEL "TaskCycleTime" ANNOTATION_ORIGIN "Group" /begin ANNOTATION_TEXT "0" /end ANNOTATION_TEXT /end ANNOTATION
 /begin ANNOTATION ANNOTATION_LABEL "TimeResolution" ANNOTATION_ORIGIN "Group" /begin ANNOTATION_TEXT "0" /end ANNOTATION_TEXT /end ANNOTATION
 /begin REF_MEASUREMENT PCAN.PGNTX.GenericPGTx2.MessageState.Task1 PCAN.PGNTX.GenericPGTx2.MessageEnable.Task1 PCAN.PGNTX.GenericPGTx2.ValArray.Task1 /end REF_MEASUREMENT
/end GROUP
/begin GROUP SYSTEM.P_CAN.Generic_PG_Tx3 "Generic PG Tx3"
 /begin ANNOTATION ANNOTATION_LABEL "Instance" ANNOTATION_ORIGIN "Group" /begin ANNOTATION_TEXT "0" /end ANNOTATION_TEXT /end ANNOTATION
 /begin ANNOTATION ANNOTATION_LABEL "TaskCycleTime" ANNOTATION_ORIGIN "Group" /begin ANNOTATION_TEXT "0" /end ANNOTATION_TEXT /end ANNOTATION
 /begin ANNOTATION ANNOTATION_LABEL "TimeResolution" ANNOTATION_ORIGIN "Group" /begin ANNOTATION_TEXT "0" /end ANNOTATION_TEXT /end ANNOTATION
 /begin REF_MEASUREMENT PCAN.PGNTX.GenericPGTx3.MessageState.Task1 PCAN.PGNTX.GenericPGTx3.Val1.Task1 PCAN.PGNTX.GenericPGTx3.Val10.Task1 PCAN.PGNTX.GenericPGTx3.Val2.Task1 PCAN.PGNTX.GenericPGTx3.Val3.Task1 PCAN.PGNTX.GenericPGTx3.Val4.Task1 PCAN.PGNTX.GenericPGTx3.Val5.Task1 PCAN.PGNTX.GenericPGTx3.Val6.Task1 PCAN.PGNTX.GenericPGTx3.Val7.Task1 PCAN.PGNTX.GenericPGTx3.Val8.Task1 PCAN.PGNTX.GenericPGTx3.Val9.Task1 PCAN.PGNTX.GenericPGTx3.MessageEnable.Task1 /end REF_MEASUREMENT
/end GROUP
/begin GROUP SYSTEM.P_CAN.Generic_DM1_Rx_SA00.Generic_DTC_Filter "Generic DTC Filter"
 /begin ANNOTATION ANNOTATION_LABEL "Instance" ANNOTATION_ORIGIN "Group" /begin ANNOTATION_TEXT "1" /end ANNOTATION_TEXT /end ANNOTATION
 /begin ANNOTATION ANNOTATION_LABEL "TaskCycleTime" ANNOTATION_ORIGIN "Group" /begin ANNOTATION_TEXT "0" /end ANNOTATION_TEXT /end ANNOTATION
 /begin ANNOTATION ANNOTATION_LABEL "TimeResolution" ANNOTATION_ORIGIN "Group" /begin ANNOTATION_TEXT "0" /end ANNOTATION_TEXT /end ANNOTATION
 /begin REF_MEASUREMENT GenericDM1RxSA19.GenericDTCFilter.SPN_3_3.Task1 GenericDM1RxSA19.GenericDTCFilter.SPN_4_4.Task1 GenericDM1RxSA19.GenericDTCFilter.SPN_5_5.Task1 GenericDM1RxSA19.GenericDTCFilter.SPN_6_6.Task1 /end REF_MEASUREMENT
/end GROUP
/begin GROUP SYSTEM.P_CAN.Generic_DM1_Rx_SA00.Generic_DTC_Filter.2 "Generic DTC Filter"
 /begin ANNOTATION ANNOTATION_LABEL "Instance" ANNOTATION_ORIGIN "Group" /begin ANNOTATION_TEXT "2" /end ANNOTATION_TEXT /end ANNOTATION
 /begin ANNOTATION ANNOTATION_LABEL "TaskCycleTime" ANNOTATION_ORIGIN "Group" /begin ANNOTATION_TEXT "0" /end ANNOTATION_TEXT /end ANNOTATION
 /begin ANNOTATION ANNOTATION_LABEL "TimeResolution" ANNOTATION_ORIGIN "Group" /begin ANNOTATION_TEXT "0" /end ANNOTATION_TEXT /end ANNOTATION
 /begin REF_MEASUREMENT GenericDM1RxSA32.GenericDTCFilter.SPN_7_7.Task1 GenericDM1RxSA32.GenericDTCFilter.SPN_7_7__Priority.Task1 GenericDM1RxSA32.GenericDTCFilter.SPN_8_8.Task1 GenericDM1RxSA32.GenericDTCFilter.SPN_8_8__Priority.Task1 /end REF_MEASUREMENT
/end GROUP
/begin GROUP SYSTEM.P_CAN.Generic_DM1_Rx_SA00.Generic_DTC_Filter.0 "Generic DTC Filter"
 /begin ANNOTATION ANNOTATION_LABEL "Instance" ANNOTATION_ORIGIN "Group" /begin ANNOTATION_TEXT "0" /end ANNOTATION_TEXT /end ANNOTATION
 /begin ANNOTATION ANNOTATION_LABEL "TaskCycleTime" ANNOTATION_ORIGIN "Group" /begin ANNOTATION_TEXT "0" /end ANNOTATION_TEXT /end ANNOTATION
 /begin ANNOTATION ANNOTATION_LABEL "TimeResolution" ANNOTATION_ORIGIN "Group" /begin ANNOTATION_TEXT "0" /end ANNOTATION_TEXT /end ANNOTATION
 /begin REF_MEASUREMENT GenericDM1RxSA00.GenericDTCFilter.SPN_1_1.Task1 GenericDM1RxSA00.GenericDTCFilter.SPN_2_2.Task1 /end REF_MEASUREMENT
/end GROUP
/begin GROUP SYSTEM.P_CAN.Generic_DM1_Rx_SA00 "Generic DM1 Rx SA00"
 /begin ANNOTATION ANNOTATION_LABEL "Instance" ANNOTATION_ORIGIN "Group" /begin ANNOTATION_TEXT "0" /end ANNOTATION_TEXT /end ANNOTATION
 /begin ANNOTATION ANNOTATION_LABEL "TaskCycleTime" ANNOTATION_ORIGIN "Group" /begin ANNOTATION_TEXT "0" /end ANNOTATION_TEXT /end ANNOTATION
 /begin ANNOTATION ANNOTATION_LABEL "TimeResolution" ANNOTATION_ORIGIN "Group" /begin ANNOTATION_TEXT "0" /end ANNOTATION_TEXT /end ANNOTATION
 /begin SUB_GROUP SYSTEM.P_CAN.Generic_DM1_Rx_SA00.Generic_DTC_Filter SYSTEM.P_CAN.Generic_DM1_Rx_SA00.Generic_DTC_Filter.2 SYSTEM.P_CAN.Generic_DM1_Rx_SA00.Generic_DTC_Filter.0 /end SUB_GROUP
 /begin REF_MEASUREMENT PCAN.GenericDM1RxSA00.MessageState.Task1 PCAN.GenericDM1RxSA00.ActiveDTC.Task1 PCAN.GenericDM1RxSA00.AmberWarningLamp.Task1 PCAN.GenericDM1RxSA00.AmberWarningLampFlash.Task1 PCAN.GenericDM1RxSA00.ProtectLamp.Task1 PCAN.GenericDM1RxSA00.RedStopLamp.Task1 PCAN.GenericDM1RxSA00.UndefinedActiveDtc.Task1 PCAN.GenericDM1RxSA00.MessageEnable.Task1 PCAN.GenericDM1RxSA00.AmberWarningLampFlash_DIAG.Task1 /end REF_MEASUREMENT
/end GROUP
/begin GROUP SYSTEM.P_CAN.Generic_DM1_Rx_SA19 "Generic DM1 Rx SA19"
 /begin ANNOTATION ANNOTATION_LABEL "Instance" ANNOTATION_ORIGIN "Group" /begin ANNOTATION_TEXT "1" /end ANNOTATION_TEXT /end ANNOTATION
 /begin ANNOTATION ANNOTATION_LABEL "TaskCycleTime" ANNOTATION_ORIGIN "Group" /begin ANNOTATION_TEXT "0" /end ANNOTATION_TEXT /end ANNOTATION
 /begin ANNOTATION ANNOTATION_LABEL "TimeResolution" ANNOTATION_ORIGIN "Group" /begin ANNOTATION_TEXT "0" /end ANNOTATION_TEXT /end ANNOTATION
 /begin REF_MEASUREMENT PCAN.GenericDM1RxSA19.MessageState.Task1 PCAN.GenericDM1RxSA19.ActiveDTC.Task1 PCAN.GenericDM1RxSA19.AmberWarningLamp.Task1 PCAN.GenericDM1RxSA19.AmberWarningLampFlash.Task1 PCAN.GenericDM1RxSA19.ProtectLamp.Task1 PCAN.GenericDM1RxSA19.RedStopLamp.Task1 PCAN.GenericDM1RxSA19.UndefinedActiveDtc.Task1 PCAN.GenericDM1RxSA19.MessageEnable.Task1 PCAN.GenericDM1RxSA19.AmberWarningLampFlash_DIAG.Task1 /end REF_MEASUREMENT
/end GROUP
/begin GROUP SYSTEM.P_CAN.Generic_DM1_Rx_SA32 "Generic DM1 Rx SA32"
 /begin ANNOTATION ANNOTATION_LABEL "Instance" ANNOTATION_ORIGIN "Group" /begin ANNOTATION_TEXT "2" /end ANNOTATION_TEXT /end ANNOTATION
 /begin ANNOTATION ANNOTATION_LABEL "TaskCycleTime" ANNOTATION_ORIGIN "Group" /begin ANNOTATION_TEXT "0" /end ANNOTATION_TEXT /end ANNOTATION
 /begin ANNOTATION ANNOTATION_LABEL "TimeResolution" ANNOTATION_ORIGIN "Group" /begin ANNOTATION_TEXT "0" /end ANNOTATION_TEXT /end ANNOTATION
 /begin REF_MEASUREMENT PCAN.GenericDM1RxSA32.MessageState.Task1 PCAN.GenericDM1RxSA32.ActiveDTC.Task1 PCAN.GenericDM1RxSA32.MalfunctionIndicatorLamp.Task1 PCAN.GenericDM1RxSA32.MalfunctionIndicatorLampFlash.Task1 PCAN.GenericDM1RxSA32.UndefinedActiveDtc.Task1 PCAN.GenericDM1RxSA32.MessageEnable.Task1 PCAN.GenericDM1RxSA32.SwitchDtcMode.Task1 PCAN.GenericDM1RxSA32.SwitchRecMode.Task1 /end REF_MEASUREMENT
/end GROUP
/begin GROUP SYSTEM.P_CAN.Generic_DM1_Tx_Message "Generic DM1 Tx Message"
 /begin ANNOTATION ANNOTATION_LABEL "Instance" ANNOTATION_ORIGIN "Group" /begin ANNOTATION_TEXT "0" /end ANNOTATION_TEXT /end ANNOTATION
 /begin ANNOTATION ANNOTATION_LABEL "TaskCycleTime" ANNOTATION_ORIGIN "Group" /begin ANNOTATION_TEXT "0" /end ANNOTATION_TEXT /end ANNOTATION
 /begin ANNOTATION ANNOTATION_LABEL "TimeResolution" ANNOTATION_ORIGIN "Group" /begin ANNOTATION_TEXT "0" /end ANNOTATION_TEXT /end ANNOTATION
 /begin REF_MEASUREMENT PCAN.GenericDM1TxMessage.DeviceState.Task1 PCAN.GenericDM1TxMessage.DeviceEnable.Task1 /end REF_MEASUREMENT
/end GROUP
/begin GROUP SYSTEM.P_CAN.Generic_DM4REQ "Generic DM4REQ"
 /begin ANNOTATION ANNOTATION_LABEL "Instance" ANNOTATION_ORIGIN "Group" /begin ANNOTATION_TEXT "0" /end ANNOTATION_TEXT /end ANNOTATION
 /begin ANNOTATION ANNOTATION_LABEL "TaskCycleTime" ANNOTATION_ORIGIN "Group" /begin ANNOTATION_TEXT "0" /end ANNOTATION_TEXT /end ANNOTATION
 /begin ANNOTATION ANNOTATION_LABEL "TimeResolution" ANNOTATION_ORIGIN "Group" /begin ANNOTATION_TEXT "0" /end ANNOTATION_TEXT /end ANNOTATION
 /begin REF_MEASUREMENT PCAN.GenericDM4REQ.DeviceState.Task1 PCAN.GenericDM4REQ.DeviceEnable.Task1 PCAN.GenericDM4REQ.RequestDM4.Task1 /end REF_MEASUREMENT
/end GROUP
/begin GROUP SYSTEM.P_CAN "P-CAN"
 /begin ANNOTATION ANNOTATION_LABEL "Instance" ANNOTATION_ORIGIN "Group" /begin ANNOTATION_TEXT "0" /end ANNOTATION_TEXT /end ANNOTATION
 /begin ANNOTATION ANNOTATION_LABEL "TaskCycleTime" ANNOTATION_ORIGIN "Group" /begin ANNOTATION_TEXT "0" /end ANNOTATION_TEXT /end ANNOTATION
 /begin ANNOTATION ANNOTATION_LABEL "TimeResolution" ANNOTATION_ORIGIN "Group" /begin ANNOTATION_TEXT "0" /end ANNOTATION_TEXT /end ANNOTATION
 /begin SUB_GROUP SYSTEM.P_CAN.P_GenTX_2 SYSTEM.P_CAN.P_GenTX_1 SYSTEM.P_CAN.P_GenTX_3 SYSTEM.P_CAN.Generic_PG_Rx2 SYSTEM.P_CAN.Generic_PG_Rx4 SYSTEM.P_CAN.Generic_PG_Rx3 SYSTEM.P_CAN.Generic_PG_Rx1 SYSTEM.P_CAN.Generic_PG_Tx1 SYSTEM.P_CAN.Generic_PG_Tx2 SYSTEM.P_CAN.Generic_PG_Tx3 SYSTEM.P_CAN.Generic_DM1_Rx_SA00 SYSTEM.P_CAN.Generic_DM1_Rx_SA19 SYSTEM.P_CAN.Generic_DM1_Rx_SA32 SYSTEM.P_CAN.Generic_DM1_Tx_Message SYSTEM.P_CAN.Generic_DM4REQ /end SUB_GROUP
 /begin REF_MEASUREMENT PCAN.BusOffState.Task1 /end REF_MEASUREMENT
/end GROUP
/begin GROUP SYSTEM.I_CAN.I_Test1 "I_Test1"
 /begin ANNOTATION ANNOTATION_LABEL "Instance" ANNOTATION_ORIGIN "Group" /begin ANNOTATION_TEXT "0" /end ANNOTATION_TEXT /end ANNOTATION
 /begin ANNOTATION ANNOTATION_LABEL "TaskCycleTime" ANNOTATION_ORIGIN "Group" /begin ANNOTATION_TEXT "0" /end ANNOTATION_TEXT /end ANNOTATION
 /begin ANNOTATION ANNOTATION_LABEL "TimeResolution" ANNOTATION_ORIGIN "Group" /begin ANNOTATION_TEXT "0" /end ANNOTATION_TEXT /end ANNOTATION
 /begin REF_MEASUREMENT IN_ICAN.IGenRx.I_Test1.MessageState.Task1 IN_ICAN.IGenRx.I_Test1.Val_1.Task1 OUT_ICAN.IGenRx.I_Test1.MessageEnable.Task1 /end REF_MEASUREMENT
/end GROUP
/begin GROUP SYSTEM.I_CAN.I_Tes1 "I_Tes1"
 /begin ANNOTATION ANNOTATION_LABEL "Instance" ANNOTATION_ORIGIN "Group" /begin ANNOTATION_TEXT "0" /end ANNOTATION_TEXT /end ANNOTATION
 /begin ANNOTATION ANNOTATION_LABEL "TaskCycleTime" ANNOTATION_ORIGIN "Group" /begin ANNOTATION_TEXT "0" /end ANNOTATION_TEXT /end ANNOTATION
 /begin ANNOTATION ANNOTATION_LABEL "TimeResolution" ANNOTATION_ORIGIN "Group" /begin ANNOTATION_TEXT "0" /end ANNOTATION_TEXT /end ANNOTATION
 /begin REF_MEASUREMENT OUT_ICAN.IGenTx.I_Tes1.MessageEnable.Task1 OUT_ICAN.IGenTx.I_Tes1.Val_1.Task1 /end REF_MEASUREMENT
/end GROUP
/begin GROUP SYSTEM.I_CAN.PG_Rx_Message_1 "PG Rx Message_1"
 /begin ANNOTATION ANNOTATION_LABEL "Instance" ANNOTATION_ORIGIN "Group" /begin ANNOTATION_TEXT "0" /end ANNOTATION_TEXT /end ANNOTATION
 /begin ANNOTATION ANNOTATION_LABEL "TaskCycleTime" ANNOTATION_ORIGIN "Group" /begin ANNOTATION_TEXT "0" /end ANNOTATION_TEXT /end ANNOTATION
 /begin ANNOTATION ANNOTATION_LABEL "TimeResolution" ANNOTATION_ORIGIN "Group" /begin ANNOTATION_TEXT "0" /end ANNOTATION_TEXT /end ANNOTATION
 /begin REF_MEASUREMENT ICAN.IPGNRX.PGRxMessage_1.Val_1.Task1 ICAN.IPGNRX.PGRxMessage_1.Val_2.Task1 ICAN.IPGNRX.PGRxMessage_1.Message_State.Task1 ICAN.IPGNRX.PGRxMessage_1.DataChangeIndicator.Task1 ICAN.IPGNRX.PGRxMessage_1.Message_Enable.Task1 /end REF_MEASUREMENT
/end GROUP
/begin GROUP SYSTEM.I_CAN.ICAN_DM1_Rx_SA_19.Generic_DTC_Filter "Generic DTC Filter"
 /begin ANNOTATION ANNOTATION_LABEL "Instance" ANNOTATION_ORIGIN "Group" /begin ANNOTATION_TEXT "0" /end ANNOTATION_TEXT /end ANNOTATION
 /begin ANNOTATION ANNOTATION_LABEL "TaskCycleTime" ANNOTATION_ORIGIN "Group" /begin ANNOTATION_TEXT "0" /end ANNOTATION_TEXT /end ANNOTATION
 /begin ANNOTATION ANNOTATION_LABEL "TimeResolution" ANNOTATION_ORIGIN "Group" /begin ANNOTATION_TEXT "0" /end ANNOTATION_TEXT /end ANNOTATION
 /begin REF_MEASUREMENT ICANDM1RxSA19.GenericDTCFilter.SPN_1_FMI_1.Task1 ICANDM1RxSA19.GenericDTCFilter.SPN_5_FMI_10.Task1 ICANDM1RxSA19.GenericDTCFilter.SPN_6_FMI_1.Task1 /end REF_MEASUREMENT
/end GROUP
/begin GROUP SYSTEM.I_CAN.ICAN_DM1_Rx_SA_19 "ICAN DM1 Rx SA 19"
 /begin ANNOTATION ANNOTATION_LABEL "Instance" ANNOTATION_ORIGIN "Group" /begin ANNOTATION_TEXT "0" /end ANNOTATION_TEXT /end ANNOTATION
 /begin ANNOTATION ANNOTATION_LABEL "TaskCycleTime" ANNOTATION_ORIGIN "Group" /begin ANNOTATION_TEXT "0" /end ANNOTATION_TEXT /end ANNOTATION
 /begin ANNOTATION ANNOTATION_LABEL "TimeResolution" ANNOTATION_ORIGIN "Group" /begin ANNOTATION_TEXT "0" /end ANNOTATION_TEXT /end ANNOTATION
 /begin SUB_GROUP SYSTEM.I_CAN.ICAN_DM1_Rx_SA_19.Generic_DTC_Filter /end SUB_GROUP
 /begin REF_MEASUREMENT ICAN.ICANDM1RxSA19.MessageState.Task1 ICAN.ICANDM1RxSA19.ActiveDTC.Task1 ICAN.ICANDM1RxSA19.AmberWarningLamp.Task1 ICAN.ICANDM1RxSA19.AmberWarningLampFlash.Task1 ICAN.ICANDM1RxSA19.UndefinedActiveDtc.Task1 ICAN.ICANDM1RxSA19.MessageEnable.Task1 ICAN.ICANDM1RxSA19.AmberWarningLamp_DIAG.Task1 ICAN.ICANDM1RxSA19.AmberWarningLampFlash_DIAG.Task1 /end REF_MEASUREMENT
/end GROUP
/begin GROUP SYSTEM.I_CAN.ICAN_DM1_Rx_SA_F1 "ICAN DM1 Rx SA F1"
 /begin ANNOTATION ANNOTATION_LABEL "Instance" ANNOTATION_ORIGIN "Group" /begin ANNOTATION_TEXT "1" /end ANNOTATION_TEXT /end ANNOTATION
 /begin ANNOTATION ANNOTATION_LABEL "TaskCycleTime" ANNOTATION_ORIGIN "Group" /begin ANNOTATION_TEXT "0" /end ANNOTATION_TEXT /end ANNOTATION
 /begin ANNOTATION ANNOTATION_LABEL "TimeResolution" ANNOTATION_ORIGIN "Group" /begin ANNOTATION_TEXT "0" /end ANNOTATION_TEXT /end ANNOTATION
 /begin REF_MEASUREMENT ICAN.ICANDM1RxSAF1.MessageState.Task1 ICAN.ICANDM1RxSAF1.ActiveDTC.Task1 ICAN.ICANDM1RxSAF1.AmberWarningLamp.Task1 ICAN.ICANDM1RxSAF1.AmberWarningLampFlash.Task1 ICAN.ICANDM1RxSAF1.MalfunctionIndicatorLamp.Task1 ICAN.ICANDM1RxSAF1.MalfunctionIndicatorLampFlash.Task1 ICAN.ICANDM1RxSAF1.ProtectLamp.Task1 ICAN.ICANDM1RxSAF1.ProtectLampFlash.Task1 ICAN.ICANDM1RxSAF1.RedStopLamp.Task1 ICAN.ICANDM1RxSAF1.RedStopLampFlash.Task1 ICAN.ICANDM1RxSAF1.UndefinedActiveDtc.Task1 ICAN.ICANDM1RxSAF1.MessageEnable.Task1 ICAN.ICANDM1RxSAF1.AmberWarningLamp_DIAG.Task1 ICAN.ICANDM1RxSAF1.AmberWarningLampFlash_DIAG.Task1 ICAN.ICANDM1RxSAF1.MalfunctionIndicatorLamp_DIAG.Task1 ICAN.ICANDM1RxSAF1.MalfunctionIndicatorLampFlash_DIAG.Task1 ICAN.ICANDM1RxSAF1.ProtectLamp_DIAG.Task1 ICAN.ICANDM1RxSAF1.ProtectLampFlash_DIAG.Task1 ICAN.ICANDM1RxSAF1.RedStopLamp_DIAG.Task1 ICAN.ICANDM1RxSAF1.RedStopLampFlash_DIAG.Task1 /end REF_MEASUREMENT
/end GROUP
/begin GROUP SYSTEM.I_CAN "I-CAN"
 /begin ANNOTATION ANNOTATION_LABEL "Instance" ANNOTATION_ORIGIN "Group" /begin ANNOTATION_TEXT "0" /end ANNOTATION_TEXT /end ANNOTATION
 /begin ANNOTATION ANNOTATION_LABEL "TaskCycleTime" ANNOTATION_ORIGIN "Group" /begin ANNOTATION_TEXT "0" /end ANNOTATION_TEXT /end ANNOTATION
 /begin ANNOTATION ANNOTATION_LABEL "TimeResolution" ANNOTATION_ORIGIN "Group" /begin ANNOTATION_TEXT "0" /end ANNOTATION_TEXT /end ANNOTATION
 /begin SUB_GROUP SYSTEM.I_CAN.I_Test1 SYSTEM.I_CAN.I_Tes1 SYSTEM.I_CAN.PG_Rx_Message_1 SYSTEM.I_CAN.ICAN_DM1_Rx_SA_19 SYSTEM.I_CAN.ICAN_DM1_Rx_SA_F1 /end SUB_GROUP
/end GROUP
/begin GROUP SYSTEM.FMS_CAN.FMS_GenTX_1 "FMS-GenTX_1"
 /begin ANNOTATION ANNOTATION_LABEL "Instance" ANNOTATION_ORIGIN "Group" /begin ANNOTATION_TEXT "0" /end ANNOTATION_TEXT /end ANNOTATION
 /begin ANNOTATION ANNOTATION_LABEL "TaskCycleTime" ANNOTATION_ORIGIN "Group" /begin ANNOTATION_TEXT "0" /end ANNOTATION_TEXT /end ANNOTATION
 /begin ANNOTATION ANNOTATION_LABEL "TimeResolution" ANNOTATION_ORIGIN "Group" /begin ANNOTATION_TEXT "0" /end ANNOTATION_TEXT /end ANNOTATION
 /begin REF_MEASUREMENT FMSCAN.TX_GEN.FMSGenTX_1.MessageState.Task1 FMSCAN.TX_GEN.FMSGenTX_1.MessageEnable.Task1 FMSCAN.TX_GEN.FMSGenTX_1.Val_1.Task1 /end REF_MEASUREMENT
/end GROUP
/begin GROUP SYSTEM.FMS_CAN.Generic_DM1_Rx_SA11 "Generic DM1 Rx SA11"
 /begin ANNOTATION ANNOTATION_LABEL "Instance" ANNOTATION_ORIGIN "Group" /begin ANNOTATION_TEXT "0" /end ANNOTATION_TEXT /end ANNOTATION
 /begin ANNOTATION ANNOTATION_LABEL "TaskCycleTime" ANNOTATION_ORIGIN "Group" /begin ANNOTATION_TEXT "0" /end ANNOTATION_TEXT /end ANNOTATION
 /begin ANNOTATION ANNOTATION_LABEL "TimeResolution" ANNOTATION_ORIGIN "Group" /begin ANNOTATION_TEXT "0" /end ANNOTATION_TEXT /end ANNOTATION
 /begin REF_MEASUREMENT FMSCAN.GenericDM1RxSA11.MessageState.Task1 FMSCAN.GenericDM1RxSA11.ActiveDTC.Task1 FMSCAN.GenericDM1RxSA11.AmberWarningLamp.Task1 FMSCAN.GenericDM1RxSA11.AmberWarningLampFlash.Task1 FMSCAN.GenericDM1RxSA11.UndefinedActiveDtc.Task1 FMSCAN.GenericDM1RxSA11.MessageEnable.Task1 /end REF_MEASUREMENT
/end GROUP
/begin GROUP SYSTEM.FMS_CAN.Generic_DM1_Tx_Message "Generic DM1 Tx Message"
 /begin ANNOTATION ANNOTATION_LABEL "Instance" ANNOTATION_ORIGIN "Group" /begin ANNOTATION_TEXT "0" /end ANNOTATION_TEXT /end ANNOTATION
 /begin ANNOTATION ANNOTATION_LABEL "TaskCycleTime" ANNOTATION_ORIGIN "Group" /begin ANNOTATION_TEXT "0" /end ANNOTATION_TEXT /end ANNOTATION
 /begin ANNOTATION ANNOTATION_LABEL "TimeResolution" ANNOTATION_ORIGIN "Group" /begin ANNOTATION_TEXT "0" /end ANNOTATION_TEXT /end ANNOTATION
 /begin REF_MEASUREMENT FMSCAN.GenericDM1TxMessage.DeviceState.Task1 FMSCAN.GenericDM1TxMessage.DeviceEnable.Task1 /end REF_MEASUREMENT
/end GROUP
/begin GROUP SYSTEM.FMS_CAN "FMS-CAN"
 /begin ANNOTATION ANNOTATION_LABEL "Instance" ANNOTATION_ORIGIN "Group" /begin ANNOTATION_TEXT "0" /end ANNOTATION_TEXT /end ANNOTATION
 /begin ANNOTATION ANNOTATION_LABEL "TaskCycleTime" ANNOTATION_ORIGIN "Group" /begin ANNOTATION_TEXT "0" /end ANNOTATION_TEXT /end ANNOTATION
 /begin ANNOTATION ANNOTATION_LABEL "TimeResolution" ANNOTATION_ORIGIN "Group" /begin ANNOTATION_TEXT "0" /end ANNOTATION_TEXT /end ANNOTATION
 /begin SUB_GROUP SYSTEM.FMS_CAN.FMS_GenTX_1 SYSTEM.FMS_CAN.Generic_DM1_Rx_SA11 SYSTEM.FMS_CAN.Generic_DM1_Tx_Message /end SUB_GROUP
 /begin REF_MEASUREMENT FMSCAN.BusActivityState.Task1 /end REF_MEASUREMENT
/end GROUP
/begin GROUP SYSTEM.DR_CAN.DR_GenTX_1 "DR-GenTX_1"
 /begin ANNOTATION ANNOTATION_LABEL "Instance" ANNOTATION_ORIGIN "Group" /begin ANNOTATION_TEXT "0" /end ANNOTATION_TEXT /end ANNOTATION
 /begin ANNOTATION ANNOTATION_LABEL "TaskCycleTime" ANNOTATION_ORIGIN "Group" /begin ANNOTATION_TEXT "0" /end ANNOTATION_TEXT /end ANNOTATION
 /begin ANNOTATION ANNOTATION_LABEL "TimeResolution" ANNOTATION_ORIGIN "Group" /begin ANNOTATION_TEXT "0" /end ANNOTATION_TEXT /end ANNOTATION
 /begin REF_MEASUREMENT DRCAN.TX_GEN.DRGenTX_1.MessageState.Task1 DRCAN.TX_GEN.DRGenTX_1.MessageEnable.Task1 DRCAN.TX_GEN.DRGenTX_1.Val_1.Task1 /end REF_MEASUREMENT
/end GROUP
/begin GROUP SYSTEM.DR_CAN "DR-CAN"
 /begin ANNOTATION ANNOTATION_LABEL "Instance" ANNOTATION_ORIGIN "Group" /begin ANNOTATION_TEXT "0" /end ANNOTATION_TEXT /end ANNOTATION
 /begin ANNOTATION ANNOTATION_LABEL "TaskCycleTime" ANNOTATION_ORIGIN "Group" /begin ANNOTATION_TEXT "0" /end ANNOTATION_TEXT /end ANNOTATION
 /begin ANNOTATION ANNOTATION_LABEL "TimeResolution" ANNOTATION_ORIGIN "Group" /begin ANNOTATION_TEXT "0" /end ANNOTATION_TEXT /end ANNOTATION
 /begin SUB_GROUP SYSTEM.DR_CAN.DR_GenTX_1 /end SUB_GROUP
/end GROUP
/begin GROUP SYSTEM.H_CAN.H_GenTX_1 "H-GenTX_1"
 /begin ANNOTATION ANNOTATION_LABEL "Instance" ANNOTATION_ORIGIN "Group" /begin ANNOTATION_TEXT "0" /end ANNOTATION_TEXT /end ANNOTATION
 /begin ANNOTATION ANNOTATION_LABEL "TaskCycleTime" ANNOTATION_ORIGIN "Group" /begin ANNOTATION_TEXT "0" /end ANNOTATION_TEXT /end ANNOTATION
 /begin ANNOTATION ANNOTATION_LABEL "TimeResolution" ANNOTATION_ORIGIN "Group" /begin ANNOTATION_TEXT "0" /end ANNOTATION_TEXT /end ANNOTATION
 /begin REF_MEASUREMENT HCAN.TX_GEN.HGenTX_1.MessageState.Task1 HCAN.TX_GEN.HGenTX_1.MessageEnable.Task1 HCAN.TX_GEN.HGenTX_1.Val_1.Task1 HCAN.TX_GEN.HGenTX_1.Val_2.Task1 /end REF_MEASUREMENT
/end GROUP
/begin GROUP SYSTEM.H_CAN "H-CAN"
 /begin ANNOTATION ANNOTATION_LABEL "Instance" ANNOTATION_ORIGIN "Group" /begin ANNOTATION_TEXT "0" /end ANNOTATION_TEXT /end ANNOTATION
 /begin ANNOTATION ANNOTATION_LABEL "TaskCycleTime" ANNOTATION_ORIGIN "Group" /begin ANNOTATION_TEXT "0" /end ANNOTATION_TEXT /end ANNOTATION
 /begin ANNOTATION ANNOTATION_LABEL "TimeResolution" ANNOTATION_ORIGIN "Group" /begin ANNOTATION_TEXT "0" /end ANNOTATION_TEXT /end ANNOTATION
 /begin SUB_GROUP SYSTEM.H_CAN.H_GenTX_1 /end SUB_GROUP
/end GROUP
/begin GROUP SYSTEM.STIMD "STIMD"
 /begin ANNOTATION ANNOTATION_LABEL "Instance" ANNOTATION_ORIGIN "Group" /begin ANNOTATION_TEXT "0" /end ANNOTATION_TEXT /end ANNOTATION
 /begin ANNOTATION ANNOTATION_LABEL "TaskCycleTime" ANNOTATION_ORIGIN "Group" /begin ANNOTATION_TEXT "0" /end ANNOTATION_TEXT /end ANNOTATION
 /begin ANNOTATION ANNOTATION_LABEL "TimeResolution" ANNOTATION_ORIGIN "Group" /begin ANNOTATION_TEXT "0" /end ANNOTATION_TEXT /end ANNOTATION
 /begin REF_MEASUREMENT STIMD.CanValue.Task1 STIMD.EEprom_Value.Task1 STIMD.TypeReal.Task1 STIMD.TypeTest.Task1 STIMD.DTC_activation.Task1 STIMD.GenTxCycleTime.Task1 STIMD.Accel_Enable.Task1 STIMD.Alarm_boSetAlarm.Task1 STIMD.Alarm_usiMinutes.Task1 STIMD.Alarm_usiSeconds.Task1 STIMD.D_DM1TX.Task1 STIMD.DM11_enable.Task1 STIMD.DM13_enable.Task1 STIMD.DM1RX_enable.Task1 STIMD.DM1RX_SwitchDtcMode.Task1 STIMD.DM1RX_SwitchRecMode.Task1 STIMD.DM2_enable.Task1 STIMD.DM3_enable.Task1 STIMD.DM4RX_Device_Enable.Task1 STIMD.DM4RX_EcuAddress.Task1 STIMD.DM4RX_Next.Task1 STIMD.DM4RX_Previous.Task1 STIMD.DM4RX_RequestDm4.Task1 STIMD.DM4RX_SaeFormat.Task1 STIMD.DTC_enable.Task1 STIMD.DTC_EnableCon00.Task1 STIMD.DTC_StorageCon00.Task1 STIMD.EEprom_Enable.Task1 STIMD.EEprom_Trigger.Task1 STIMD.F_DM1TX.Task1 STIMD.FmsCanEnable.Task1 STIMD.ListDtcEcuAddrMask.Task1 STIMD.ListDtcEnable.Task1 STIMD.ListDtcNextEntry.Task1 STIMD.ListDtcPrevEntry.Task1 STIMD.ListDtcSelectCanChannel.Task1 STIMD.ListDtcStatusMask.Task1 STIMD.OUT_enable.Task1 STIMD.OUT_TdActivation.Task1 STIMD.OUT_value.Task1 STIMD.P_DM1TX.Task1 STIMD.PCanEnable.Task1 STIMD.TimeDateSet.Task1 STIMD.TimeSourceSelect.Task1 STIMD.TSU_enable.Task1 STIMD.TSU_Source.Task1 /end REF_MEASUREMENT
/end GROUP
/begin GROUP SYSTEM.TSUD "TSUD"
 /begin ANNOTATION ANNOTATION_LABEL "Instance" ANNOTATION_ORIGIN "Group" /begin ANNOTATION_TEXT "0" /end ANNOTATION_TEXT /end ANNOTATION
 /begin ANNOTATION ANNOTATION_LABEL "TaskCycleTime" ANNOTATION_ORIGIN "Group" /begin ANNOTATION_TEXT "0" /end ANNOTATION_TEXT /end ANNOTATION
 /begin ANNOTATION ANNOTATION_LABEL "TimeResolution" ANNOTATION_ORIGIN "Group" /begin ANNOTATION_TEXT "0" /end ANNOTATION_TEXT /end ANNOTATION
 /begin REF_MEASUREMENT TSUD.TotalDistance.Task1 TSUD.TripADistance.Task1 TSUD.TripBDistance.Task1 TSUD.DeviceState.Task1 TSUD.PulseNumber.Task1 TSUD.ShaftSpeed.Task1 TSUD.VehicleSpeed.Task1 TSUD.DrivingState.Task1 TSUD.GetDiagWriteOdometer.Task1 TSUD.KFactor.Task1 TSUD.DeviceEnable.Task1 TSUD.SetDiagWriteOdoResponse.Task1 TSUD.SourceOfCalculation.Task1 TSUD.TripAReset.Task1 TSUD.TripBReset.Task1 TSUD.KFactor_DIAG.Task1 TSUD.SetDiagWriteOdoResponse_DIAG.Task1 TSUD.ShaftSpeed_DIAG.Task1 TSUD.SourceOfCalculation_DIAG.Task1 TSUD.TotalDistance_DIAG.Task1 TSUD.TripADistance_DIAG.Task1 TSUD.TripBDistance_DIAG.Task1 TSUD.VehicleSpeed_DIAG.Task1 /end REF_MEASUREMENT
/end GROUP
/begin GROUP SYSTEM.Inertian_Sensor_Device.Accelerometer_Subdevice "Accelerometer Subdevice"
 /begin ANNOTATION ANNOTATION_LABEL "Instance" ANNOTATION_ORIGIN "Group" /begin ANNOTATION_TEXT "0" /end ANNOTATION_TEXT /end ANNOTATION
 /begin ANNOTATION ANNOTATION_LABEL "TaskCycleTime" ANNOTATION_ORIGIN "Group" /begin ANNOTATION_TEXT "0" /end ANNOTATION_TEXT /end ANNOTATION
 /begin ANNOTATION ANNOTATION_LABEL "TimeResolution" ANNOTATION_ORIGIN "Group" /begin ANNOTATION_TEXT "0" /end ANNOTATION_TEXT /end ANNOTATION
 /begin REF_MEASUREMENT InertianSensorDevice.AccelerometerSubdevice.Ax.Task1 InertianSensorDevice.AccelerometerSubdevice.Ay.Task1 InertianSensorDevice.AccelerometerSubdevice.Az.Task1 InertianSensorDevice.AccelerometerSubdevice.DeviceState.Task1 InertianSensorDevice.AccelerometerSubdevice.DeviceEnable.Task1 /end REF_MEASUREMENT
/end GROUP
/begin GROUP SYSTEM.Inertian_Sensor_Device "Inertian Sensor Device"
 /begin ANNOTATION ANNOTATION_LABEL "Instance" ANNOTATION_ORIGIN "Group" /begin ANNOTATION_TEXT "0" /end ANNOTATION_TEXT /end ANNOTATION
 /begin ANNOTATION ANNOTATION_LABEL "TaskCycleTime" ANNOTATION_ORIGIN "Group" /begin ANNOTATION_TEXT "0" /end ANNOTATION_TEXT /end ANNOTATION
 /begin ANNOTATION ANNOTATION_LABEL "TimeResolution" ANNOTATION_ORIGIN "Group" /begin ANNOTATION_TEXT "0" /end ANNOTATION_TEXT /end ANNOTATION
 /begin SUB_GROUP SYSTEM.Inertian_Sensor_Device.Accelerometer_Subdevice /end SUB_GROUP
/end GROUP
/begin GROUP SYSTEM "SYSTEM"
 /begin ANNOTATION ANNOTATION_LABEL "Instance" ANNOTATION_ORIGIN "Group" /begin ANNOTATION_TEXT "0" /end ANNOTATION_TEXT /end ANNOTATION
 /begin ANNOTATION ANNOTATION_LABEL "TaskCycleTime" ANNOTATION_ORIGIN "Group" /begin ANNOTATION_TEXT "0" /end ANNOTATION_TEXT /end ANNOTATION
 /begin ANNOTATION ANNOTATION_LABEL "TimeResolution" ANNOTATION_ORIGIN "Group" /begin ANNOTATION_TEXT "0" /end ANNOTATION_TEXT /end ANNOTATION
 /begin SUB_GROUP SYSTEM.Alarm_Devices SYSTEM.Date_and_Time SYSTEM.Model_Control SYSTEM.Digital_Inputs SYSTEM.Digital_Outputs__STATIC_ SYSTEM.Digital_Output__PWM_ SYSTEM.NVM_Model_Related_Data SYSTEM.RAM_Device SYSTEM.DEM_Diagnostic_Event_Manager SYSTEM.DtcList SYSTEM.DM4RX_Main_Device SYSTEM.UDS_Services SYSTEM.D_CAN SYSTEM.A_CAN SYSTEM.P_CAN SYSTEM.I_CAN SYSTEM.FMS_CAN SYSTEM.DR_CAN SYSTEM.H_CAN SYSTEM.STIMD SYSTEM.TSUD SYSTEM.Inertian_Sensor_Device /end SUB_GROUP
/end GROUP
/begin GROUP PROCESSIMAGE "PROCESSIMAGE" ROOT
 /begin ANNOTATION ANNOTATION_LABEL "Instance" ANNOTATION_ORIGIN "Group" /begin ANNOTATION_TEXT "0" /end ANNOTATION_TEXT /end ANNOTATION
 /begin ANNOTATION ANNOTATION_LABEL "TaskCycleTime" ANNOTATION_ORIGIN "Group" /begin ANNOTATION_TEXT "0" /end ANNOTATION_TEXT /end ANNOTATION
 /begin ANNOTATION ANNOTATION_LABEL "TimeResolution" ANNOTATION_ORIGIN "Group" /begin ANNOTATION_TEXT "0" /end ANNOTATION_TEXT /end ANNOTATION
 /begin SUB_GROUP SYSTEM /end SUB_GROUP
/end GROUP
/begin GROUP NVMPARAMETER.NVM_Parameter "NVM Parameter"
 /begin ANNOTATION ANNOTATION_LABEL "Instance" ANNOTATION_ORIGIN "Group" /begin ANNOTATION_TEXT "0" /end ANNOTATION_TEXT /end ANNOTATION
 /begin ANNOTATION ANNOTATION_LABEL "TaskCycleTime" ANNOTATION_ORIGIN "Group" /begin ANNOTATION_TEXT "0" /end ANNOTATION_TEXT /end ANNOTATION
 /begin ANNOTATION ANNOTATION_LABEL "TimeResolution" ANNOTATION_ORIGIN "Group" /begin ANNOTATION_TEXT "0" /end ANNOTATION_TEXT /end ANNOTATION
 /begin REF_CHARACTERISTIC Variable_00 Variable_01 Variable_02 /end REF_CHARACTERISTIC
/end GROUP
/begin GROUP NVMPARAMETER "NVMPARAMETER" ROOT
 /begin ANNOTATION ANNOTATION_LABEL "Instance" ANNOTATION_ORIGIN "Group" /begin ANNOTATION_TEXT "0" /end ANNOTATION_TEXT /end ANNOTATION
 /begin ANNOTATION ANNOTATION_LABEL "TaskCycleTime" ANNOTATION_ORIGIN "Group" /begin ANNOTATION_TEXT "0" /end ANNOTATION_TEXT /end ANNOTATION
 /begin ANNOTATION ANNOTATION_LABEL "TimeResolution" ANNOTATION_ORIGIN "Group" /begin ANNOTATION_TEXT "0" /end ANNOTATION_TEXT /end ANNOTATION
 /begin SUB_GROUP NVMPARAMETER.NVM_Parameter /end SUB_GROUP
/end GROUP
/begin COMPU_METHOD COMP_DEFAULT "" RAT_FUNC "%11.5" /* display format */ "Increments" /* physical unit */ COEFFS 0 1 0 0 0 1 /end COMPU_METHOD
/begin COMPU_METHOD IS_BOOLEAN_TRUE "" RAT_FUNC "%11.5" /* display format */ "" /* physical unit */ COEFFS 0 1 0 0 0 1 /end COMPU_METHOD
/begin COMPU_VTAB BSGEvo_Illumi_DutyCycle_Encoding ". " TAB_VERB 4 251 "BSGEvo_Illumi_DutyCycle_Encoding__Parameter_Specific_Indicator" 252 "BSGEvo_Illumi_DutyCycle_Encoding__Reserved_Range_For_Future_Indication" 254 "BSGEvo_Illumi_DutyCycle_Encoding__Error_Indicator" 255 "BSGEvo_Illumi_DutyCycle_Encoding__Not_Available" /end COMPU_VTAB
/begin COMPU_VTAB DNR_Position_Selected_Encoding ". " TAB_VERB 2 0 "DNR_Position_Selected_Encoding__NonSelected" 1 "DNR_Position_Selected_Encoding__Selected" /end COMPU_VTAB
/begin COMPU_VTAB DNR_Position_SwitchStatus_Encoding ". " TAB_VERB 4 0 "DNR_Position_SwitchStatus_Encoding__Switch_Position_Valid" 1 "DNR_Position_SwitchStatus_Encoding__2_Contiguous_Switching_Positions_Active" 2 "DNR_Position_SwitchStatus_Encoding__Switch_Defect" 3 "DNR_Position_SwitchStatus_Encoding__Signal_Not_Available" /end COMPU_VTAB
/begin COMPU_VTAB MFL_BtnInfo_Btn_Encoding ". " TAB_VERB 2 0 "MFL_BtnInfo_Btn_Encoding__Inactive" 1 "MFL_BtnInfo_Btn_Encoding__Active" /end COMPU_VTAB
/begin COMPU_VTAB MFL_BtnInfo_ErrorLoc_Encoding ". " TAB_VERB 3 10 "MFL_BtnInfo_ErrorLoc_Encoding__MFL_right_and_left_out_of_order" 2 "MFL_BtnInfo_ErrorLoc_Encoding__MFL_right_out_of_order" 8 "MFL_BtnInfo_ErrorLoc_Encoding__MFL_left_out_of_order" /end COMPU_VTAB
/begin COMPU_VTAB MFL_BtnInfo_ErrorType_Encoding ". " TAB_VERB 1 15 "MFL_BtnInfo_ErrorType_Encoding__Not_Available" /end COMPU_VTAB
/begin RECORD_LAYOUT LC_A_UINT8 FNC_VALUES 1 UBYTE ROW_DIR DIRECT /end RECORD_LAYOUT
/begin RECORD_LAYOUT LC_A_UINT16 FNC_VALUES 1 UWORD ROW_DIR DIRECT /end RECORD_LAYOUT
/end MODULE
/end PROJECT
